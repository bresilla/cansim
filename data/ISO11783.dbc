VERSION ""

NS_ :

BS_:

BU_: SEND VT Sprayer Loader AuxInput

BO_ 3221225472 VECTOR__INDEPENDENT_SIG_MSG: 0 Vector__XXX
 SG_ VTFunctionECUtoVT : 0|8@1+ (1,0) [0|255] "" Vector__XXX
 SG_ KeyActivationCode : 0|8@1+ (1,0) [0|2] "" Vector__XXX
 SG_ KeyObjectParentID : 0|16@1+ (1,0) [0|65535] "" Vector__XXX
 SG_ KeyObjectID : 0|16@1+ (1,0) [0|65535] "" Vector__XXX
 SG_ SoftKeyCode : 0|8@1+ (1,0) [0|255] "" Vector__XXX
 SG_ ButtonActivationCode : 0|8@1+ (1,0) [0|2] "" Vector__XXX
 SG_ ButtonObjectID : 0|16@1+ (1,0) [0|65535] "" Vector__XXX
 SG_ ButtonObjectParentID : 0|16@1+ (1,0) [0|65535] "" Vector__XXX
 SG_ ButtonKeyCode : 0|8@1+ (1,0) [0|255] "" Vector__XXX
 SG_ XPosition : 0|16@1+ (1,0) [0|65535] "" Vector__XXX
 SG_ YPosition : 0|16@1+ (1,0) [0|65535] "" Vector__XXX
 SG_ TouchState : 0|8@1+ (1,0) [0|255] "" Vector__XXX
 SG_ VTSelectInputObjectID : 0|16@1+ (1,0) [0|65535] "" Vector__XXX
 SG_ VTSelectInputObjectStatus : 0|8@1+ (1,0) [0|1] "" Vector__XXX
 SG_ VTEscObjectID : 0|16@1+ (1,0) [0|65535] "" Vector__XXX
 SG_ VTChangeNumericValueObjectID : 0|16@1+ (1,0) [0|65535] "" Vector__XXX
 SG_ VTChangeNumericValueValue : 0|32@1+ (1,0) [0|4294967295] "" Vector__XXX
 SG_ VTChangeActiveMaskObjectID : 0|16@1+ (1,0) [0|65535] "" Vector__XXX
 SG_ VTChangeSoftKeyMaskParentID : 0|16@1+ (1,0) [0|65535] "" Vector__XXX
 SG_ VTChangeSoftKeyMaskObjectID : 0|16@1+ (1,0) [0|65535] "" Vector__XXX
 SG_ ParentObjectID : 0|16@1+ (1,0) [0|65535] "" Vector__XXX
 SG_ ObjectToChangeStringValueID : 0|16@1+ (1,0) [0|65535] "" Vector__XXX
 SG_ DisplayActivationStatus1 : 0|1@1+ (1,0) [0|1] "" Vector__XXX
 SG_ VisibleDataAlarmMaskID : 0|16@1+ (1,0) [0|65535] "" Vector__XXX
 SG_ VisibleSoftKeyMaskID : 0|16@1+ (1,0) [0|65535] "" Vector__XXX
 SG_ ObjectPoolRecord : 0|56@1+ (1,0) [0|3338120000] "" Vector__XXX
 SG_ AuxiliaryFunctionObjectID : 0|16@1+ (1,0) [0|65535] "" Vector__XXX
 SG_ AssignmentErrorNotAccepted : 0|1@1+ (1,0) [0|1] "" Vector__XXX
 SG_ NumberOfInpuUnits : 0|8@1+ (1,0) [0|255] "" Vector__XXX
 SG_ AuxModelIdentification : 0|16@1+ (1,0) [0|65535] "" Vector__XXX
 SG_ InputStatusObjectId : 0|16@1+ (1,0) [0|255] "" Vector__XXX
 SG_ AuxInputEnable : 0|8@1+ (1,0) [0|1] "" Vector__XXX
 SG_ AuxErrorInvalidInputID : 0|1@1+ (1,0) [0|1] "" Vector__XXX
 SG_ AuxErrorAnyOther : 0|1@1+ (1,0) [0|1] "" Vector__XXX
 SG_ ObjectToShowHideID : 0|16@1+ (1,0) [0|65535] "" Vector__XXX
 SG_ ShowOrHide : 0|8@1+ (1,0) [0|1] "" Vector__XXX
 SG_ ObjectoEnableDisbaleID : 0|16@1+ (1,0) [0|65535] "" Vector__XXX
 SG_ EnableOrDisable : 0|8@1+ (1,0) [0|1] "" Vector__XXX
 SG_ SelectInputObjectID : 0|16@1+ (1,0) [0|65535] "" Vector__XXX
 SG_ SetFocusOpenForEditing : 0|8@1+ (1,0) [0|255] "" Vector__XXX
 SG_ NumberOfRepetitions_Audio : 0|8@1+ (1,0) [0|255] "" Vector__XXX
 SG_ Frequency_Audio : 0|16@1+ (1,0) [0|65535] "hz" Vector__XXX
 SG_ OnTimeDuration_Audio : 0|16@1+ (1,0) [0|65535] "ms" Vector__XXX
 SG_ OffTimeDuration_Audio : 0|16@1+ (1,0) [0|65535] "ms" Vector__XXX
 SG_ AudioVolume : 0|8@1+ (1,0) [0|100] "%" Vector__XXX
 SG_ ParentObjectID : 0|16@1+ (1,0) [0|65535] "" Vector__XXX
 SG_ ObjectToMoveID : 0|16@1+ (1,0) [0|65535] "" Vector__XXX
 SG_ XPosChangeTopLeft : 0|8@1+ (1,-127) [-127|128] "" Vector__XXX
 SG_ YPosChangeTopLeft : 0|8@1+ (1,-127) [-127|128] "" Vector__XXX
 SG_ ObjectToSizeID : 0|16@1+ (1,0) [0|65535] "" Vector__XXX
 SG_ NewWidth : 0|16@1+ (1,0) [0|65535] "" Vector__XXX
 SG_ NewHeight : 0|16@1+ (1,0) [0|65535] "" Vector__XXX
 SG_ ObjectToChangeColourID : 0|16@1+ (1,0) [0|65535] "" Vector__XXX
 SG_ NewBackgroundColour : 0|8@1+ (1,0) [0|255] "" Vector__XXX
 SG_ ObjectToChangeNumValueID : 0|16@1+ (1,0) [0|65535] "" Vector__XXX
 SG_ NewValue : 0|32@1+ (1,0) [0|65535] "" Vector__XXX
 SG_ ObjectToChangeEndPointID : 0|16@1+ (1,0) [0|65535] "" Vector__XXX
 SG_ Width : 0|16@1+ (1,0) [0|65535] "" Vector__XXX
 SG_ Height : 0|16@1+ (1,0) [0|65535] "" Vector__XXX
 SG_ LineDirection : 0|8@1+ (1,0) [0|1] "" Vector__XXX
 SG_ ObjectToChangeFontID : 0|16@1+ (1,0) [0|65535] "" Vector__XXX
 SG_ FontColour : 0|8@1+ (1,0) [0|255] "" Vector__XXX
 SG_ FontSize : 0|8@1+ (1,0) [0|255] "" Vector__XXX
 SG_ FontType : 0|8@1+ (1,0) [0|255] "" Vector__XXX
 SG_ FontStyle : 0|8@1+ (1,0) [0|255] "" Vector__XXX
 SG_ ObjectToChangeLineAttributesID : 0|16@1+ (1,0) [0|65535] "" Vector__XXX
 SG_ LineColour : 0|8@1+ (1,0) [0|255] "" Vector__XXX
 SG_ LineWidth : 0|8@1+ (1,0) [0|255] "" Vector__XXX
 SG_ LineArt : 0|16@1+ (1,0) [0|65535] "" Vector__XXX
 SG_ ObjectToChangeFillAttributesID : 0|16@1+ (1,0) [0|65535] "" Vector__XXX
 SG_ FillType : 0|8@1+ (1,0) [0|255] "" Vector__XXX
 SG_ FillColour : 0|8@1+ (1,0) [0|255] "" Vector__XXX
 SG_ FillPatternObjectID : 0|16@1+ (1,0) [0|65535] "" Vector__XXX
 SG_ WorkingSetObjectID : 0|16@1+ (1,0) [0|65535] "" Vector__XXX
 SG_ NewActiveMaskObjectID : 0|16@1+ (1,0) [0|65535] "" Vector__XXX
 SG_ MaskType : 0|8@1+ (1,0) [0|255] "" Vector__XXX
 SG_ DataOrAlarmMaskObjectID : 0|16@1+ (1,0) [0|65535] "" Vector__XXX
 SG_ NewSoftKeyMaskObjectID : 0|16@1+ (1,0) [0|65535] "" Vector__XXX
 SG_ ObjectToChangeAttributeID : 0|16@1+ (1,0) [0|65535] "" Vector__XXX
 SG_ AttributeID : 0|8@1+ (1,0) [0|16777200] "" Vector__XXX
 SG_ NewAttributeValue : 0|32@1+ (1,0) [0|0] "" Vector__XXX
 SG_ AlarmMaskObjectID : 0|16@1+ (1,0) [0|65535] "" Vector__XXX
 SG_ NewPriority : 0|8@1+ (1,0) [0|255] "" Vector__XXX
 SG_ ListInputObjectID : 0|16@1+ (1,0) [0|65535] "" Vector__XXX
 SG_ ListIndex : 0|8@1+ (1,0) [0|255] "" Vector__XXX
 SG_ NewObjectID : 0|16@1+ (1,0) [0|65535] "" Vector__XXX
 SG_ ObjectToChangeStringValueID : 0|16@1+ (1,0) [0|65535] "" Vector__XXX
 SG_ NewStringValue : 0|16@1+ (1,0) [0|65535] "" Vector__XXX
 SG_ ParentObjectID : 0|16@1+ (1,0) [0|65535] "" Vector__XXX
 SG_ ObjectToMoveID : 0|16@1+ (1,0) [0|65535] "" Vector__XXX
 SG_ XPosChangeTopLeftLong : 0|16@1- (1,0) [-32768|32767] "" Vector__XXX
 SG_ YPosChangeTopLeftLong : 0|16@1- (1,0) [-32768|32767] "" Vector__XXX
 SG_ ObjectToAssociateLabelWithID : 0|16@1+ (1,0) [0|65535] "" Vector__XXX
 SG_ StringVariableObjectID : 0|16@1+ (1,0) [0|65535] "" Vector__XXX
 SG_ GraphicRepresentationObjectID : 0|16@1+ (1,0) [0|255] "" Vector__XXX
 SG_ FontType : 0|8@1+ (1,0) [0|255] "" Vector__XXX
 SG_ PolygonObjectToChangeID : 0|16@1+ (1,0) [0|65535] "" Vector__XXX
 SG_ IndexOfThePointToReplace : 0|8@1+ (1,0) [0|255] "" Vector__XXX
 SG_ NewValueX : 0|16@1+ (1,0) [0|65535] "" Vector__XXX
 SG_ NewValueY : 0|16@1+ (1,0) [0|65535] "" Vector__XXX
 SG_ PolygonObjectToScaleID : 0|16@1+ (1,0) [0|65535] "" Vector__XXX
 SG_ NewWidthAttribute : 0|16@1+ (1,0) [0|65535] "" Vector__XXX
 SG_ NewHeigthAttribute : 0|16@1+ (1,0) [0|0] "" Vector__XXX
 SG_ GraphicsContextObjectID : 0|16@1+ (1,0) [0|65535] "" Vector__XXX
 SG_ SubCommandID : 0|8@1+ (1,0) [0|0] "" Vector__XXX
 SG_ ObjectToGetAttributeID : 0|16@1+ (1,0) [0|65535] "" Vector__XXX
 SG_ AttributeID : 0|8@1+ (1,0) [0|0] "" Vector__XXX
 SG_ ColourMapObjectID : 0|16@1+ (1,0) [0|65535] "" Vector__XXX
 SG_ LockUnlockCommand : 0|8@1+ (1,0) [0|1] "" Vector__XXX
 SG_ ObjectIDOfDataMaskToLock : 0|16@1+ (1,0) [0|65535] "" Vector__XXX
 SG_ LockTimeout : 0|16@1+ (1,0) [0|65535] "" Vector__XXX
 SG_ MacroObjecID : 0|8@1+ (1,0) [0|255] "" Vector__XXX
 SG_ MemoryRequired : 0|24@1+ (1,0) [0|16777200] "" Vector__XXX
 SG_ CodePlane : 0|8@1+ (1,0) [0|16] "" Vector__XXX
 SG_ FirstWideChar : 0|16@1+ (1,0) [0|65535] "" Vector__XXX
 SG_ LastWideChar : 0|16@1+ (1,0) [0|65535] "" Vector__XXX
 SG_ VersionLabelToStore : 0|56@1+ (1,0) [0|3338120000] "" Vector__XXX
 SG_ VersionLabelToLoad : 0|56@1+ (1,0) [0|3338120000] "" Vector__XXX
 SG_ VersionLabelToDelete : 0|56@1+ (1,0) [0|3338120000] "" Vector__XXX
 SG_ WSMaintenanceInitiating : 0|1@1+ (1,0) [0|1] "" Vector__XXX
 SG_ WSMaintenanceBitmask : 0|1@1+ (1,0) [0|1] "" Vector__XXX
 SG_ VTFunctionECUtoVT : 0|8@1+ (1,0) [0|255] "" Vector__XXX
 SG_ KeyActivationCode : 0|8@1+ (1,0) [0|2] "" Vector__XXX
 SG_ KeyObjectParentID : 0|16@1+ (1,0) [0|65535] "" Vector__XXX
 SG_ KeyObjectID : 0|16@1+ (1,0) [0|65535] "" Vector__XXX
 SG_ SoftKeyCode : 0|8@1+ (1,0) [0|255] "" Vector__XXX
 SG_ ButtonActivationCode : 0|8@1+ (1,0) [0|2] "" Vector__XXX
 SG_ ButtonObjectID : 0|16@1+ (1,0) [0|65535] "" Vector__XXX
 SG_ ButtonObjectParentID : 0|16@1+ (1,0) [0|65535] "" Vector__XXX
 SG_ ButtonKeyCode : 0|8@1+ (1,0) [0|255] "" Vector__XXX
 SG_ XPosition : 0|16@1+ (1,0) [0|65535] "" Vector__XXX
 SG_ YPosition : 0|16@1+ (1,0) [0|65535] "" Vector__XXX
 SG_ TouchState : 0|8@1+ (1,0) [0|255] "" Vector__XXX
 SG_ VTSelectInputObjectID : 0|16@1+ (1,0) [0|65535] "" Vector__XXX
 SG_ VTSelectInputObjectStatus : 0|8@1+ (1,0) [0|1] "" Vector__XXX
 SG_ VTEscObjectID : 0|16@1+ (1,0) [0|65535] "" Vector__XXX
 SG_ VTChangeNumericValueObjectID : 0|16@1+ (1,0) [0|65535] "" Vector__XXX
 SG_ VTChangeNumericValueValue : 0|32@1+ (1,0) [0|4294967295] "" Vector__XXX
 SG_ VTChangeActiveMaskObjectID : 0|16@1+ (1,0) [0|65535] "" Vector__XXX
 SG_ VTChangeSoftKeyMaskParentID : 0|16@1+ (1,0) [0|65535] "" Vector__XXX
 SG_ VTChangeSoftKeyMaskObjectID : 0|16@1+ (1,0) [0|65535] "" Vector__XXX
 SG_ ParentObjectID : 0|16@1+ (1,0) [0|65535] "" Vector__XXX
 SG_ ObjectToChangeStringValueID : 0|16@1+ (1,0) [0|65535] "" Vector__XXX
 SG_ DisplayActivationStatus1 : 0|1@1+ (1,0) [0|1] "" Vector__XXX
 SG_ VisibleDataAlarmMaskID : 0|16@1+ (1,0) [0|65535] "" Vector__XXX
 SG_ VisibleSoftKeyMaskID : 0|16@1+ (1,0) [0|65535] "" Vector__XXX
 SG_ ObjectPoolRecord : 0|56@1+ (1,0) [0|3338120000] "" Vector__XXX
 SG_ AuxiliaryFunctionObjectID : 0|16@1+ (1,0) [0|65535] "" Vector__XXX
 SG_ AssignmentErrorNotAccepted : 0|1@1+ (1,0) [0|1] "" Vector__XXX
 SG_ NumberOfInpuUnits : 0|8@1+ (1,0) [0|255] "" Vector__XXX
 SG_ AuxModelIdentification : 0|16@1+ (1,0) [0|65535] "" Vector__XXX
 SG_ InputStatusObjectId : 0|16@1+ (1,0) [0|255] "" Vector__XXX
 SG_ AuxInputEnable : 0|8@1+ (1,0) [0|1] "" Vector__XXX
 SG_ AuxErrorInvalidInputID : 0|1@1+ (1,0) [0|1] "" Vector__XXX
 SG_ AuxErrorAnyOther : 0|1@1+ (1,0) [0|1] "" Vector__XXX
 SG_ ObjectToShowHideID : 0|16@1+ (1,0) [0|65535] "" Vector__XXX
 SG_ ShowOrHide : 0|8@1+ (1,0) [0|1] "" Vector__XXX
 SG_ ObjectoEnableDisbaleID : 0|16@1+ (1,0) [0|65535] "" Vector__XXX
 SG_ EnableOrDisable : 0|8@1+ (1,0) [0|1] "" Vector__XXX
 SG_ SelectInputObjectID : 0|16@1+ (1,0) [0|65535] "" Vector__XXX
 SG_ SetFocusOpenForEditing : 0|8@1+ (1,0) [0|255] "" Vector__XXX
 SG_ NumberOfRepetitions_Audio : 0|8@1+ (1,0) [0|255] "" Vector__XXX
 SG_ Frequency_Audio : 0|16@1+ (1,0) [0|65535] "hz" Vector__XXX
 SG_ OnTimeDuration_Audio : 0|16@1+ (1,0) [0|65535] "ms" Vector__XXX
 SG_ OffTimeDuration_Audio : 0|16@1+ (1,0) [0|65535] "ms" Vector__XXX
 SG_ AudioVolume : 0|8@1+ (1,0) [0|100] "%" Vector__XXX
 SG_ ParentObjectID : 0|16@1+ (1,0) [0|65535] "" Vector__XXX
 SG_ ObjectToMoveID : 0|16@1+ (1,0) [0|65535] "" Vector__XXX
 SG_ XPosChangeTopLeft : 0|8@1+ (1,-127) [-127|128] "" Vector__XXX
 SG_ YPosChangeTopLeft : 0|8@1+ (1,-127) [-127|128] "" Vector__XXX
 SG_ ObjectToSizeID : 0|16@1+ (1,0) [0|65535] "" Vector__XXX
 SG_ NewWidth : 0|16@1+ (1,0) [0|65535] "" Vector__XXX
 SG_ NewHeight : 0|16@1+ (1,0) [0|65535] "" Vector__XXX
 SG_ ObjectToChangeColourID : 0|16@1+ (1,0) [0|65535] "" Vector__XXX
 SG_ NewBackgroundColour : 0|8@1+ (1,0) [0|255] "" Vector__XXX
 SG_ ObjectToChangeNumValueID : 0|16@1+ (1,0) [0|65535] "" Vector__XXX
 SG_ NewValue : 0|32@1+ (1,0) [0|65535] "" Vector__XXX
 SG_ ObjectToChangeEndPointID : 0|16@1+ (1,0) [0|65535] "" Vector__XXX
 SG_ Width : 0|16@1+ (1,0) [0|65535] "" Vector__XXX
 SG_ Height : 0|16@1+ (1,0) [0|65535] "" Vector__XXX
 SG_ LineDirection : 0|8@1+ (1,0) [0|1] "" Vector__XXX
 SG_ ObjectToChangeFontID : 0|16@1+ (1,0) [0|65535] "" Vector__XXX
 SG_ FontColour : 0|8@1+ (1,0) [0|255] "" Vector__XXX
 SG_ FontSize : 0|8@1+ (1,0) [0|255] "" Vector__XXX
 SG_ FontType : 0|8@1+ (1,0) [0|255] "" Vector__XXX
 SG_ FontStyle : 0|8@1+ (1,0) [0|255] "" Vector__XXX
 SG_ ObjectToChangeLineAttributesID : 0|16@1+ (1,0) [0|65535] "" Vector__XXX
 SG_ LineColour : 0|8@1+ (1,0) [0|255] "" Vector__XXX
 SG_ LineWidth : 0|8@1+ (1,0) [0|255] "" Vector__XXX
 SG_ LineArt : 0|16@1+ (1,0) [0|65535] "" Vector__XXX
 SG_ ObjectToChangeFillAttributesID : 0|16@1+ (1,0) [0|65535] "" Vector__XXX
 SG_ FillType : 0|8@1+ (1,0) [0|255] "" Vector__XXX
 SG_ FillColour : 0|8@1+ (1,0) [0|255] "" Vector__XXX
 SG_ FillPatternObjectID : 0|16@1+ (1,0) [0|65535] "" Vector__XXX
 SG_ WorkingSetObjectID : 0|16@1+ (1,0) [0|65535] "" Vector__XXX
 SG_ NewActiveMaskObjectID : 0|16@1+ (1,0) [0|65535] "" Vector__XXX
 SG_ MaskType : 0|8@1+ (1,0) [0|255] "" Vector__XXX
 SG_ DataOrAlarmMaskObjectID : 0|16@1+ (1,0) [0|65535] "" Vector__XXX
 SG_ NewSoftKeyMaskObjectID : 0|16@1+ (1,0) [0|65535] "" Vector__XXX
 SG_ ObjectToChangeAttributeID : 0|16@1+ (1,0) [0|65535] "" Vector__XXX
 SG_ AttributeID : 0|8@1+ (1,0) [0|16777200] "" Vector__XXX
 SG_ NewAttributeValue : 0|32@1+ (1,0) [0|0] "" Vector__XXX
 SG_ AlarmMaskObjectID : 0|16@1+ (1,0) [0|65535] "" Vector__XXX
 SG_ NewPriority : 0|8@1+ (1,0) [0|255] "" Vector__XXX
 SG_ ListInputObjectID : 0|16@1+ (1,0) [0|65535] "" Vector__XXX
 SG_ ListIndex : 0|8@1+ (1,0) [0|255] "" Vector__XXX
 SG_ NewObjectID : 0|16@1+ (1,0) [0|65535] "" Vector__XXX
 SG_ ObjectToChangeStringValueID : 0|16@1+ (1,0) [0|65535] "" Vector__XXX
 SG_ NewStringValue : 0|16@1+ (1,0) [0|65535] "" Vector__XXX
 SG_ ParentObjectID : 0|16@1+ (1,0) [0|65535] "" Vector__XXX
 SG_ ObjectToMoveID : 0|16@1+ (1,0) [0|65535] "" Vector__XXX
 SG_ XPosChangeTopLeftLong : 0|16@1- (1,0) [-32768|32767] "" Vector__XXX
 SG_ YPosChangeTopLeftLong : 0|16@1- (1,0) [-32768|32767] "" Vector__XXX
 SG_ ObjectToAssociateLabelWithID : 0|16@1+ (1,0) [0|65535] "" Vector__XXX
 SG_ StringVariableObjectID : 0|16@1+ (1,0) [0|65535] "" Vector__XXX
 SG_ GraphicRepresentationObjectID : 0|16@1+ (1,0) [0|255] "" Vector__XXX
 SG_ FontType : 0|8@1+ (1,0) [0|255] "" Vector__XXX
 SG_ PolygonObjectToChangeID : 0|16@1+ (1,0) [0|65535] "" Vector__XXX
 SG_ IndexOfThePointToReplace : 0|8@1+ (1,0) [0|255] "" Vector__XXX
 SG_ NewValueX : 0|16@1+ (1,0) [0|65535] "" Vector__XXX
 SG_ NewValueY : 0|16@1+ (1,0) [0|65535] "" Vector__XXX
 SG_ PolygonObjectToScaleID : 0|16@1+ (1,0) [0|65535] "" Vector__XXX
 SG_ NewWidthAttribute : 0|16@1+ (1,0) [0|65535] "" Vector__XXX
 SG_ NewHeigthAttribute : 0|16@1+ (1,0) [0|0] "" Vector__XXX
 SG_ GraphicsContextObjectID : 0|16@1+ (1,0) [0|65535] "" Vector__XXX
 SG_ SubCommandID : 0|8@1+ (1,0) [0|0] "" Vector__XXX
 SG_ ObjectToGetAttributeID : 0|16@1+ (1,0) [0|65535] "" Vector__XXX
 SG_ AttributeID : 0|8@1+ (1,0) [0|0] "" Vector__XXX
 SG_ ColourMapObjectID : 0|16@1+ (1,0) [0|65535] "" Vector__XXX
 SG_ LockUnlockCommand : 0|8@1+ (1,0) [0|1] "" Vector__XXX
 SG_ ObjectIDOfDataMaskToLock : 0|16@1+ (1,0) [0|65535] "" Vector__XXX
 SG_ LockTimeout : 0|16@1+ (1,0) [0|65535] "" Vector__XXX
 SG_ MacroObjecID : 0|8@1+ (1,0) [0|255] "" Vector__XXX
 SG_ MemoryRequired : 0|24@1+ (1,0) [0|16777200] "" Vector__XXX
 SG_ CodePlane : 0|8@1+ (1,0) [0|16] "" Vector__XXX
 SG_ FirstWideChar : 0|16@1+ (1,0) [0|65535] "" Vector__XXX
 SG_ LastWideChar : 0|16@1+ (1,0) [0|65535] "" Vector__XXX
 SG_ VersionLabelToStore : 0|56@1+ (1,0) [0|3338120000] "" Vector__XXX
 SG_ VersionLabelToLoad : 0|56@1+ (1,0) [0|3338120000] "" Vector__XXX
 SG_ VersionLabelToDelete : 0|56@1+ (1,0) [0|3338120000] "" Vector__XXX
 SG_ WSMaintenanceInitiating : 0|1@1+ (1,0) [0|1] "" Vector__XXX
 SG_ WSMaintenanceBitmask : 0|1@1+ (1,0) [0|1] "" Vector__XXX
 SG_ VTFunctionVTtoECU : 0|8@1+ (1,0) [0|255] "" Vector__XXX
 SG_ KeyActivationCode : 0|8@1+ (1,0) [0|2] "" Vector__XXX
 SG_ KeyObjectID : 0|16@1+ (1,0) [0|65535] "" Vector__XXX
 SG_ KeyObjectParentID : 0|16@1+ (1,0) [0|65535] "" Vector__XXX
 SG_ SoftKeyCode : 0|8@1+ (1,0) [0|255] "" Vector__XXX
 SG_ ButtonActivationCode : 0|8@1+ (1,0) [0|2] "" Vector__XXX
 SG_ ButtonObjectID : 0|16@1+ (1,0) [0|65535] "" Vector__XXX
 SG_ ButtonObjectParentID : 0|16@1+ (1,0) [0|65535] "" Vector__XXX
 SG_ ButtonKeyCode : 0|8@1+ (1,0) [0|255] "" Vector__XXX
 SG_ XPosition : 0|16@1+ (1,0) [0|65535] "" Vector__XXX
 SG_ YPosition : 0|16@1+ (1,0) [0|65535] "" Vector__XXX
 SG_ TouchState : 0|8@1+ (1,0) [0|255] "" Vector__XXX
 SG_ VTSelectInputObjectID : 0|16@1+ (1,0) [0|65535] "" Vector__XXX
 SG_ VTSelectInputObjectStatus : 0|8@1+ (1,0) [0|1] "" Vector__XXX
 SG_ VTSelectInputObjectIsEdited : 0|1@1+ (1,0) [0|1] "" Vector__XXX
 SG_ VTEscObjectID : 0|16@1+ (1,0) [0|65535] "" Vector__XXX
 SG_ ErrorCodeVTEsc1 : 0|1@1+ (1,0) [0|1] "" Vector__XXX
 SG_ ErrorCodeVTEsc2 : 0|1@1+ (1,0) [0|1] "" Vector__XXX
 SG_ VTChangeNumericValueObjectID : 0|16@1+ (1,0) [0|65535] "" Vector__XXX
 SG_ VTChangeNumericValueValue : 0|32@1+ (1,0) [0|4294967295] "" Vector__XXX
 SG_ VTChangeActiveMaskObjectID : 0|16@1+ (1,0) [0|65535] "" Vector__XXX
 SG_ ErrorCodeMissingObjects : 0|1@1+ (1,0) [0|1] "" Vector__XXX
 SG_ ErrorCodeMaskOrChildObjectError : 0|1@1+ (1,0) [0|1] "" Vector__XXX
 SG_ ErrorCodeAnyOtherError : 0|1@1+ (1,0) [0|1] "" Vector__XXX
 SG_ ErrorCodePoolDeleted : 0|1@1+ (1,0) [0|1] "" Vector__XXX
 SG_ VTChangeActiveMaskErrorID : 0|16@1+ (1,0) [0|65535] "" Vector__XXX
 SG_ VTChangeActiveMaskParentID : 0|16@1+ (1,0) [0|65535] "" Vector__XXX
 SG_ VTChangeSoftKeyMaskParentID : 0|16@1+ (1,0) [0|65535] "" Vector__XXX
 SG_ VTChangeSoftKeyMaskObjectID : 0|16@1+ (1,0) [0|65535] "" Vector__XXX
 SG_ ErrorCodeVTChangeSoftKeyMask1 : 0|1@1+ (1,0) [0|1] "" Vector__XXX
 SG_ ErrorCodeVTChangeSoftKeyMask2 : 0|1@1+ (1,0) [0|1] "" Vector__XXX
 SG_ ErrorCodeVTChangeSoftKeyMask3 : 0|1@1+ (1,0) [0|1] "" Vector__XXX
 SG_ ErrorCodeVTChangeSoftKeyMask4 : 0|1@1+ (1,0) [0|1] "" Vector__XXX
 SG_ ErrorCodeVTChangeSoftKeyMask5 : 0|1@1+ (1,0) [0|1] "" Vector__XXX
 SG_ ObjectToChangeStringID : 0|16@1+ (1,0) [0|65535] "" Vector__XXX
 SG_ EnteredStringValue : 0|8@1+ (1,0) [0|255] "" Vector__XXX
 SG_ DisplayActivationStatus1 : 0|1@1+ (1,0) [0|1] "" Vector__XXX
 SG_ VisibleDataAlarmMaskID : 0|16@1+ (1,0) [0|65535] "" Vector__XXX
 SG_ VisibleSoftKeyMaskID : 0|16@1+ (1,0) [0|65535] "" Vector__XXX
 SG_ ErrorCodeEndOfObjectPool1 : 0|1@1+ (1,0) [0|1] "" Vector__XXX
 SG_ ErrorCodeEndOfObjectPool2 : 0|1@1+ (1,0) [0|1] "" Vector__XXX
 SG_ ErrorCodeEndOfObjectPool3 : 0|1@1+ (1,0) [0|1] "" Vector__XXX
 SG_ ParentObjectIdOfFaultyObject : 0|16@1+ (1,0) [0|65535] "" Vector__XXX
 SG_ ObjectIdOfFaultyObject : 0|16@1+ (1,0) [0|65535] "" Vector__XXX
 SG_ ErrorCodeObjectPool1 : 0|1@1+ (1,0) [0|1] "" Vector__XXX
 SG_ ErrorCodeObjectPool2 : 0|1@1+ (1,0) [0|1] "" Vector__XXX
 SG_ ErrorCodeObjectPool3 : 0|1@1+ (1,0) [0|1] "" Vector__XXX
 SG_ ErrorCodeObjectPool4 : 0|1@1+ (1,0) [0|1] "" Vector__XXX
 SG_ IdentityNumber : 0|21@1+ (1,0) [0|2097150] "" Vector__XXX
 SG_ ManufacturerCode : 0|11@1+ (1,0) [0|2047] "" Vector__XXX
 SG_ ECUInstance : 0|3@1+ (1,0) [0|7] "" Vector__XXX
 SG_ FunctionInstance : 0|5@1+ (1,0) [0|31] "" Vector__XXX
 SG_ AuxiliaryInputObjectID : 0|16@1+ (1,0) [0|65535] "" Vector__XXX
 SG_ InputObjectId : 0|16@1+ (1,0) [0|255] "" Vector__XXX
 SG_ Value1 : 0|16@1+ (1,0) [0|65535] "" Vector__XXX
 SG_ Function : 0|8@1+ (1,0) [0|255] "" Vector__XXX
 SG_ DeviceClass : 0|7@1+ (1,0) [0|127] "" Vector__XXX
 SG_ IndustryGroup : 0|3@1+ (1,0) [0|7] "" Vector__XXX
 SG_ DeviceClassInstance : 0|4@1+ (1,0) [0|15] "" Vector__XXX
 SG_ SelfConfigurableAddress : 0|1@1+ (1,0) [0|1] "" Vector__XXX
 SG_ AuxiliaryFunctionType : 0|4@1+ (1,0) [0|15] "" Vector__XXX
 SG_ AuxiliaryFunctionObjectID : 0|16@1+ (1,0) [0|65535] "" Vector__XXX
 SG_ Value2 : 0|16@1+ (1,0) [0|65535] "" Vector__XXX
 SG_ AuxPreferredAssignmentRespError1 : 0|1@1+ (1,0) [0|1] "" Vector__XXX
 SG_ AuxPreferredAssignmentRespError2 : 0|1@1+ (1,0) [0|1] "" Vector__XXX
 SG_ AuxPreferredAssignmentRespError3 : 0|1@1+ (1,0) [0|1] "" Vector__XXX
 SG_ AuxPreferredAssignmentRespError4 : 0|1@1+ (1,0) [0|1] "" Vector__XXX
 SG_ InputStatusObjectId : 0|16@1+ (1,0) [0|255] "" Vector__XXX
 SG_ AuxInputEnable : 0|8@1+ (1,0) [0|1] "" Vector__XXX
 SG_ ObjectEscapeID : 0|16@1+ (1,0) [0|65535] "" Vector__XXX
 SG_ ErrorCodeEscapeObj1 : 0|1@1+ (1,0) [0|1] "" Vector__XXX
 SG_ ErrorCodeEscapeObj2 : 0|1@1+ (1,0) [0|1] "" Vector__XXX
 SG_ ObjectToHideShowID : 0|16@1+ (1,0) [0|65535] "" Vector__XXX
 SG_ ObjectShowStatus : 0|8@1+ (1,0) [0|1] "" Vector__XXX
 SG_ ErrorCodeHideShowObj1 : 0|1@1+ (1,0) [0|1] "" Vector__XXX
 SG_ ErrorCodeHideShowObj2 : 0|1@1+ (1,0) [0|1] "" Vector__XXX
 SG_ ErrorCodeHideShowObj3 : 0|1@1+ (1,0) [0|1] "" Vector__XXX
 SG_ ObjectToEnableDisableID : 0|16@1+ (1,0) [0|65535] "" Vector__XXX
 SG_ ObjectEnableStatus : 0|8@1+ (1,0) [0|1] "" Vector__XXX
 SG_ ErrorCodeEnableDisableObj1 : 0|1@1+ (1,0) [0|1] "" Vector__XXX
 SG_ ErrorCodeEnableDisableObj2 : 0|1@1+ (1,0) [0|1] "" Vector__XXX
 SG_ ErrorCodeEnableDisableObj3 : 0|1@1+ (1,0) [0|1] "" Vector__XXX
 SG_ ErrorCodeEnableDisableObj4 : 0|1@1+ (1,0) [0|1] "" Vector__XXX
 SG_ SelectInputObjectID : 0|16@1+ (1,0) [0|65535] "" Vector__XXX
 SG_ ObjectSelectStatus : 0|8@1+ (1,0) [0|2] "" Vector__XXX
 SG_ ErrorCodeSelectObject1 : 0|1@1+ (1,0) [0|1] "" Vector__XXX
 SG_ ErrorCodeSelectObject2 : 0|1@1+ (1,0) [0|1] "" Vector__XXX
 SG_ ErrorCodeSelectObject3 : 0|1@1+ (1,0) [0|1] "" Vector__XXX
 SG_ ErrorCodeSelectObject4 : 0|1@1+ (1,0) [0|1] "" Vector__XXX
 SG_ ErrorCodeSelectObject5 : 0|1@1+ (1,0) [0|1] "" Vector__XXX
 SG_ ErrorCodeControlAudioDevice1 : 0|1@1+ (1,0) [0|1] "" Vector__XXX
 SG_ ErrorCodeControlAudioDevice2 : 0|1@1+ (1,0) [0|1] "" Vector__XXX
 SG_ ErrorCodeAudioVolume1 : 0|1@1+ (1,0) [0|1] "" Vector__XXX
 SG_ ErrorCodeAudioVolume2 : 0|1@1+ (1,0) [0|1] "" Vector__XXX
 SG_ ParentObjectID : 0|16@1+ (1,0) [0|65535] "" Vector__XXX
 SG_ ObjectToMoveID : 0|16@1+ (1,0) [0|65535] "" Vector__XXX
 SG_ ErrorCodeChangeChildLocation1 : 0|1@1+ (1,0) [0|1] "" Vector__XXX
 SG_ ErrorCodeChangeChildLocation2 : 0|1@1+ (1,0) [0|1] "" Vector__XXX
 SG_ ErrorCodeChangeChildLocation5 : 0|1@1+ (1,0) [0|1] "" Vector__XXX
 SG_ ObjectToSizeID : 0|16@1+ (1,0) [0|65535] "" Vector__XXX
 SG_ ErrorCodeObjToSize1 : 0|1@1+ (1,0) [0|1] "" Vector__XXX
 SG_ ErrorCodeObjToSize2 : 0|1@1+ (1,0) [0|1] "" Vector__XXX
 SG_ ErrorCodeObjToSize3 : 0|1@1+ (1,0) [0|1] "" Vector__XXX
 SG_ ErrorCodeObjToSize4 : 0|1@1+ (1,0) [0|1] "" Vector__XXX
 SG_ ObjectToChangeColourID : 0|16@1+ (1,0) [0|65535] "" Vector__XXX
 SG_ NewBackgroundColour : 0|8@1+ (1,0) [0|255] "" Vector__XXX
 SG_ ErrorCodeChangeColour1 : 0|1@1+ (1,0) [0|1] "" Vector__XXX
 SG_ ErrorCodeChangeColour2 : 0|1@1+ (1,0) [0|1] "" Vector__XXX
 SG_ ErrorCodeChangeColour3 : 0|1@1+ (1,0) [0|1] "" Vector__XXX
 SG_ ObjectToChangeNumValueID : 0|16@1+ (1,0) [0|65535] "" Vector__XXX
 SG_ ErrorCodeChangeNumValue1 : 0|1@1+ (1,0) [0|1] "" Vector__XXX
 SG_ ErrorCodeChangeNumValue2 : 0|1@1+ (1,0) [0|1] "" Vector__XXX
 SG_ ErrorCodeChangeNumValue3 : 0|1@1+ (1,0) [0|1] "" Vector__XXX
 SG_ ValueOfTheObject : 0|32@1+ (1,0) [0|2704] "" Vector__XXX
 SG_ ObjectToChangeEndPointID : 0|16@1+ (1,0) [0|65535] "" Vector__XXX
 SG_ ErrorCodeChangeEditPoint1 : 0|1@1+ (1,0) [0|1] "" Vector__XXX
 SG_ ErrorCodeChangeEditPoint2 : 0|1@1+ (1,0) [0|1] "" Vector__XXX
 SG_ ErrorCodeChangeEditPoint3 : 0|1@1+ (1,0) [0|1] "" Vector__XXX
 SG_ ObjectToChangeFontID : 0|16@1+ (1,0) [0|65535] "" Vector__XXX
 SG_ ErrorCodeChangeFont1 : 0|1@1+ (1,0) [0|1] "" Vector__XXX
 SG_ ErrorCodeChangeFont2 : 0|1@1+ (1,0) [0|1] "" Vector__XXX
 SG_ ErrorCodeChangeFont4 : 0|1@1+ (1,0) [0|1] "" Vector__XXX
 SG_ ErrorCodeChangeFont3 : 0|1@1+ (1,0) [0|1] "" Vector__XXX
 SG_ ErrorCodeChangeFont5 : 0|1@1+ (1,0) [0|1] "" Vector__XXX
 SG_ ErrorCodeChangeFont6 : 0|1@1+ (1,0) [0|1] "" Vector__XXX
 SG_ ObjectToChangeLineAttributeID : 0|16@1+ (1,0) [0|65535] "" Vector__XXX
 SG_ ErrorCodeChangeLineAttribute1 : 0|1@1+ (1,0) [0|1] "" Vector__XXX
 SG_ ErrorCodeChangeLineAttribute2 : 0|1@1+ (1,0) [0|1] "" Vector__XXX
 SG_ ErrorCodeChangeLineAttribute3 : 0|1@1+ (1,0) [0|1] "" Vector__XXX
 SG_ ErrorCodeChangeLineAttribute4 : 0|1@1+ (1,0) [0|1] "" Vector__XXX
 SG_ ObjectToChangeFillAttributesID : 0|16@1+ (1,0) [0|65535] "" Vector__XXX
 SG_ ErrorCodeChangeFillAttributes1 : 0|1@1+ (1,0) [0|1] "" Vector__XXX
 SG_ ErrorCodeChangeFillAttributes2 : 0|1@1+ (1,0) [0|1] "" Vector__XXX
 SG_ ErrorCodeChangeFillAttributes3 : 0|1@1+ (1,0) [0|1] "" Vector__XXX
 SG_ ErrorCodeChangeFillAttributes4 : 0|1@1+ (1,0) [0|1] "" Vector__XXX
 SG_ ErrorCodeChangeFillAttributes5 : 0|1@1+ (1,0) [0|1] "" Vector__XXX
 SG_ ActiveMaskObjectID : 0|16@1+ (1,0) [0|0] "" Vector__XXX
 SG_ ErrorCodeChangeActiveMask1 : 0|1@1+ (1,0) [0|1] "" Vector__XXX
 SG_ ErrorCodeChangeActiveMask2 : 0|1@1+ (1,0) [0|1] "" Vector__XXX
 SG_ ErrorCodeChangeActiveMask3 : 0|1@1+ (1,0) [0|1] "" Vector__XXX
 SG_ ErrorCodeChangeActiveMask4 : 0|1@1+ (1,0) [0|1] "" Vector__XXX
 SG_ ErrorCodeChangeActiveMask5 : 0|1@1+ (1,0) [0|1] "" Vector__XXX
 SG_ DataOrAlarmMaskObjectID : 0|16@1+ (1,0) [0|65535] "" Vector__XXX
 SG_ SoftKeyMaskObjectID : 0|16@1+ (1,0) [0|65535] "" Vector__XXX
 SG_ ErrorCodeChangeSoftKeyMask1 : 0|1@1+ (1,0) [0|1] "" Vector__XXX
 SG_ ErrorCodeChangeSoftKeyMask2 : 0|1@1+ (1,0) [0|1] "" Vector__XXX
 SG_ ErrorCodeChangeSoftKeyMask3 : 0|1@1+ (1,0) [0|1] "" Vector__XXX
 SG_ ErrorCodeChangeSoftKeyMask4 : 0|1@1+ (1,0) [0|1] "" Vector__XXX
 SG_ ErrorCodeChangeSoftKeyMask5 : 0|1@1+ (1,0) [0|1] "" Vector__XXX
 SG_ ObjectToChangeAttributeID : 0|16@1+ (1,0) [0|65535] "" Vector__XXX
 SG_ AttributeID : 0|8@1+ (1,0) [0|65535] "" Vector__XXX
 SG_ ErrorCodeChangeAttribute1 : 0|1@1+ (1,0) [0|1] "" Vector__XXX
 SG_ ErrorCodeChangeAttribute2 : 0|1@1+ (1,0) [0|1] "" Vector__XXX
 SG_ ErrorCodeChangeAttribute3 : 0|1@1+ (1,0) [0|1] "" Vector__XXX
 SG_ ErrorCodeChangeAttribute4 : 0|1@1+ (1,0) [0|1] "" Vector__XXX
 SG_ AlarmMaskObjectID : 0|16@1+ (1,0) [0|65535] "" Vector__XXX
 SG_ NewPriority : 0|8@1+ (1,0) [0|255] "" Vector__XXX
 SG_ ErrorCodeChangePriority1 : 0|1@1+ (1,0) [0|1] "" Vector__XXX
 SG_ ErrorCodeChangePriority2 : 0|1@1+ (1,0) [0|1] "" Vector__XXX
 SG_ ErrorCodeChangePriority3 : 0|1@1+ (1,0) [0|1] "" Vector__XXX
 SG_ ListInputObjectID : 0|16@1+ (1,0) [0|65535] "" Vector__XXX
 SG_ ListIndex : 0|8@1+ (1,0) [0|255] "" Vector__XXX
 SG_ NewObjectID : 0|16@1+ (1,0) [0|65535] "" Vector__XXX
 SG_ ErrorCodeChangeListItem1 : 0|1@1+ (1,0) [0|1] "" Vector__XXX
 SG_ ErrorCodeChangeListItem2 : 0|1@1+ (1,0) [0|1] "" Vector__XXX
 SG_ ErrorCodeChangeListItem3 : 0|1@1+ (1,0) [0|1] "" Vector__XXX
 SG_ ErrorCodeChangeListItem4 : 0|1@1+ (1,0) [0|1] "" Vector__XXX
 SG_ ErrorCodeDeleteObjectPool1 : 0|1@1+ (1,0) [0|1] "" Vector__XXX
 SG_ ErrorCodeDeleteObjectPool2 : 0|1@1+ (1,0) [0|1] "" Vector__XXX
 SG_ ParentObjectID : 0|16@1+ (1,0) [0|65535] "" Vector__XXX
 SG_ ObjectToChangeStringValueID : 0|16@1+ (1,0) [0|65535] "" Vector__XXX
 SG_ ErrorCodeChangeStrObjectID : 0|1@1+ (1,0) [0|1] "" Vector__XXX
 SG_ ErrorCodeChangeStrTooLong : 0|1@1+ (1,0) [0|1] "" Vector__XXX
 SG_ ErrorCodeChangeStrError : 0|1@1+ (1,0) [0|1] "" Vector__XXX
 SG_ ParentObjectID : 0|16@1+ (1,0) [0|65535] "" Vector__XXX
 SG_ ObjectToMoveID : 0|16@1+ (1,0) [0|65535] "" Vector__XXX
 SG_ ErrorCodeChangePosInvalidParent : 0|1@1+ (1,0) [0|1] "" Vector__XXX
 SG_ ErrorCodeChangePosInvalidObject : 0|1@1+ (1,0) [0|1] "" Vector__XXX
 SG_ ErrorCodeChangePosInvalidError : 0|1@1+ (1,0) [0|1] "" Vector__XXX
 SG_ ErrorCodeSetObjectLabel1 : 0|1@1+ (1,0) [0|1] "" Vector__XXX
 SG_ ErrorCodeSetObjectLabel2 : 0|1@1+ (1,0) [0|1] "" Vector__XXX
 SG_ ErrorCodeSetObjectLabel3 : 0|1@1+ (1,0) [0|1] "" Vector__XXX
 SG_ ErrorCodeSetObjectLabel4 : 0|1@1+ (1,0) [0|1] "" Vector__XXX
 SG_ ErrorCodeSetObjectLabel5 : 0|1@1+ (1,0) [0|1] "" Vector__XXX
 SG_ ErrorCodeSetObjectLabel6 : 0|1@1+ (1,0) [0|1] "" Vector__XXX
 SG_ PolygonObjectToChangeID : 0|16@1+ (1,0) [0|65535] "" Vector__XXX
 SG_ ErrorCodeChangePoygonPoint1 : 0|1@1+ (1,0) [0|1] "" Vector__XXX
 SG_ ErrorCodeChangePoygonPoint2 : 0|1@1+ (1,0) [0|1] "" Vector__XXX
 SG_ ErrorCodeChangePoygonPoint3 : 0|1@1+ (1,0) [0|1] "" Vector__XXX
 SG_ PolygonObjectToScaleID : 0|16@1+ (1,0) [0|65535] "" Vector__XXX
 SG_ NewWidthAttribute : 0|16@1+ (1,0) [0|65535] "" Vector__XXX
 SG_ NewHeigthAttribute : 0|16@1+ (1,0) [0|0] "" Vector__XXX
 SG_ ErrorCodeChangePolygonScale1 : 0|1@1+ (1,0) [0|1] "" Vector__XXX
 SG_ ErrorCodeChangePolygonScale5 : 0|1@1+ (1,0) [0|1] "" Vector__XXX
 SG_ GraphicsContextObjectID : 0|16@1+ (1,0) [0|65535] "" Vector__XXX
 SG_ SubCommandID : 0|8@1+ (1,0) [0|0] "" Vector__XXX
 SG_ ErrorCodeGraphicsContextCmd1 : 0|1@1+ (1,0) [0|1] "" Vector__XXX
 SG_ ErrorCodeGraphicsContextCmd2 : 0|1@1+ (1,0) [0|1] "" Vector__XXX
 SG_ ErrorCodeGraphicsContextCmd3 : 0|1@1+ (1,0) [0|1] "" Vector__XXX
 SG_ ErrorCodeGraphicsContextCmd4 : 0|1@1+ (1,0) [0|1] "" Vector__XXX
 SG_ ErrorCodeGraphicsContextCmd5 : 0|1@1+ (1,0) [0|1] "" Vector__XXX
 SG_ ObjectToGetAttributeID_Resp : 0|16@1+ (1,0) [0|65535] "" Vector__XXX
 SG_ AttributeID : 0|8@1+ (1,0) [0|0] "" Vector__XXX
 SG_ ColourMapObjectID : 0|16@1+ (1,0) [0|65535] "" Vector__XXX
 SG_ ErrorCodeSelectColourMap2 : 0|1@1+ (1,0) [0|1] "" Vector__XXX
 SG_ ErrorCodeSelectColourMap1 : 0|1@1+ (1,0) [0|1] "" Vector__XXX
 SG_ ErrorCodeLockUnlockMask9 : 0|1@1+ (1,0) [0|1] "" Vector__XXX
 SG_ ErrorCodeLockUnlockMask8 : 0|1@1+ (1,0) [0|1] "" Vector__XXX
 SG_ ErrorCodeLockUnlockMask7 : 0|1@1+ (1,0) [0|1] "" Vector__XXX
 SG_ ErrorCodeLockUnlockMask6 : 0|1@1+ (1,0) [0|1] "" Vector__XXX
 SG_ ErrorCodeLockUnlockMask5 : 0|1@1+ (1,0) [0|1] "" Vector__XXX
 SG_ ErrorCodeLockUnlockMask4 : 0|1@1+ (1,0) [0|1] "" Vector__XXX
 SG_ ErrorCodeLockUnlockMask3 : 0|1@1+ (1,0) [0|1] "" Vector__XXX
 SG_ ErrorCodeLockUnlockMask2 : 0|1@1+ (1,0) [0|1] "" Vector__XXX
 SG_ ErrorCodeLockUnlockMask1 : 0|1@1+ (1,0) [0|1] "" Vector__XXX
 SG_ LockUnlockCommand : 0|8@1+ (1,0) [0|1] "" Vector__XXX
 SG_ MacroObjecID : 0|8@1+ (1,0) [0|255] "" Vector__XXX
 SG_ ErrorCodeExecuteMacro1 : 0|1@1+ (1,0) [0|1] "" Vector__XXX
 SG_ ErrorCodeExecuteMacro2 : 0|1@1+ (1,0) [0|1] "" Vector__XXX
 SG_ ErrorCodeExecuteMacro3 : 0|1@1+ (1,0) [0|1] "" Vector__XXX
 SG_ VersionNumberISO11783Part6 : 0|8@1+ (1,0) [0|255] "" Vector__XXX
 SG_ MemoryStatus : 0|8@1+ (1,0) [0|1] "" Vector__XXX
 SG_ FirstWideChar : 0|16@1+ (1,0) [0|65535] "" Vector__XXX
 SG_ LastWideChar : 0|16@1+ (1,0) [0|65535] "" Vector__XXX
 SG_ ErrorCodeGetSupportedWideChars2 : 0|1@1+ (1,0) [0|1] "" Vector__XXX
 SG_ ErrorCodeGetSupportedWideChars1 : 0|1@1+ (1,0) [0|1] "" Vector__XXX
 SG_ CodePlane : 0|8@1+ (1,0) [0|16] "" Vector__XXX
 SG_ NumberOfRanges : 0|8@1+ (1,0) [0|255] "" Vector__XXX
 SG_ NavigationSoftKeys : 0|8@1+ (1,0) [0|254] "" Vector__XXX
 SG_ XDotsForSoftKeyDescriptor : 0|8@1+ (1,0) [0|255] "" Vector__XXX
 SG_ YDotsForSoftKeyDescriptor : 0|8@1+ (1,0) [0|255] "" Vector__XXX
 SG_ NumberOfPossibleVirtualSoftKeys : 0|8@1+ (1,0) [0|255] "" Vector__XXX
 SG_ NumberOfPhysicalSoftKeys : 0|8@1+ (1,0) [0|255] "" Vector__XXX
 SG_ FontSize_8x8 : 0|1@1+ (1,0) [0|1] "" Vector__XXX
 SG_ FontSize_8x12 : 0|1@1+ (1,0) [0|1] "" Vector__XXX
 SG_ FontSize_12x16 : 0|1@1+ (1,0) [0|1] "" Vector__XXX
 SG_ FontSize_16x16 : 0|1@1+ (1,0) [0|1] "" Vector__XXX
 SG_ FontSize_16x24 : 0|1@1+ (1,0) [0|1] "" Vector__XXX
 SG_ FontSize_24x32 : 0|1@1+ (1,0) [0|1] "" Vector__XXX
 SG_ FontSize_32x32 : 0|1@1+ (1,0) [0|1] "" Vector__XXX
 SG_ FontSize_32x48 : 0|1@1+ (1,0) [0|1] "" Vector__XXX
 SG_ FontSize_48x64 : 0|1@1+ (1,0) [0|1] "" Vector__XXX
 SG_ FontSize_64x64 : 0|1@1+ (1,0) [0|1] "" Vector__XXX
 SG_ FontSize_64x96 : 0|1@1+ (1,0) [0|1] "" Vector__XXX
 SG_ FontSize_96x128 : 0|1@1+ (1,0) [0|1] "" Vector__XXX
 SG_ FontSize_128x128 : 0|1@1+ (1,0) [0|1] "" Vector__XXX
 SG_ FontSize_128x192 : 0|1@1+ (1,0) [0|1] "" Vector__XXX
 SG_ FontType_BoldText : 0|1@1+ (1,0) [0|1] "" Vector__XXX
 SG_ FontType_CrossedOutText : 0|1@1+ (1,0) [0|1] "" Vector__XXX
 SG_ FontType_UnderlinedText : 0|1@1+ (1,0) [0|1] "" Vector__XXX
 SG_ FontType_ItalicsText : 0|1@1+ (1,0) [0|1] "" Vector__XXX
 SG_ FontType_InvertedText : 0|1@1+ (1,0) [0|1] "" Vector__XXX
 SG_ FontType_FlashInverted : 0|1@1+ (1,0) [0|1] "" Vector__XXX
 SG_ FontType_FlashHidden : 0|1@1+ (1,0) [0|1] "" Vector__XXX
 SG_ FontType_ProportionalFont : 0|1@1+ (1,0) [0|1] "" Vector__XXX
 SG_ MaxLineWidth : 0|8@1+ (1,0) [0|255] "" Vector__XXX
 SG_ LineArts : 0|8@1+ (1,0) [0|1] "" Vector__XXX
 SG_ FillTypes : 0|8@1+ (1,0) [0|1] "" Vector__XXX
 SG_ ShapeFillTypes : 0|8@1+ (1,0) [0|3] "" Vector__XXX
 SG_ SupportedGrapicMode : 0|8@1+ (1,0) [0|2] "" Vector__XXX
 SG_ Hardware1 : 0|1@1+ (1,0) [0|1] "" Vector__XXX
 SG_ Hardware2 : 0|1@1+ (1,0) [0|1] "" Vector__XXX
 SG_ Hardware3 : 0|1@1+ (1,0) [0|1] "" Vector__XXX
 SG_ Hardware4 : 0|1@1+ (1,0) [0|1] "" Vector__XXX
 SG_ Hardware5 : 0|1@1+ (1,0) [0|1] "" Vector__XXX
 SG_ Hardware6 : 0|1@1+ (1,0) [0|1] "" Vector__XXX
 SG_ NrOfXPixelsInDataAreaMask : 0|16@1+ (1,0) [0|65535] "" Vector__XXX
 SG_ NrOfYPixelsInDataAreaMask : 0|16@1+ (1,0) [0|65535] "" Vector__XXX
 SG_ AcknowledgmentStoreVersion : 0|4@1+ (1,0) [0|8] "" Vector__XXX
 SG_ AcknowledgmentLoadVersion : 0|4@1+ (1,0) [0|8] "" Vector__XXX
 SG_ AcknowledgmentDeleteVersion : 0|4@1+ (1,0) [0|8] "" Vector__XXX
 SG_ NrOfVersionStrings : 0|8@1+ (1,0) [0|255] "" Vector__XXX
 SG_ VersionLables : 0|56@1+ (1,0) [0|0] "" Vector__XXX
 SG_ ParentObjectID : 0|16@1+ (1,0) [0|65535] "" Vector__XXX
 SG_ ObjectIDOfFaultyObject : 0|16@1+ (1,0) [0|65535] "" Vector__XXX
 SG_ ErrorCodeVtObjPoolError1 : 0|1@1+ (1,0) [0|1] "" Vector__XXX
 SG_ ErrorCodeVtObjPoolError2 : 0|1@1+ (1,0) [0|1] "" Vector__XXX
 SG_ ErrorCodeVtObjPoolError3 : 0|1@1+ (1,0) [0|1] "" Vector__XXX
 SG_ ErrorCodeVtObjPoolError4 : 0|1@1+ (1,0) [0|1] "" Vector__XXX
 SG_ SourceAdressOfActiveWSM : 0|8@1+ (1,0) [0|255] "" Vector__XXX
 SG_ VisibleDataOrAlarmMaskObjectID : 0|16@1+ (1,0) [0|65535] "" Vector__XXX
 SG_ VisibleSoftKeyMaskObjectID : 0|16@1+ (1,0) [0|65535] "" Vector__XXX
 SG_ VTBusyCode1 : 0|1@1+ (1,0) [0|1] "" Vector__XXX
 SG_ VTBusyCode2 : 0|1@1+ (1,0) [0|1] "" Vector__XXX
 SG_ VTBusyCode3 : 0|1@1+ (1,0) [0|1] "" Vector__XXX
 SG_ VTBusyCode4 : 0|1@1+ (1,0) [0|1] "" Vector__XXX
 SG_ VTBusyCode5 : 0|1@1+ (1,0) [0|1] "" Vector__XXX
 SG_ VTBusyCode8 : 0|1@1+ (1,0) [0|1] "" Vector__XXX
 SG_ VTFunctionCode : 0|8@1+ (1,0) [0|255] "" Vector__XXX
 SG_ VTFunctionVTtoECU : 0|8@1+ (1,0) [0|255] "" Vector__XXX
 SG_ KeyActivationCode : 0|8@1+ (1,0) [0|2] "" Vector__XXX
 SG_ KeyObjectID : 0|16@1+ (1,0) [0|65535] "" Vector__XXX
 SG_ KeyObjectParentID : 0|16@1+ (1,0) [0|65535] "" Vector__XXX
 SG_ SoftKeyCode : 0|8@1+ (1,0) [0|255] "" Vector__XXX
 SG_ ButtonActivationCode : 0|8@1+ (1,0) [0|2] "" Vector__XXX
 SG_ ButtonObjectID : 0|16@1+ (1,0) [0|65535] "" Vector__XXX
 SG_ ButtonObjectParentID : 0|16@1+ (1,0) [0|65535] "" Vector__XXX
 SG_ ButtonKeyCode : 0|8@1+ (1,0) [0|255] "" Vector__XXX
 SG_ XPosition : 0|16@1+ (1,0) [0|65535] "" Vector__XXX
 SG_ YPosition : 0|16@1+ (1,0) [0|65535] "" Vector__XXX
 SG_ TouchState : 0|8@1+ (1,0) [0|255] "" Vector__XXX
 SG_ VTSelectInputObjectID : 0|16@1+ (1,0) [0|65535] "" Vector__XXX
 SG_ VTSelectInputObjectStatus : 0|8@1+ (1,0) [0|1] "" Vector__XXX
 SG_ VTSelectInputObjectIsEdited : 0|1@1+ (1,0) [0|1] "" Vector__XXX
 SG_ VTEscObjectID : 0|16@1+ (1,0) [0|65535] "" Vector__XXX
 SG_ ErrorCodeVTEsc1 : 0|1@1+ (1,0) [0|1] "" Vector__XXX
 SG_ ErrorCodeVTEsc2 : 0|1@1+ (1,0) [0|1] "" Vector__XXX
 SG_ VTChangeNumericValueObjectID : 0|16@1+ (1,0) [0|65535] "" Vector__XXX
 SG_ VTChangeNumericValueValue : 0|32@1+ (1,0) [0|4294967295] "" Vector__XXX
 SG_ VTChangeActiveMaskObjectID : 0|16@1+ (1,0) [0|65535] "" Vector__XXX
 SG_ ErrorCodeMissingObjects : 0|1@1+ (1,0) [0|1] "" Vector__XXX
 SG_ ErrorCodeMaskOrChildObjectError : 0|1@1+ (1,0) [0|1] "" Vector__XXX
 SG_ ErrorCodeAnyOtherError : 0|1@1+ (1,0) [0|1] "" Vector__XXX
 SG_ ErrorCodePoolDeleted : 0|1@1+ (1,0) [0|1] "" Vector__XXX
 SG_ VTChangeActiveMaskErrorID : 0|16@1+ (1,0) [0|65535] "" Vector__XXX
 SG_ VTChangeActiveMaskParentID : 0|16@1+ (1,0) [0|65535] "" Vector__XXX
 SG_ VTChangeSoftKeyMaskParentID : 0|16@1+ (1,0) [0|65535] "" Vector__XXX
 SG_ VTChangeSoftKeyMaskObjectID : 0|16@1+ (1,0) [0|65535] "" Vector__XXX
 SG_ ErrorCodeVTChangeSoftKeyMask1 : 0|1@1+ (1,0) [0|1] "" Vector__XXX
 SG_ ErrorCodeVTChangeSoftKeyMask2 : 0|1@1+ (1,0) [0|1] "" Vector__XXX
 SG_ ErrorCodeVTChangeSoftKeyMask3 : 0|1@1+ (1,0) [0|1] "" Vector__XXX
 SG_ ErrorCodeVTChangeSoftKeyMask4 : 0|1@1+ (1,0) [0|1] "" Vector__XXX
 SG_ ErrorCodeVTChangeSoftKeyMask5 : 0|1@1+ (1,0) [0|1] "" Vector__XXX
 SG_ ObjectToChangeStringID : 0|16@1+ (1,0) [0|65535] "" Vector__XXX
 SG_ EnteredStringValue : 0|8@1+ (1,0) [0|255] "" Vector__XXX
 SG_ DisplayActivationStatus1 : 0|1@1+ (1,0) [0|1] "" Vector__XXX
 SG_ VisibleDataAlarmMaskID : 0|16@1+ (1,0) [0|65535] "" Vector__XXX
 SG_ VisibleSoftKeyMaskID : 0|16@1+ (1,0) [0|65535] "" Vector__XXX
 SG_ ErrorCodeEndOfObjectPool1 : 0|1@1+ (1,0) [0|1] "" Vector__XXX
 SG_ ErrorCodeEndOfObjectPool2 : 0|1@1+ (1,0) [0|1] "" Vector__XXX
 SG_ ErrorCodeEndOfObjectPool3 : 0|1@1+ (1,0) [0|1] "" Vector__XXX
 SG_ ParentObjectIdOfFaultyObject : 0|16@1+ (1,0) [0|65535] "" Vector__XXX
 SG_ ObjectIdOfFaultyObject : 0|16@1+ (1,0) [0|65535] "" Vector__XXX
 SG_ ErrorCodeObjectPool1 : 0|1@1+ (1,0) [0|1] "" Vector__XXX
 SG_ ErrorCodeObjectPool2 : 0|1@1+ (1,0) [0|1] "" Vector__XXX
 SG_ ErrorCodeObjectPool3 : 0|1@1+ (1,0) [0|1] "" Vector__XXX
 SG_ ErrorCodeObjectPool4 : 0|1@1+ (1,0) [0|1] "" Vector__XXX
 SG_ IdentityNumber : 0|21@1+ (1,0) [0|2097150] "" Vector__XXX
 SG_ ManufacturerCode : 0|11@1+ (1,0) [0|2047] "" Vector__XXX
 SG_ ECUInstance : 0|3@1+ (1,0) [0|7] "" Vector__XXX
 SG_ FunctionInstance : 0|5@1+ (1,0) [0|31] "" Vector__XXX
 SG_ AuxiliaryInputObjectID : 0|16@1+ (1,0) [0|65535] "" Vector__XXX
 SG_ InputObjectId : 0|16@1+ (1,0) [0|255] "" Vector__XXX
 SG_ Value1 : 0|16@1+ (1,0) [0|65535] "" Vector__XXX
 SG_ Function : 0|8@1+ (1,0) [0|255] "" Vector__XXX
 SG_ DeviceClass : 0|7@1+ (1,0) [0|127] "" Vector__XXX
 SG_ IndustryGroup : 0|3@1+ (1,0) [0|7] "" Vector__XXX
 SG_ DeviceClassInstance : 0|4@1+ (1,0) [0|15] "" Vector__XXX
 SG_ SelfConfigurableAddress : 0|1@1+ (1,0) [0|1] "" Vector__XXX
 SG_ AuxiliaryFunctionType : 0|4@1+ (1,0) [0|15] "" Vector__XXX
 SG_ AuxiliaryFunctionObjectID : 0|16@1+ (1,0) [0|65535] "" Vector__XXX
 SG_ Value2 : 0|16@1+ (1,0) [0|65535] "" Vector__XXX
 SG_ AuxPreferredAssignmentRespError1 : 0|1@1+ (1,0) [0|1] "" Vector__XXX
 SG_ AuxPreferredAssignmentRespError2 : 0|1@1+ (1,0) [0|1] "" Vector__XXX
 SG_ AuxPreferredAssignmentRespError3 : 0|1@1+ (1,0) [0|1] "" Vector__XXX
 SG_ AuxPreferredAssignmentRespError4 : 0|1@1+ (1,0) [0|1] "" Vector__XXX
 SG_ InputStatusObjectId : 0|16@1+ (1,0) [0|255] "" Vector__XXX
 SG_ AuxInputEnable : 0|8@1+ (1,0) [0|1] "" Vector__XXX
 SG_ ObjectEscapeID : 0|16@1+ (1,0) [0|65535] "" Vector__XXX
 SG_ ErrorCodeEscapeObj1 : 0|1@1+ (1,0) [0|1] "" Vector__XXX
 SG_ ErrorCodeEscapeObj2 : 0|1@1+ (1,0) [0|1] "" Vector__XXX
 SG_ ObjectToHideShowID : 0|16@1+ (1,0) [0|65535] "" Vector__XXX
 SG_ ObjectShowStatus : 0|8@1+ (1,0) [0|1] "" Vector__XXX
 SG_ ErrorCodeHideShowObj1 : 0|1@1+ (1,0) [0|1] "" Vector__XXX
 SG_ ErrorCodeHideShowObj2 : 0|1@1+ (1,0) [0|1] "" Vector__XXX
 SG_ ErrorCodeHideShowObj3 : 0|1@1+ (1,0) [0|1] "" Vector__XXX
 SG_ ObjectToEnableDisableID : 0|16@1+ (1,0) [0|65535] "" Vector__XXX
 SG_ ObjectEnableStatus : 0|8@1+ (1,0) [0|1] "" Vector__XXX
 SG_ ErrorCodeEnableDisableObj1 : 0|1@1+ (1,0) [0|1] "" Vector__XXX
 SG_ ErrorCodeEnableDisableObj2 : 0|1@1+ (1,0) [0|1] "" Vector__XXX
 SG_ ErrorCodeEnableDisableObj3 : 0|1@1+ (1,0) [0|1] "" Vector__XXX
 SG_ ErrorCodeEnableDisableObj4 : 0|1@1+ (1,0) [0|1] "" Vector__XXX
 SG_ SelectInputObjectID : 0|16@1+ (1,0) [0|65535] "" Vector__XXX
 SG_ ObjectSelectStatus : 0|8@1+ (1,0) [0|2] "" Vector__XXX
 SG_ ErrorCodeSelectObject1 : 0|1@1+ (1,0) [0|1] "" Vector__XXX
 SG_ ErrorCodeSelectObject2 : 0|1@1+ (1,0) [0|1] "" Vector__XXX
 SG_ ErrorCodeSelectObject3 : 0|1@1+ (1,0) [0|1] "" Vector__XXX
 SG_ ErrorCodeSelectObject4 : 0|1@1+ (1,0) [0|1] "" Vector__XXX
 SG_ ErrorCodeSelectObject5 : 0|1@1+ (1,0) [0|1] "" Vector__XXX
 SG_ ErrorCodeControlAudioDevice1 : 0|1@1+ (1,0) [0|1] "" Vector__XXX
 SG_ ErrorCodeControlAudioDevice2 : 0|1@1+ (1,0) [0|1] "" Vector__XXX
 SG_ ErrorCodeAudioVolume1 : 0|1@1+ (1,0) [0|1] "" Vector__XXX
 SG_ ErrorCodeAudioVolume2 : 0|1@1+ (1,0) [0|1] "" Vector__XXX
 SG_ ParentObjectID_Location : 0|16@1+ (1,0) [0|65535] "" Vector__XXX
 SG_ ObjectToMoveID_Location : 0|16@1+ (1,0) [0|65535] "" Vector__XXX
 SG_ ErrorCodeChangeChildLocation1 : 0|1@1+ (1,0) [0|1] "" Vector__XXX
 SG_ ErrorCodeChangeChildLocation2 : 0|1@1+ (1,0) [0|1] "" Vector__XXX
 SG_ ErrorCodeChangeChildLocation5 : 0|1@1+ (1,0) [0|1] "" Vector__XXX
 SG_ ObjectToSizeID : 0|16@1+ (1,0) [0|65535] "" Vector__XXX
 SG_ ErrorCodeObjToSize1 : 0|1@1+ (1,0) [0|1] "" Vector__XXX
 SG_ ErrorCodeObjToSize2 : 0|1@1+ (1,0) [0|1] "" Vector__XXX
 SG_ ErrorCodeObjToSize3 : 0|1@1+ (1,0) [0|1] "" Vector__XXX
 SG_ ErrorCodeObjToSize4 : 0|1@1+ (1,0) [0|1] "" Vector__XXX
 SG_ ObjectToChangeColourID : 0|16@1+ (1,0) [0|65535] "" Vector__XXX
 SG_ NewBackgroundColour : 0|8@1+ (1,0) [0|255] "" Vector__XXX
 SG_ ErrorCodeChangeColour1 : 0|1@1+ (1,0) [0|1] "" Vector__XXX
 SG_ ErrorCodeChangeColour2 : 0|1@1+ (1,0) [0|1] "" Vector__XXX
 SG_ ErrorCodeChangeColour3 : 0|1@1+ (1,0) [0|1] "" Vector__XXX
 SG_ ObjectToChangeNumValueID : 0|16@1+ (1,0) [0|65535] "" Vector__XXX
 SG_ ErrorCodeChangeNumValue1 : 0|1@1+ (1,0) [0|1] "" Vector__XXX
 SG_ ErrorCodeChangeNumValue2 : 0|1@1+ (1,0) [0|1] "" Vector__XXX
 SG_ ErrorCodeChangeNumValue3 : 0|1@1+ (1,0) [0|1] "" Vector__XXX
 SG_ ValueOfTheObject : 0|32@1+ (1,0) [0|2704] "" Vector__XXX
 SG_ ObjectToChangeEndPointID : 0|16@1+ (1,0) [0|65535] "" Vector__XXX
 SG_ ErrorCodeChangeEditPoint1 : 0|1@1+ (1,0) [0|1] "" Vector__XXX
 SG_ ErrorCodeChangeEditPoint2 : 0|1@1+ (1,0) [0|1] "" Vector__XXX
 SG_ ErrorCodeChangeEditPoint3 : 0|1@1+ (1,0) [0|1] "" Vector__XXX
 SG_ ObjectToChangeFontID : 0|16@1+ (1,0) [0|65535] "" Vector__XXX
 SG_ ErrorCodeChangeFont1 : 0|1@1+ (1,0) [0|1] "" Vector__XXX
 SG_ ErrorCodeChangeFont2 : 0|1@1+ (1,0) [0|1] "" Vector__XXX
 SG_ ErrorCodeChangeFont4 : 0|1@1+ (1,0) [0|1] "" Vector__XXX
 SG_ ErrorCodeChangeFont3 : 0|1@1+ (1,0) [0|1] "" Vector__XXX
 SG_ ErrorCodeChangeFont5 : 0|1@1+ (1,0) [0|1] "" Vector__XXX
 SG_ ErrorCodeChangeFont6 : 0|1@1+ (1,0) [0|1] "" Vector__XXX
 SG_ ObjectToChangeLineAttributeID : 0|16@1+ (1,0) [0|65535] "" Vector__XXX
 SG_ ErrorCodeChangeLineAttribute1 : 0|1@1+ (1,0) [0|1] "" Vector__XXX
 SG_ ErrorCodeChangeLineAttribute2 : 0|1@1+ (1,0) [0|1] "" Vector__XXX
 SG_ ErrorCodeChangeLineAttribute3 : 0|1@1+ (1,0) [0|1] "" Vector__XXX
 SG_ ErrorCodeChangeLineAttribute4 : 0|1@1+ (1,0) [0|1] "" Vector__XXX
 SG_ ObjectToChangeFillAttributesID : 0|16@1+ (1,0) [0|65535] "" Vector__XXX
 SG_ ErrorCodeChangeFillAttributes1 : 0|1@1+ (1,0) [0|1] "" Vector__XXX
 SG_ ErrorCodeChangeFillAttributes2 : 0|1@1+ (1,0) [0|1] "" Vector__XXX
 SG_ ErrorCodeChangeFillAttributes3 : 0|1@1+ (1,0) [0|1] "" Vector__XXX
 SG_ ErrorCodeChangeFillAttributes4 : 0|1@1+ (1,0) [0|1] "" Vector__XXX
 SG_ ErrorCodeChangeFillAttributes5 : 0|1@1+ (1,0) [0|1] "" Vector__XXX
 SG_ ActiveMaskObjectID : 0|16@1+ (1,0) [0|0] "" Vector__XXX
 SG_ ErrorCodeChangeActiveMask1 : 0|1@1+ (1,0) [0|1] "" Vector__XXX
 SG_ ErrorCodeChangeActiveMask2 : 0|1@1+ (1,0) [0|1] "" Vector__XXX
 SG_ ErrorCodeChangeActiveMask3 : 0|1@1+ (1,0) [0|1] "" Vector__XXX
 SG_ ErrorCodeChangeActiveMask4 : 0|1@1+ (1,0) [0|1] "" Vector__XXX
 SG_ ErrorCodeChangeActiveMask5 : 0|1@1+ (1,0) [0|1] "" Vector__XXX
 SG_ DataOrAlarmMaskObjectID : 0|16@1+ (1,0) [0|65535] "" Vector__XXX
 SG_ SoftKeyMaskObjectID : 0|16@1+ (1,0) [0|65535] "" Vector__XXX
 SG_ ErrorCodeChangeSoftKeyMask1 : 0|1@1+ (1,0) [0|1] "" Vector__XXX
 SG_ ErrorCodeChangeSoftKeyMask2 : 0|1@1+ (1,0) [0|1] "" Vector__XXX
 SG_ ErrorCodeChangeSoftKeyMask3 : 0|1@1+ (1,0) [0|1] "" Vector__XXX
 SG_ ErrorCodeChangeSoftKeyMask4 : 0|1@1+ (1,0) [0|1] "" Vector__XXX
 SG_ ErrorCodeChangeSoftKeyMask5 : 0|1@1+ (1,0) [0|1] "" Vector__XXX
 SG_ ObjectToChangeAttributeID : 0|16@1+ (1,0) [0|65535] "" Vector__XXX
 SG_ AttributeID_Change : 0|8@1+ (1,0) [0|65535] "" Vector__XXX
 SG_ ErrorCodeChangeAttribute1 : 0|1@1+ (1,0) [0|1] "" Vector__XXX
 SG_ ErrorCodeChangeAttribute2 : 0|1@1+ (1,0) [0|1] "" Vector__XXX
 SG_ ErrorCodeChangeAttribute3 : 0|1@1+ (1,0) [0|1] "" Vector__XXX
 SG_ ErrorCodeChangeAttribute4 : 0|1@1+ (1,0) [0|1] "" Vector__XXX
 SG_ AlarmMaskObjectID : 0|16@1+ (1,0) [0|65535] "" Vector__XXX
 SG_ NewPriority : 0|8@1+ (1,0) [0|255] "" Vector__XXX
 SG_ ErrorCodeChangePriority1 : 0|1@1+ (1,0) [0|1] "" Vector__XXX
 SG_ ErrorCodeChangePriority2 : 0|1@1+ (1,0) [0|1] "" Vector__XXX
 SG_ ErrorCodeChangePriority3 : 0|1@1+ (1,0) [0|1] "" Vector__XXX
 SG_ ListInputObjectID : 0|16@1+ (1,0) [0|65535] "" Vector__XXX
 SG_ ListIndex : 0|8@1+ (1,0) [0|255] "" Vector__XXX
 SG_ NewObjectID : 0|16@1+ (1,0) [0|65535] "" Vector__XXX
 SG_ ErrorCodeChangeListItem1 : 0|1@1+ (1,0) [0|1] "" Vector__XXX
 SG_ ErrorCodeChangeListItem2 : 0|1@1+ (1,0) [0|1] "" Vector__XXX
 SG_ ErrorCodeChangeListItem3 : 0|1@1+ (1,0) [0|1] "" Vector__XXX
 SG_ ErrorCodeChangeListItem4 : 0|1@1+ (1,0) [0|1] "" Vector__XXX
 SG_ ErrorCodeDeleteObjectPool1 : 0|1@1+ (1,0) [0|1] "" Vector__XXX
 SG_ ErrorCodeDeleteObjectPool2 : 0|1@1+ (1,0) [0|1] "" Vector__XXX
 SG_ ParentObjectID_StringVal : 0|16@1+ (1,0) [0|65535] "" Vector__XXX
 SG_ ObjectToChangeStringValueID : 0|16@1+ (1,0) [0|65535] "" Vector__XXX
 SG_ ErrorCodeChangeStrObjectID : 0|1@1+ (1,0) [0|1] "" Vector__XXX
 SG_ ErrorCodeChangeStrTooLong : 0|1@1+ (1,0) [0|1] "" Vector__XXX
 SG_ ErrorCodeChangeStrError : 0|1@1+ (1,0) [0|1] "" Vector__XXX
 SG_ ParentObjectID_Position : 0|16@1+ (1,0) [0|65535] "" Vector__XXX
 SG_ ObjectToMoveID_Position : 0|16@1+ (1,0) [0|65535] "" Vector__XXX
 SG_ ErrorCodeChangePosInvalidParent : 0|1@1+ (1,0) [0|1] "" Vector__XXX
 SG_ ErrorCodeChangePosInvalidObject : 0|1@1+ (1,0) [0|1] "" Vector__XXX
 SG_ ErrorCodeChangePosInvalidError : 0|1@1+ (1,0) [0|1] "" Vector__XXX
 SG_ ErrorCodeSetObjectLabel1 : 0|1@1+ (1,0) [0|1] "" Vector__XXX
 SG_ ErrorCodeSetObjectLabel2 : 0|1@1+ (1,0) [0|1] "" Vector__XXX
 SG_ ErrorCodeSetObjectLabel3 : 0|1@1+ (1,0) [0|1] "" Vector__XXX
 SG_ ErrorCodeSetObjectLabel4 : 0|1@1+ (1,0) [0|1] "" Vector__XXX
 SG_ ErrorCodeSetObjectLabel5 : 0|1@1+ (1,0) [0|1] "" Vector__XXX
 SG_ ErrorCodeSetObjectLabel6 : 0|1@1+ (1,0) [0|1] "" Vector__XXX
 SG_ PolygonObjectToChangeID : 0|16@1+ (1,0) [0|65535] "" Vector__XXX
 SG_ ErrorCodeChangePoygonPoint1 : 0|1@1+ (1,0) [0|1] "" Vector__XXX
 SG_ ErrorCodeChangePoygonPoint2 : 0|1@1+ (1,0) [0|1] "" Vector__XXX
 SG_ ErrorCodeChangePoygonPoint3 : 0|1@1+ (1,0) [0|1] "" Vector__XXX
 SG_ PolygonObjectToScaleID : 0|16@1+ (1,0) [0|65535] "" Vector__XXX
 SG_ NewWidthAttribute : 0|16@1+ (1,0) [0|65535] "" Vector__XXX
 SG_ NewHeigthAttribute : 0|16@1+ (1,0) [0|0] "" Vector__XXX
 SG_ ErrorCodeChangePolygonScale1 : 0|1@1+ (1,0) [0|1] "" Vector__XXX
 SG_ ErrorCodeChangePolygonScale5 : 0|1@1+ (1,0) [0|1] "" Vector__XXX
 SG_ GraphicsContextObjectID : 0|16@1+ (1,0) [0|65535] "" Vector__XXX
 SG_ SubCommandID : 0|8@1+ (1,0) [0|0] "" Vector__XXX
 SG_ ErrorCodeGraphicsContextCmd1 : 0|1@1+ (1,0) [0|1] "" Vector__XXX
 SG_ ErrorCodeGraphicsContextCmd2 : 0|1@1+ (1,0) [0|1] "" Vector__XXX
 SG_ ErrorCodeGraphicsContextCmd3 : 0|1@1+ (1,0) [0|1] "" Vector__XXX
 SG_ ErrorCodeGraphicsContextCmd4 : 0|1@1+ (1,0) [0|1] "" Vector__XXX
 SG_ ErrorCodeGraphicsContextCmd5 : 0|1@1+ (1,0) [0|1] "" Vector__XXX
 SG_ ObjectToGetAttributeID_Resp : 0|16@1+ (1,0) [0|65535] "" Vector__XXX
 SG_ AttributeID : 0|8@1+ (1,0) [0|0] "" Vector__XXX
 SG_ ColourMapObjectID : 0|16@1+ (1,0) [0|65535] "" Vector__XXX
 SG_ ErrorCodeSelectColourMap2 : 0|1@1+ (1,0) [0|1] "" Vector__XXX
 SG_ ErrorCodeSelectColourMap1 : 0|1@1+ (1,0) [0|1] "" Vector__XXX
 SG_ ErrorCodeLockUnlockMask9 : 0|1@1+ (1,0) [0|1] "" Vector__XXX
 SG_ ErrorCodeLockUnlockMask8 : 0|1@1+ (1,0) [0|1] "" Vector__XXX
 SG_ ErrorCodeLockUnlockMask7 : 0|1@1+ (1,0) [0|1] "" Vector__XXX
 SG_ ErrorCodeLockUnlockMask6 : 0|1@1+ (1,0) [0|1] "" Vector__XXX
 SG_ ErrorCodeLockUnlockMask5 : 0|1@1+ (1,0) [0|1] "" Vector__XXX
 SG_ ErrorCodeLockUnlockMask4 : 0|1@1+ (1,0) [0|1] "" Vector__XXX
 SG_ ErrorCodeLockUnlockMask3 : 0|1@1+ (1,0) [0|1] "" Vector__XXX
 SG_ ErrorCodeLockUnlockMask2 : 0|1@1+ (1,0) [0|1] "" Vector__XXX
 SG_ ErrorCodeLockUnlockMask1 : 0|1@1+ (1,0) [0|1] "" Vector__XXX
 SG_ LockUnlockCommand : 0|8@1+ (1,0) [0|1] "" Vector__XXX
 SG_ MacroObjecID : 0|8@1+ (1,0) [0|255] "" Vector__XXX
 SG_ ErrorCodeExecuteMacro1 : 0|1@1+ (1,0) [0|1] "" Vector__XXX
 SG_ ErrorCodeExecuteMacro2 : 0|1@1+ (1,0) [0|1] "" Vector__XXX
 SG_ ErrorCodeExecuteMacro3 : 0|1@1+ (1,0) [0|1] "" Vector__XXX
 SG_ VersionNumberISO11783Part6 : 0|8@1+ (1,0) [0|255] "" Vector__XXX
 SG_ MemoryStatus : 0|8@1+ (1,0) [0|1] "" Vector__XXX
 SG_ FirstWideChar : 0|16@1+ (1,0) [0|65535] "" Vector__XXX
 SG_ LastWideChar : 0|16@1+ (1,0) [0|65535] "" Vector__XXX
 SG_ ErrorCodeGetSupportedWideChars2 : 0|1@1+ (1,0) [0|1] "" Vector__XXX
 SG_ ErrorCodeGetSupportedWideChars1 : 0|1@1+ (1,0) [0|1] "" Vector__XXX
 SG_ CodePlane : 0|8@1+ (1,0) [0|16] "" Vector__XXX
 SG_ NumberOfRanges : 0|8@1+ (1,0) [0|255] "" Vector__XXX
 SG_ NavigationSoftKeys : 0|8@1+ (1,0) [0|254] "" Vector__XXX
 SG_ XDotsForSoftKeyDescriptor : 0|8@1+ (1,0) [0|255] "" Vector__XXX
 SG_ YDotsForSoftKeyDescriptor : 0|8@1+ (1,0) [0|255] "" Vector__XXX
 SG_ NumberOfPossibleVirtualSoftKeys : 0|8@1+ (1,0) [0|255] "" Vector__XXX
 SG_ NumberOfPhysicalSoftKeys : 0|8@1+ (1,0) [0|255] "" Vector__XXX
 SG_ FontSize_8x8 : 0|1@1+ (1,0) [0|1] "" Vector__XXX
 SG_ FontSize_8x12 : 0|1@1+ (1,0) [0|1] "" Vector__XXX
 SG_ FontSize_12x16 : 0|1@1+ (1,0) [0|1] "" Vector__XXX
 SG_ FontSize_16x16 : 0|1@1+ (1,0) [0|1] "" Vector__XXX
 SG_ FontSize_16x24 : 0|1@1+ (1,0) [0|1] "" Vector__XXX
 SG_ FontSize_24x32 : 0|1@1+ (1,0) [0|1] "" Vector__XXX
 SG_ FontSize_32x32 : 0|1@1+ (1,0) [0|1] "" Vector__XXX
 SG_ FontSize_32x48 : 0|1@1+ (1,0) [0|1] "" Vector__XXX
 SG_ FontSize_48x64 : 0|1@1+ (1,0) [0|1] "" Vector__XXX
 SG_ FontSize_64x64 : 0|1@1+ (1,0) [0|1] "" Vector__XXX
 SG_ FontSize_64x96 : 0|1@1+ (1,0) [0|1] "" Vector__XXX
 SG_ FontSize_96x128 : 0|1@1+ (1,0) [0|1] "" Vector__XXX
 SG_ FontSize_128x128 : 0|1@1+ (1,0) [0|1] "" Vector__XXX
 SG_ FontSize_128x192 : 0|1@1+ (1,0) [0|1] "" Vector__XXX
 SG_ FontType_BoldText : 0|1@1+ (1,0) [0|1] "" Vector__XXX
 SG_ FontType_CrossedOutText : 0|1@1+ (1,0) [0|1] "" Vector__XXX
 SG_ FontType_UnderlinedText : 0|1@1+ (1,0) [0|1] "" Vector__XXX
 SG_ FontType_ItalicsText : 0|1@1+ (1,0) [0|1] "" Vector__XXX
 SG_ FontType_InvertedText : 0|1@1+ (1,0) [0|1] "" Vector__XXX
 SG_ FontType_FlashInverted : 0|1@1+ (1,0) [0|1] "" Vector__XXX
 SG_ FontType_FlashHidden : 0|1@1+ (1,0) [0|1] "" Vector__XXX
 SG_ FontType_ProportionalFont : 0|1@1+ (1,0) [0|1] "" Vector__XXX
 SG_ MaxLineWidth : 0|8@1+ (1,0) [0|255] "" Vector__XXX
 SG_ LineArts : 0|8@1+ (1,0) [0|1] "" Vector__XXX
 SG_ FillTypes : 0|8@1+ (1,0) [0|1] "" Vector__XXX
 SG_ ShapeFillTypes : 0|8@1+ (1,0) [0|3] "" Vector__XXX
 SG_ SupportedGrapicMode : 0|8@1+ (1,0) [0|2] "" Vector__XXX
 SG_ Hardware1 : 0|1@1+ (1,0) [0|1] "" Vector__XXX
 SG_ Hardware2 : 0|1@1+ (1,0) [0|1] "" Vector__XXX
 SG_ Hardware3 : 0|1@1+ (1,0) [0|1] "" Vector__XXX
 SG_ Hardware4 : 0|1@1+ (1,0) [0|1] "" Vector__XXX
 SG_ Hardware5 : 0|1@1+ (1,0) [0|1] "" Vector__XXX
 SG_ Hardware6 : 0|1@1+ (1,0) [0|1] "" Vector__XXX
 SG_ NrOfXPixelsInDataAreaMask : 0|16@1+ (1,0) [0|65535] "" Vector__XXX
 SG_ NrOfYPixelsInDataAreaMask : 0|16@1+ (1,0) [0|65535] "" Vector__XXX
 SG_ AcknowledgmentStoreVersion : 0|4@1+ (1,0) [0|8] "" Vector__XXX
 SG_ AcknowledgmentLoadVersion : 0|4@1+ (1,0) [0|8] "" Vector__XXX
 SG_ AcknowledgmentDeleteVersion : 0|4@1+ (1,0) [0|8] "" Vector__XXX
 SG_ NrOfVersionStrings : 0|8@1+ (1,0) [0|255] "" Vector__XXX
 SG_ VersionLables : 0|56@1+ (1,0) [0|0] "" Vector__XXX
 SG_ VTParentObjectID : 0|16@1+ (1,0) [0|65535] "" Vector__XXX
 SG_ ObjectIDOfFaultyObject : 0|16@1+ (1,0) [0|65535] "" Vector__XXX
 SG_ ErrorCodeVtObjPoolError1 : 0|1@1+ (1,0) [0|1] "" Vector__XXX
 SG_ ErrorCodeVtObjPoolError2 : 0|1@1+ (1,0) [0|1] "" Vector__XXX
 SG_ ErrorCodeVtObjPoolError3 : 0|1@1+ (1,0) [0|1] "" Vector__XXX
 SG_ ErrorCodeVtObjPoolError4 : 0|1@1+ (1,0) [0|1] "" Vector__XXX
 SG_ SourceAdressOfActiveWSM : 0|8@1+ (1,0) [0|255] "" Vector__XXX
 SG_ VisibleDataOrAlarmMaskObjectID : 0|16@1+ (1,0) [0|65535] "" Vector__XXX
 SG_ VisibleSoftKeyMaskObjectID : 0|16@1+ (1,0) [0|65535] "" Vector__XXX
 SG_ VTBusyCode1 : 0|1@1+ (1,0) [0|1] "" Vector__XXX
 SG_ VTBusyCode2 : 0|1@1+ (1,0) [0|1] "" Vector__XXX
 SG_ VTBusyCode3 : 0|1@1+ (1,0) [0|1] "" Vector__XXX
 SG_ VTBusyCode4 : 0|1@1+ (1,0) [0|1] "" Vector__XXX
 SG_ VTBusyCode5 : 0|1@1+ (1,0) [0|1] "" Vector__XXX
 SG_ VTBusyCode8 : 0|1@1+ (1,0) [0|1] "" Vector__XXX
 SG_ VTFunctionCode : 0|8@1+ (1,0) [0|255] "" Vector__XXX

BO_ 2365194522 PD_Loader: 8 SEND
 SG_ Capacity : 32|32@1+ (1,0) [0|4294967295] "mm2/s"  Loader
 SG_ Quality : 0|32@1+ (1,0) [0|100] "%"  Loader

BO_ 2565340800 VT21_Sprayer: 8 Sprayer
 SG_ VTFunctionECUtoVT M : 0|8@1+ (1,0) [0|255] "" Vector__XXX
 SG_ KeyActivationCode m0 : 8|8@1+ (1,0) [0|2] "" Vector__XXX
 SG_ KeyObjectParentID m0 : 32|16@1+ (1,0) [0|65535] "" Vector__XXX
 SG_ KeyObjectID m0 : 16|16@1+ (1,0) [0|65535] "" Vector__XXX
 SG_ SoftKeyCode m0 : 48|8@1+ (1,0) [0|255] "" Vector__XXX
 SG_ ButtonActivationCode m1 : 8|8@1+ (1,0) [0|2] "" Vector__XXX
 SG_ ButtonObjectID m1 : 16|16@1+ (1,0) [0|65535] "" Vector__XXX
 SG_ ButtonObjectParentID m1 : 32|16@1+ (1,0) [0|65535] "" Vector__XXX
 SG_ ButtonKeyCode m1 : 48|8@1+ (1,0) [0|255] "" Vector__XXX
 SG_ XPosition m2 : 8|16@1+ (1,0) [0|65535] "" Vector__XXX
 SG_ YPosition m2 : 24|16@1+ (1,0) [0|65535] "" Vector__XXX
 SG_ TouchState m2 : 40|8@1+ (1,0) [0|255] "" Vector__XXX
 SG_ VTSelectInputObjectID m3 : 8|16@1+ (1,0) [0|65535] "" Vector__XXX
 SG_ VTSelectInputObjectStatus m3 : 24|8@1+ (1,0) [0|1] "" Vector__XXX
 SG_ VTEscObjectID m4 : 8|16@1+ (1,0) [0|65535] "" Vector__XXX
 SG_ VTChangeNumericValueObjectID m5 : 8|16@1+ (1,0) [0|65535] "" Vector__XXX
 SG_ VTChangeNumericValueValue m5 : 32|32@1+ (1,0) [0|4294967295] "" Vector__XXX
 SG_ VTChangeActiveMaskObjectID m6 : 8|16@1+ (1,0) [0|65535] "" Vector__XXX
 SG_ VTChangeSoftKeyMaskParentID m7 : 8|16@1+ (1,0) [0|65535] "" Vector__XXX
 SG_ VTChangeSoftKeyMaskObjectID m7 : 24|16@1+ (1,0) [0|65535] "" Vector__XXX
 SG_ ParentObjectID_Resp m8 : 8|16@1+ (1,0) [0|65535] "" Vector__XXX
 SG_ ObjectToChangeStringValueID_Resp m8 : 24|16@1+ (1,0) [0|65535] "" Vector__XXX
 SG_ DisplayActivationStatus1 m9 : 8|1@1+ (1,0) [0|1] "" Vector__XXX
 SG_ VisibleDataAlarmMaskID m9 : 16|16@1+ (1,0) [0|65535] "" Vector__XXX
 SG_ VisibleSoftKeyMaskID m9 : 32|16@1+ (1,0) [0|65535] "" Vector__XXX
 SG_ ObjectPoolRecord m17 : 8|56@1+ (1,0) [0|3338120000] "" Vector__XXX
 SG_ AuxiliaryFunctionObjectID m36 : 8|16@1+ (1,0) [0|65535] "" Vector__XXX
 SG_ AssignmentErrorNotAccepted m36 : 24|1@1+ (1,0) [0|1] "" Vector__XXX
 SG_ NumberOfInpuUnits m34 : 8|8@1+ (1,0) [0|255] "" Vector__XXX
 SG_ AuxModelIdentification m35 : 8|16@1+ (1,0) [0|65535] "" Vector__XXX
 SG_ InputStatusObjectId m37 : 8|16@1+ (1,0) [0|255] "" Vector__XXX
 SG_ AuxInputEnable m37 : 24|8@1+ (1,0) [0|1] "" Vector__XXX
 SG_ AuxErrorInvalidInputID m37 : 32|1@1+ (1,0) [0|1] "" Vector__XXX
 SG_ AuxErrorAnyOther m37 : 33|1@1+ (1,0) [0|1] "" Vector__XXX
 SG_ ObjectToShowHideID m160 : 8|16@1+ (1,0) [0|65535] "" Vector__XXX
 SG_ ShowOrHide m160 : 24|8@1+ (1,0) [0|1] "" Vector__XXX
 SG_ ObjectoEnableDisbaleID m161 : 8|16@1+ (1,0) [0|65535] "" Vector__XXX
 SG_ EnableOrDisable m161 : 24|8@1+ (1,0) [0|1] "" Vector__XXX
 SG_ SelectInputObjectID m162 : 8|16@1+ (1,0) [0|65535] "" Vector__XXX
 SG_ SetFocusOpenForEditing m162 : 24|8@1+ (1,0) [0|255] "" Vector__XXX
 SG_ NumberOfRepetitions_Audio m163 : 8|8@1+ (1,0) [0|255] "" Vector__XXX
 SG_ Frequency_Audio m163 : 16|16@1+ (1,0) [0|65535] "hz" Vector__XXX
 SG_ OnTimeDuration_Audio m163 : 32|16@1+ (1,0) [0|65535] "ms" Vector__XXX
 SG_ OffTimeDuration_Audio m163 : 48|16@1+ (1,0) [0|65535] "ms" Vector__XXX
 SG_ AudioVolume m164 : 8|8@1+ (1,0) [0|100] "%" Vector__XXX
 SG_ ParentObjectID_Location m165 : 8|16@1+ (1,0) [0|65535] "" Vector__XXX
 SG_ ObjectToMoveID_Location m165 : 24|16@1+ (1,0) [0|65535] "" Vector__XXX
 SG_ XPosChangeTopLeft m165 : 40|8@1+ (1,-127) [-127|128] "" Vector__XXX
 SG_ YPosChangeTopLeft m165 : 48|8@1+ (1,-127) [-127|128] "" Vector__XXX
 SG_ ObjectToSizeID m166 : 8|16@1+ (1,0) [0|65535] "" Vector__XXX
 SG_ NewWidth m166 : 24|16@1+ (1,0) [0|65535] "" Vector__XXX
 SG_ NewHeight m166 : 40|16@1+ (1,0) [0|65535] "" Vector__XXX
 SG_ ObjectToChangeColourID m167 : 8|16@1+ (1,0) [0|65535] "" Vector__XXX
 SG_ NewBackgroundColour m167 : 24|8@1+ (1,0) [0|255] "" Vector__XXX
 SG_ ObjectToChangeNumValueID m168 : 8|16@1+ (1,0) [0|65535] "" Vector__XXX
 SG_ NewValue m168 : 32|32@1+ (1,0) [0|65535] "" Vector__XXX
 SG_ ObjectToChangeEndPointID m169 : 8|16@1+ (1,0) [0|65535] "" Vector__XXX
 SG_ Width m169 : 24|16@1+ (1,0) [0|65535] "" Vector__XXX
 SG_ Height m169 : 40|16@1+ (1,0) [0|65535] "" Vector__XXX
 SG_ LineDirection m169 : 56|8@1+ (1,0) [0|1] "" Vector__XXX
 SG_ ObjectToChangeFontID m170 : 8|16@1+ (1,0) [0|65535] "" Vector__XXX
 SG_ FontColour m170 : 24|8@1+ (1,0) [0|255] "" Vector__XXX
 SG_ FontSize m170 : 32|8@1+ (1,0) [0|255] "" Vector__XXX
 SG_ FontType m170 : 40|8@1+ (1,0) [0|255] "" Vector__XXX
 SG_ FontStyle m170 : 48|8@1+ (1,0) [0|255] "" Vector__XXX
 SG_ ObjectToChangeLineAttributesID m171 : 8|16@1+ (1,0) [0|65535] "" Vector__XXX
 SG_ LineColour m171 : 24|8@1+ (1,0) [0|255] "" Vector__XXX
 SG_ LineWidth m171 : 32|8@1+ (1,0) [0|255] "" Vector__XXX
 SG_ LineArt m171 : 40|16@1+ (1,0) [0|65535] "" Vector__XXX
 SG_ ObjectToChangeFillAttributesID m172 : 8|16@1+ (1,0) [0|65535] "" Vector__XXX
 SG_ FillType m172 : 24|8@1+ (1,0) [0|255] "" Vector__XXX
 SG_ FillColour m172 : 32|8@1+ (1,0) [0|255] "" Vector__XXX
 SG_ FillPatternObjectID m172 : 40|16@1+ (1,0) [0|65535] "" Vector__XXX
 SG_ WorkingSetObjectID m173 : 8|16@1+ (1,0) [0|65535] "" Vector__XXX
 SG_ NewActiveMaskObjectID m173 : 24|16@1+ (1,0) [0|65535] "" Vector__XXX
 SG_ MaskType m174 : 8|8@1+ (1,0) [0|255] "" Vector__XXX
 SG_ DataOrAlarmMaskObjectID m174 : 16|16@1+ (1,0) [0|65535] "" Vector__XXX
 SG_ NewSoftKeyMaskObjectID m174 : 32|16@1+ (1,0) [0|65535] "" Vector__XXX
 SG_ ObjectToChangeAttributeID m175 : 8|16@1+ (1,0) [0|65535] "" Vector__XXX
 SG_ AttributeID_Change m175 : 24|8@1+ (1,0) [0|16777200] "" Vector__XXX
 SG_ NewAttributeValue m175 : 32|32@1+ (1,0) [0|0] "" Vector__XXX
 SG_ AlarmMaskObjectID m176 : 8|16@1+ (1,0) [0|65535] "" Vector__XXX
 SG_ NewPriority m176 : 24|8@1+ (1,0) [0|255] "" Vector__XXX
 SG_ ListInputObjectID m177 : 8|16@1+ (1,0) [0|65535] "" Vector__XXX
 SG_ ListIndex m177 : 24|8@1+ (1,0) [0|255] "" Vector__XXX
 SG_ NewObjectID m177 : 32|16@1+ (1,0) [0|65535] "" Vector__XXX
 SG_ ObjectToChangeStringValueID m179 : 8|16@1+ (1,0) [0|65535] "" Vector__XXX
 SG_ NewStringValue m179 : 24|16@1+ (1,0) [0|65535] "" Vector__XXX
 SG_ ParentObjectID_Position m180 : 8|16@1+ (1,0) [0|65535] "" Vector__XXX
 SG_ ObjectToMoveID_Position m180 : 24|16@1+ (1,0) [0|65535] "" Vector__XXX
 SG_ XPosChangeTopLeftLong m180 : 40|16@1- (1,0) [-32768|32767] "" Vector__XXX
 SG_ YPosChangeTopLeftLong m180 : 56|16@1- (1,0) [-32768|32767] "" Vector__XXX
 SG_ ObjectToAssociateLabelWithID m181 : 8|16@1+ (1,0) [0|65535] "" Vector__XXX
 SG_ StringVariableObjectID m181 : 24|16@1+ (1,0) [0|65535] "" Vector__XXX
 SG_ GraphicRepresentationObjectID m181 : 48|16@1+ (1,0) [0|255] "" Vector__XXX
 SG_ LabelFontType m181 : 40|8@1+ (1,0) [0|255] "" Vector__XXX
 SG_ PolygonObjectToChangeID m182 : 8|16@1+ (1,0) [0|65535] "" Vector__XXX
 SG_ IndexOfThePointToReplace m182 : 24|8@1+ (1,0) [0|255] "" Vector__XXX
 SG_ NewValueX m182 : 32|16@1+ (1,0) [0|65535] "" Vector__XXX
 SG_ NewValueY m182 : 48|16@1+ (1,0) [0|65535] "" Vector__XXX
 SG_ PolygonObjectToScaleID m183 : 8|16@1+ (1,0) [0|65535] "" Vector__XXX
 SG_ NewWidthAttribute m183 : 24|16@1+ (1,0) [0|65535] "" Vector__XXX
 SG_ NewHeigthAttribute m183 : 40|16@1+ (1,0) [0|0] "" Vector__XXX
 SG_ GraphicsContextObjectID m184 : 8|16@1+ (1,0) [0|65535] "" Vector__XXX
 SG_ SubCommandID m184 : 24|8@1+ (1,0) [0|0] "" Vector__XXX
 SG_ ObjectToGetAttributeID m185 : 8|16@1+ (1,0) [0|65535] "" Vector__XXX
 SG_ AttributeID m185 : 24|8@1+ (1,0) [0|0] "" Vector__XXX
 SG_ ColourMapObjectID m186 : 8|16@1+ (1,0) [0|65535] "" Vector__XXX
 SG_ LockUnlockCommand m189 : 8|8@1+ (1,0) [0|1] "" Vector__XXX
 SG_ ObjectIDOfDataMaskToLock m189 : 16|16@1+ (1,0) [0|65535] "" Vector__XXX
 SG_ LockTimeout m189 : 32|16@1+ (1,0) [0|65535] "" Vector__XXX
 SG_ MacroObjecID m190 : 8|8@1+ (1,0) [0|255] "" Vector__XXX
 SG_ MemoryRequired m192 : 16|24@1+ (1,0) [0|16777200] "" Vector__XXX
 SG_ CodePlane m193 : 8|8@1+ (1,0) [0|16] "" Vector__XXX
 SG_ FirstWideChar m193 : 16|16@1+ (1,0) [0|65535] "" Vector__XXX
 SG_ LastWideChar m193 : 32|16@1+ (1,0) [0|65535] "" Vector__XXX
 SG_ VersionLabelToStore m208 : 8|56@1+ (1,0) [0|3338120000] "" Vector__XXX
 SG_ VersionLabelToLoad m209 : 8|56@1+ (1,0) [0|3338120000] "" Vector__XXX
 SG_ VersionLabelToDelete m210 : 8|56@1+ (1,0) [0|3338120000] "" Vector__XXX
 SG_ WSMaintenanceInitiating m255 : 8|1@1+ (1,0) [0|1] "" Vector__XXX
 SG_ WSMaintenanceBitmask m255 : 15|1@1+ (1,0) [0|1] "" Vector__XXX

BO_ 2565340802 VT21_AuxInput: 8 AuxInput
 SG_ VTFunctionECUtoVT M : 0|8@1+ (1,0) [0|255] "" Vector__XXX
 SG_ KeyActivationCode m0 : 8|8@1+ (1,0) [0|2] "" Vector__XXX
 SG_ KeyObjectParentID m0 : 32|16@1+ (1,0) [0|65535] "" Vector__XXX
 SG_ KeyObjectID m0 : 16|16@1+ (1,0) [0|65535] "" Vector__XXX
 SG_ SoftKeyCode m0 : 48|8@1+ (1,0) [0|255] "" Vector__XXX
 SG_ ButtonActivationCode m1 : 8|8@1+ (1,0) [0|2] "" Vector__XXX
 SG_ ButtonObjectID m1 : 16|16@1+ (1,0) [0|65535] "" Vector__XXX
 SG_ ButtonObjectParentID m1 : 32|16@1+ (1,0) [0|65535] "" Vector__XXX
 SG_ ButtonKeyCode m1 : 48|8@1+ (1,0) [0|255] "" Vector__XXX
 SG_ XPosition m2 : 8|16@1+ (1,0) [0|65535] "" Vector__XXX
 SG_ YPosition m2 : 24|16@1+ (1,0) [0|65535] "" Vector__XXX
 SG_ TouchState m2 : 40|8@1+ (1,0) [0|255] "" Vector__XXX
 SG_ VTSelectInputObjectID m3 : 8|16@1+ (1,0) [0|65535] "" Vector__XXX
 SG_ VTSelectInputObjectStatus m3 : 24|8@1+ (1,0) [0|1] "" Vector__XXX
 SG_ VTEscObjectID m4 : 8|16@1+ (1,0) [0|65535] "" Vector__XXX
 SG_ VTChangeNumericValueObjectID m5 : 8|16@1+ (1,0) [0|65535] "" Vector__XXX
 SG_ VTChangeNumericValueValue m5 : 32|32@1+ (1,0) [0|4294967295] "" Vector__XXX
 SG_ VTChangeActiveMaskObjectID m6 : 8|16@1+ (1,0) [0|65535] "" Vector__XXX
 SG_ VTChangeSoftKeyMaskParentID m7 : 8|16@1+ (1,0) [0|65535] "" Vector__XXX
 SG_ VTChangeSoftKeyMaskObjectID m7 : 24|16@1+ (1,0) [0|65535] "" Vector__XXX
 SG_ ParentObjectID_Resp m8 : 8|16@1+ (1,0) [0|65535] "" Vector__XXX
 SG_ ObjectToChangeStringValueID_Resp m8 : 24|16@1+ (1,0) [0|65535] "" Vector__XXX
 SG_ DisplayActivationStatus1 m9 : 8|1@1+ (1,0) [0|1] "" Vector__XXX
 SG_ VisibleDataAlarmMaskID m9 : 16|16@1+ (1,0) [0|65535] "" Vector__XXX
 SG_ VisibleSoftKeyMaskID m9 : 32|16@1+ (1,0) [0|65535] "" Vector__XXX
 SG_ ObjectPoolRecord m17 : 8|56@1+ (1,0) [0|3338120000] "" Vector__XXX
 SG_ AuxiliaryFunctionObjectID m36 : 8|16@1+ (1,0) [0|65535] "" Vector__XXX
 SG_ AssignmentErrorNotAccepted m36 : 24|1@1+ (1,0) [0|1] "" Vector__XXX
 SG_ NumberOfInpuUnits m34 : 8|8@1+ (1,0) [0|255] "" Vector__XXX
 SG_ AuxModelIdentification m35 : 8|16@1+ (1,0) [0|65535] "" Vector__XXX
 SG_ InputStatusObjectId m37 : 8|16@1+ (1,0) [0|255] "" Vector__XXX
 SG_ AuxInputEnable m37 : 24|8@1+ (1,0) [0|1] "" Vector__XXX
 SG_ AuxErrorInvalidInputID m37 : 32|1@1+ (1,0) [0|1] "" Vector__XXX
 SG_ AuxErrorAnyOther m37 : 33|1@1+ (1,0) [0|1] "" Vector__XXX
 SG_ ObjectToShowHideID m160 : 8|16@1+ (1,0) [0|65535] "" Vector__XXX
 SG_ ShowOrHide m160 : 24|8@1+ (1,0) [0|1] "" Vector__XXX
 SG_ ObjectoEnableDisbaleID m161 : 8|16@1+ (1,0) [0|65535] "" Vector__XXX
 SG_ EnableOrDisable m161 : 24|8@1+ (1,0) [0|1] "" Vector__XXX
 SG_ SelectInputObjectID m162 : 8|16@1+ (1,0) [0|65535] "" Vector__XXX
 SG_ SetFocusOpenForEditing m162 : 24|8@1+ (1,0) [0|255] "" Vector__XXX
 SG_ NumberOfRepetitions_Audio m163 : 8|8@1+ (1,0) [0|255] "" Vector__XXX
 SG_ Frequency_Audio m163 : 16|16@1+ (1,0) [0|65535] "hz" Vector__XXX
 SG_ OnTimeDuration_Audio m163 : 32|16@1+ (1,0) [0|65535] "ms" Vector__XXX
 SG_ OffTimeDuration_Audio m163 : 48|16@1+ (1,0) [0|65535] "ms" Vector__XXX
 SG_ AudioVolume m164 : 8|8@1+ (1,0) [0|100] "%" Vector__XXX
 SG_ ParentObjectID_Location m165 : 8|16@1+ (1,0) [0|65535] "" Vector__XXX
 SG_ ObjectToMoveID_Location m165 : 24|16@1+ (1,0) [0|65535] "" Vector__XXX
 SG_ XPosChangeTopLeft m165 : 40|8@1+ (1,-127) [-127|128] "" Vector__XXX
 SG_ YPosChangeTopLeft m165 : 48|8@1+ (1,-127) [-127|128] "" Vector__XXX
 SG_ ObjectToSizeID m166 : 8|16@1+ (1,0) [0|65535] "" Vector__XXX
 SG_ NewWidth m166 : 24|16@1+ (1,0) [0|65535] "" Vector__XXX
 SG_ NewHeight m166 : 40|16@1+ (1,0) [0|65535] "" Vector__XXX
 SG_ ObjectToChangeColourID m167 : 8|16@1+ (1,0) [0|65535] "" Vector__XXX
 SG_ NewBackgroundColour m167 : 24|8@1+ (1,0) [0|255] "" Vector__XXX
 SG_ ObjectToChangeNumValueID m168 : 8|16@1+ (1,0) [0|65535] "" Vector__XXX
 SG_ NewValue m168 : 32|32@1+ (1,0) [0|65535] "" Vector__XXX
 SG_ ObjectToChangeEndPointID m169 : 8|16@1+ (1,0) [0|65535] "" Vector__XXX
 SG_ Width m169 : 24|16@1+ (1,0) [0|65535] "" Vector__XXX
 SG_ Height m169 : 40|16@1+ (1,0) [0|65535] "" Vector__XXX
 SG_ LineDirection m169 : 56|8@1+ (1,0) [0|1] "" Vector__XXX
 SG_ ObjectToChangeFontID m170 : 8|16@1+ (1,0) [0|65535] "" Vector__XXX
 SG_ FontColour m170 : 24|8@1+ (1,0) [0|255] "" Vector__XXX
 SG_ FontSize m170 : 32|8@1+ (1,0) [0|255] "" Vector__XXX
 SG_ FontType m170 : 40|8@1+ (1,0) [0|255] "" Vector__XXX
 SG_ FontStyle m170 : 48|8@1+ (1,0) [0|255] "" Vector__XXX
 SG_ ObjectToChangeLineAttributesID m171 : 8|16@1+ (1,0) [0|65535] "" Vector__XXX
 SG_ LineColour m171 : 24|8@1+ (1,0) [0|255] "" Vector__XXX
 SG_ LineWidth m171 : 32|8@1+ (1,0) [0|255] "" Vector__XXX
 SG_ LineArt m171 : 40|16@1+ (1,0) [0|65535] "" Vector__XXX
 SG_ ObjectToChangeFillAttributesID m172 : 8|16@1+ (1,0) [0|65535] "" Vector__XXX
 SG_ FillType m172 : 24|8@1+ (1,0) [0|255] "" Vector__XXX
 SG_ FillColour m172 : 32|8@1+ (1,0) [0|255] "" Vector__XXX
 SG_ FillPatternObjectID m172 : 40|16@1+ (1,0) [0|65535] "" Vector__XXX
 SG_ WorkingSetObjectID m173 : 8|16@1+ (1,0) [0|65535] "" Vector__XXX
 SG_ NewActiveMaskObjectID m173 : 24|16@1+ (1,0) [0|65535] "" Vector__XXX
 SG_ MaskType m174 : 8|8@1+ (1,0) [0|255] "" Vector__XXX
 SG_ DataOrAlarmMaskObjectID m174 : 16|16@1+ (1,0) [0|65535] "" Vector__XXX
 SG_ NewSoftKeyMaskObjectID m174 : 32|16@1+ (1,0) [0|65535] "" Vector__XXX
 SG_ ObjectToChangeAttributeID m175 : 8|16@1+ (1,0) [0|65535] "" Vector__XXX
 SG_ AttributeID_Change m175 : 24|8@1+ (1,0) [0|16777200] "" Vector__XXX
 SG_ NewAttributeValue m175 : 32|32@1+ (1,0) [0|0] "" Vector__XXX
 SG_ AlarmMaskObjectID m176 : 8|16@1+ (1,0) [0|65535] "" Vector__XXX
 SG_ NewPriority m176 : 24|8@1+ (1,0) [0|255] "" Vector__XXX
 SG_ ListInputObjectID m177 : 8|16@1+ (1,0) [0|65535] "" Vector__XXX
 SG_ ListIndex m177 : 24|8@1+ (1,0) [0|255] "" Vector__XXX
 SG_ NewObjectID m177 : 32|16@1+ (1,0) [0|65535] "" Vector__XXX
 SG_ ObjectToChangeStringValueID m179 : 8|16@1+ (1,0) [0|65535] "" Vector__XXX
 SG_ NewStringValue m179 : 24|16@1+ (1,0) [0|65535] "" Vector__XXX
 SG_ ParentObjectID_Position m180 : 8|16@1+ (1,0) [0|65535] "" Vector__XXX
 SG_ ObjectToMoveID_Position m180 : 24|16@1+ (1,0) [0|65535] "" Vector__XXX
 SG_ XPosChangeTopLeftLong m180 : 40|16@1- (1,0) [-32768|32767] "" Vector__XXX
 SG_ YPosChangeTopLeftLong m180 : 56|16@1- (1,0) [-32768|32767] "" Vector__XXX
 SG_ ObjectToAssociateLabelWithID m181 : 8|16@1+ (1,0) [0|65535] "" Vector__XXX
 SG_ StringVariableObjectID m181 : 24|16@1+ (1,0) [0|65535] "" Vector__XXX
 SG_ GraphicRepresentationObjectID m181 : 48|16@1+ (1,0) [0|255] "" Vector__XXX
 SG_ LabelFontType m181 : 40|8@1+ (1,0) [0|255] "" Vector__XXX
 SG_ PolygonObjectToChangeID m182 : 8|16@1+ (1,0) [0|65535] "" Vector__XXX
 SG_ IndexOfThePointToReplace m182 : 24|8@1+ (1,0) [0|255] "" Vector__XXX
 SG_ NewValueX m182 : 32|16@1+ (1,0) [0|65535] "" Vector__XXX
 SG_ NewValueY m182 : 48|16@1+ (1,0) [0|65535] "" Vector__XXX
 SG_ PolygonObjectToScaleID m183 : 8|16@1+ (1,0) [0|65535] "" Vector__XXX
 SG_ NewWidthAttribute m183 : 24|16@1+ (1,0) [0|65535] "" Vector__XXX
 SG_ NewHeigthAttribute m183 : 40|16@1+ (1,0) [0|0] "" Vector__XXX
 SG_ GraphicsContextObjectID m184 : 8|16@1+ (1,0) [0|65535] "" Vector__XXX
 SG_ SubCommandID m184 : 24|8@1+ (1,0) [0|0] "" Vector__XXX
 SG_ ObjectToGetAttributeID m185 : 8|16@1+ (1,0) [0|65535] "" Vector__XXX
 SG_ AttributeID m185 : 24|8@1+ (1,0) [0|0] "" Vector__XXX
 SG_ ColourMapObjectID m186 : 8|16@1+ (1,0) [0|65535] "" Vector__XXX
 SG_ LockUnlockCommand m189 : 8|8@1+ (1,0) [0|1] "" Vector__XXX
 SG_ ObjectIDOfDataMaskToLock m189 : 16|16@1+ (1,0) [0|65535] "" Vector__XXX
 SG_ LockTimeout m189 : 32|16@1+ (1,0) [0|65535] "" Vector__XXX
 SG_ MacroObjecID m190 : 8|8@1+ (1,0) [0|255] "" Vector__XXX
 SG_ MemoryRequired m192 : 16|24@1+ (1,0) [0|16777200] "" Vector__XXX
 SG_ CodePlane m193 : 8|8@1+ (1,0) [0|16] "" Vector__XXX
 SG_ FirstWideChar m193 : 16|16@1+ (1,0) [0|65535] "" Vector__XXX
 SG_ LastWideChar m193 : 32|16@1+ (1,0) [0|65535] "" Vector__XXX
 SG_ VersionLabelToStore m208 : 8|56@1+ (1,0) [0|3338120000] "" Vector__XXX
 SG_ VersionLabelToLoad m209 : 8|56@1+ (1,0) [0|3338120000] "" Vector__XXX
 SG_ VersionLabelToDelete m210 : 8|56@1+ (1,0) [0|3338120000] "" Vector__XXX
 SG_ WSMaintenanceInitiating m255 : 8|1@1+ (1,0) [0|1] "" Vector__XXX
 SG_ WSMaintenanceBitmask m255 : 15|1@1+ (1,0) [0|1] "" Vector__XXX

BO_ 2632384130 VT12_AuxInput: 14 AuxInput
 SG_ VTFunctionVTtoECU M : 0|8@1+ (1,0) [0|255] "" Vector__XXX
 SG_ KeyActivationCode m0 : 8|8@1+ (1,0) [0|2] "" Vector__XXX
 SG_ KeyObjectID m0 : 16|16@1+ (1,0) [0|65535] "" Vector__XXX
 SG_ KeyObjectParentID m0 : 32|16@1+ (1,0) [0|65535] "" Vector__XXX
 SG_ SoftKeyCode m0 : 48|8@1+ (1,0) [0|255] "" Vector__XXX
 SG_ ButtonActivationCode m1 : 8|8@1+ (1,0) [0|2] "" Vector__XXX
 SG_ ButtonObjectID m1 : 16|16@1+ (1,0) [0|65535] "" Vector__XXX
 SG_ ButtonObjectParentID m1 : 32|16@1+ (1,0) [0|65535] "" Vector__XXX
 SG_ ButtonKeyCode m1 : 48|8@1+ (1,0) [0|255] "" Vector__XXX
 SG_ XPosition m2 : 8|16@1+ (1,0) [0|65535] "" Vector__XXX
 SG_ YPosition m2 : 24|16@1+ (1,0) [0|65535] "" Vector__XXX
 SG_ TouchState m2 : 40|8@1+ (1,0) [0|255] "" Vector__XXX
 SG_ VTSelectInputObjectID m3 : 8|16@1+ (1,0) [0|65535] "" Vector__XXX
 SG_ VTSelectInputObjectStatus m3 : 24|8@1+ (1,0) [0|1] "" Vector__XXX
 SG_ VTSelectInputObjectIsEdited m3 : 32|1@1+ (1,0) [0|1] "" Vector__XXX
 SG_ VTEscObjectID m4 : 8|16@1+ (1,0) [0|65535] "" Vector__XXX
 SG_ ErrorCodeVTEsc1 m4 : 24|1@1+ (1,0) [0|1] "" Vector__XXX
 SG_ ErrorCodeVTEsc2 m4 : 28|1@1+ (1,0) [0|1] "" Vector__XXX
 SG_ VTChangeNumericValueObjectID m5 : 8|16@1+ (1,0) [0|65535] "" Vector__XXX
 SG_ VTChangeNumericValueValue m5 : 32|32@1+ (1,0) [0|4294967295] "" Vector__XXX
 SG_ VTChangeActiveMaskObjectID m6 : 8|16@1+ (1,0) [0|65535] "" Vector__XXX
 SG_ ErrorCodeMissingObjects m6 : 26|1@1+ (1,0) [0|1] "" Vector__XXX
 SG_ ErrorCodeMaskOrChildObjectError m6 : 27|1@1+ (1,0) [0|1] "" Vector__XXX
 SG_ ErrorCodeAnyOtherError m6 : 28|1@1+ (1,0) [0|1] "" Vector__XXX
 SG_ ErrorCodePoolDeleted m6 : 29|1@1+ (1,0) [0|1] "" Vector__XXX
 SG_ VTChangeActiveMaskErrorID m6 : 32|16@1+ (1,0) [0|65535] "" Vector__XXX
 SG_ VTChangeActiveMaskParentID m6 : 48|16@1+ (1,0) [0|65535] "" Vector__XXX
 SG_ VTChangeSoftKeyMaskParentID m7 : 8|16@1+ (1,0) [0|65535] "" Vector__XXX
 SG_ VTChangeSoftKeyMaskObjectID m7 : 24|16@1+ (1,0) [0|65535] "" Vector__XXX
 SG_ ErrorCodeVTChangeSoftKeyMask1 m7 : 40|1@1+ (1,0) [0|1] "" Vector__XXX
 SG_ ErrorCodeVTChangeSoftKeyMask2 m7 : 41|1@1+ (1,0) [0|1] "" Vector__XXX
 SG_ ErrorCodeVTChangeSoftKeyMask3 m7 : 42|1@1+ (1,0) [0|1] "" Vector__XXX
 SG_ ErrorCodeVTChangeSoftKeyMask4 m7 : 43|1@1+ (1,0) [0|1] "" Vector__XXX
 SG_ ErrorCodeVTChangeSoftKeyMask5 m7 : 44|1@1+ (1,0) [0|1] "" Vector__XXX
 SG_ ObjectToChangeStringID m8 : 8|16@1+ (1,0) [0|65535] "" Vector__XXX
 SG_ EnteredStringValue m8 : 24|8@1+ (1,0) [0|255] "" Vector__XXX
 SG_ DisplayActivationStatus1 m9 : 8|1@1+ (1,0) [0|1] "" Vector__XXX
 SG_ VisibleDataAlarmMaskID m9 : 16|16@1+ (1,0) [0|65535] "" Vector__XXX
 SG_ VisibleSoftKeyMaskID m9 : 32|16@1+ (1,0) [0|65535] "" Vector__XXX
 SG_ ErrorCodeEndOfObjectPool1 m18 : 8|1@1+ (1,0) [0|1] "" Vector__XXX
 SG_ ErrorCodeEndOfObjectPool2 m18 : 9|1@1+ (1,0) [0|1] "" Vector__XXX
 SG_ ErrorCodeEndOfObjectPool3 m18 : 12|1@1+ (1,0) [0|1] "" Vector__XXX
 SG_ ParentObjectIdOfFaultyObject m18 : 16|16@1+ (1,0) [0|65535] "" Vector__XXX
 SG_ ObjectIdOfFaultyObject m18 : 32|16@1+ (1,0) [0|65535] "" Vector__XXX
 SG_ ErrorCodeObjectPool1 m18 : 48|1@1+ (1,0) [0|1] "" Vector__XXX
 SG_ ErrorCodeObjectPool2 m18 : 49|1@1+ (1,0) [0|1] "" Vector__XXX
 SG_ ErrorCodeObjectPool3 m18 : 50|1@1+ (1,0) [0|1] "" Vector__XXX
 SG_ ErrorCodeObjectPool4 m18 : 51|1@1+ (1,0) [0|1] "" Vector__XXX
 SG_ IdentityNumber m36 : 8|21@1+ (1,0) [0|2097150] "" Vector__XXX
 SG_ ManufacturerCode m36 : 29|11@1+ (1,0) [0|2047] "" Vector__XXX
 SG_ ECUInstance m36 : 40|3@1+ (1,0) [0|7] "" Vector__XXX
 SG_ FunctionInstance m36 : 43|5@1+ (1,0) [0|31] "" Vector__XXX
 SG_ AuxiliaryInputObjectID m36 : 80|16@1+ (1,0) [0|65535] "" Vector__XXX
 SG_ InputObjectId m38 : 8|16@1+ (1,0) [0|255] "" Vector__XXX
 SG_ Value1 m38 : 24|16@1+ (1,0) [0|65535] "" Vector__XXX
 SG_ Function m36 : 48|8@1+ (1,0) [0|255] "" Vector__XXX
 SG_ DeviceClass m36 : 57|7@1+ (1,0) [0|127] "" Vector__XXX
 SG_ IndustryGroup m36 : 64|3@1+ (1,0) [0|7] "" Vector__XXX
 SG_ DeviceClassInstance m36 : 67|4@1+ (1,0) [0|15] "" Vector__XXX
 SG_ SelfConfigurableAddress m36 : 71|1@1+ (1,0) [0|1] "" Vector__XXX
 SG_ AuxiliaryFunctionType m36 : 72|4@1+ (1,0) [0|15] "" Vector__XXX
 SG_ AuxiliaryFunctionObjectID m36 : 96|16@1+ (1,0) [0|65535] "" Vector__XXX
 SG_ Value2 m38 : 40|16@1+ (1,0) [0|65535] "" Vector__XXX
 SG_ AuxPreferredAssignmentRespError1 m34 : 8|1@1+ (1,0) [0|1] "" Vector__XXX
 SG_ AuxPreferredAssignmentRespError2 m34 : 9|1@1+ (1,0) [0|1] "" Vector__XXX
 SG_ AuxPreferredAssignmentRespError3 m34 : 10|1@1+ (1,0) [0|1] "" Vector__XXX
 SG_ AuxPreferredAssignmentRespError4 m34 : 11|1@1+ (1,0) [0|1] "" Vector__XXX
 SG_ InputStatusObjectId m37 : 8|16@1+ (1,0) [0|255] "" Vector__XXX
 SG_ AuxInputEnable m37 : 24|8@1+ (1,0) [0|1] "" Vector__XXX
 SG_ ObjectEscapeID m146 : 8|16@1+ (1,0) [0|65535] "" Vector__XXX
 SG_ ErrorCodeEscapeObj1 m146 : 24|1@1+ (1,0) [0|1] "" Vector__XXX
 SG_ ErrorCodeEscapeObj2 m146 : 28|1@1+ (1,0) [0|1] "" Vector__XXX
 SG_ ObjectToHideShowID m160 : 8|16@1+ (1,0) [0|65535] "" Vector__XXX
 SG_ ObjectShowStatus m160 : 24|8@1+ (1,0) [0|1] "" Vector__XXX
 SG_ ErrorCodeHideShowObj1 m160 : 32|1@1+ (1,0) [0|1] "" Vector__XXX
 SG_ ErrorCodeHideShowObj2 m160 : 33|1@1+ (1,0) [0|1] "" Vector__XXX
 SG_ ErrorCodeHideShowObj3 m160 : 35|1@1+ (1,0) [0|1] "" Vector__XXX
 SG_ ObjectToEnableDisableID m161 : 8|16@1+ (1,0) [0|65535] "" Vector__XXX
 SG_ ObjectEnableStatus m161 : 24|8@1+ (1,0) [0|1] "" Vector__XXX
 SG_ ErrorCodeEnableDisableObj1 m161 : 33|1@1+ (1,0) [0|1] "" Vector__XXX
 SG_ ErrorCodeEnableDisableObj2 m161 : 34|1@1+ (1,0) [0|1] "" Vector__XXX
 SG_ ErrorCodeEnableDisableObj3 m161 : 35|1@1+ (1,0) [0|1] "" Vector__XXX
 SG_ ErrorCodeEnableDisableObj4 m161 : 36|1@1+ (1,0) [0|1] "" Vector__XXX
 SG_ SelectInputObjectID m162 : 8|16@1+ (1,0) [0|65535] "" Vector__XXX
 SG_ ObjectSelectStatus m162 : 24|8@1+ (1,0) [0|2] "" Vector__XXX
 SG_ ErrorCodeSelectObject1 m162 : 32|1@1+ (1,0) [0|1] "" Vector__XXX
 SG_ ErrorCodeSelectObject2 m162 : 33|1@1+ (1,0) [0|1] "" Vector__XXX
 SG_ ErrorCodeSelectObject3 m162 : 34|1@1+ (1,0) [0|1] "" Vector__XXX
 SG_ ErrorCodeSelectObject4 m162 : 35|1@1+ (1,0) [0|1] "" Vector__XXX
 SG_ ErrorCodeSelectObject5 m162 : 36|1@1+ (1,0) [0|1] "" Vector__XXX
 SG_ ErrorCodeControlAudioDevice1 m163 : 8|1@1+ (1,0) [0|1] "" Vector__XXX
 SG_ ErrorCodeControlAudioDevice2 m163 : 12|1@1+ (1,0) [0|1] "" Vector__XXX
 SG_ ErrorCodeAudioVolume1 m164 : 8|1@1+ (1,0) [0|1] "" Vector__XXX
 SG_ ErrorCodeAudioVolume2 m164 : 12|1@1+ (1,0) [0|1] "" Vector__XXX
 SG_ ParentObjectID_Location m165 : 8|16@1+ (1,0) [0|65535] "" Vector__XXX
 SG_ ObjectToMoveID_Location m165 : 24|16@1+ (1,0) [0|65535] "" Vector__XXX
 SG_ ErrorCodeChangeChildLocation1 m165 : 40|1@1+ (1,0) [0|1] "" Vector__XXX
 SG_ ErrorCodeChangeChildLocation2 m165 : 41|1@1+ (1,0) [0|1] "" Vector__XXX
 SG_ ErrorCodeChangeChildLocation5 m165 : 44|1@1+ (1,0) [0|1] "" Vector__XXX
 SG_ ObjectToSizeID m166 : 8|16@1+ (1,0) [0|65535] "" Vector__XXX
 SG_ ErrorCodeObjToSize1 m166 : 24|1@1+ (1,0) [0|1] "" Vector__XXX
 SG_ ErrorCodeObjToSize2 m166 : 25|1@1+ (1,0) [0|1] "" Vector__XXX
 SG_ ErrorCodeObjToSize3 m166 : 26|1@1+ (1,0) [0|1] "" Vector__XXX
 SG_ ErrorCodeObjToSize4 m166 : 28|1@1+ (1,0) [0|1] "" Vector__XXX
 SG_ ObjectToChangeColourID m167 : 8|16@1+ (1,0) [0|65535] "" Vector__XXX
 SG_ NewBackgroundColour m167 : 24|8@1+ (1,0) [0|255] "" Vector__XXX
 SG_ ErrorCodeChangeColour1 m167 : 32|1@1+ (1,0) [0|1] "" Vector__XXX
 SG_ ErrorCodeChangeColour2 m167 : 33|1@1+ (1,0) [0|1] "" Vector__XXX
 SG_ ErrorCodeChangeColour3 m167 : 36|1@1+ (1,0) [0|1] "" Vector__XXX
 SG_ ObjectToChangeNumValueID m168 : 8|16@1+ (1,0) [0|65535] "" Vector__XXX
 SG_ ErrorCodeChangeNumValue1 m168 : 24|1@1+ (1,0) [0|1] "" Vector__XXX
 SG_ ErrorCodeChangeNumValue2 m168 : 25|1@1+ (1,0) [0|1] "" Vector__XXX
 SG_ ErrorCodeChangeNumValue3 m168 : 28|1@1+ (1,0) [0|1] "" Vector__XXX
 SG_ ValueOfTheObject m168 : 32|32@1+ (1,0) [0|2704] "" Vector__XXX
 SG_ ObjectToChangeEndPointID m169 : 8|16@1+ (1,0) [0|65535] "" Vector__XXX
 SG_ ErrorCodeChangeEditPoint1 m169 : 24|1@1+ (1,0) [0|1] "" Vector__XXX
 SG_ ErrorCodeChangeEditPoint2 m169 : 25|1@1+ (1,0) [0|1] "" Vector__XXX
 SG_ ErrorCodeChangeEditPoint3 m169 : 28|1@1+ (1,0) [0|1] "" Vector__XXX
 SG_ ObjectToChangeFontID m170 : 8|16@1+ (1,0) [0|65535] "" Vector__XXX
 SG_ ErrorCodeChangeFont1 m170 : 24|1@1+ (1,0) [0|1] "" Vector__XXX
 SG_ ErrorCodeChangeFont2 m170 : 25|1@1+ (1,0) [0|1] "" Vector__XXX
 SG_ ErrorCodeChangeFont4 m170 : 27|1@1+ (1,0) [0|1] "" Vector__XXX
 SG_ ErrorCodeChangeFont3 m170 : 26|1@1+ (1,0) [0|1] "" Vector__XXX
 SG_ ErrorCodeChangeFont5 m170 : 28|1@1+ (1,0) [0|1] "" Vector__XXX
 SG_ ErrorCodeChangeFont6 m170 : 29|1@1+ (1,0) [0|1] "" Vector__XXX
 SG_ ObjectToChangeLineAttributeID m171 : 8|16@1+ (1,0) [0|65535] "" Vector__XXX
 SG_ ErrorCodeChangeLineAttribute1 m171 : 24|1@1+ (1,0) [0|1] "" Vector__XXX
 SG_ ErrorCodeChangeLineAttribute2 m171 : 25|1@1+ (1,0) [0|1] "" Vector__XXX
 SG_ ErrorCodeChangeLineAttribute3 m171 : 26|1@1+ (1,0) [0|1] "" Vector__XXX
 SG_ ErrorCodeChangeLineAttribute4 m171 : 28|1@1+ (1,0) [0|1] "" Vector__XXX
 SG_ ObjectToChangeFillAttributesID m172 : 8|16@1+ (1,0) [0|65535] "" Vector__XXX
 SG_ ErrorCodeChangeFillAttributes1 m172 : 24|1@1+ (1,0) [0|1] "" Vector__XXX
 SG_ ErrorCodeChangeFillAttributes2 m172 : 25|1@1+ (1,0) [0|1] "" Vector__XXX
 SG_ ErrorCodeChangeFillAttributes3 m172 : 26|1@1+ (1,0) [0|1] "" Vector__XXX
 SG_ ErrorCodeChangeFillAttributes4 m172 : 27|1@1+ (1,0) [0|1] "" Vector__XXX
 SG_ ErrorCodeChangeFillAttributes5 m172 : 28|1@1+ (1,0) [0|1] "" Vector__XXX
 SG_ ActiveMaskObjectID m173 : 8|16@1+ (1,0) [0|0] "" Vector__XXX
 SG_ ErrorCodeChangeActiveMask1 m173 : 24|1@1+ (1,0) [0|1] "" Vector__XXX
 SG_ ErrorCodeChangeActiveMask2 m173 : 25|1@1+ (1,0) [0|1] "" Vector__XXX
 SG_ ErrorCodeChangeActiveMask3 m173 : 26|1@1+ (1,0) [0|1] "" Vector__XXX
 SG_ ErrorCodeChangeActiveMask4 m173 : 27|1@1+ (1,0) [0|1] "" Vector__XXX
 SG_ ErrorCodeChangeActiveMask5 m173 : 28|1@1+ (1,0) [0|1] "" Vector__XXX
 SG_ DataOrAlarmMaskObjectID m174 : 8|16@1+ (1,0) [0|65535] "" Vector__XXX
 SG_ SoftKeyMaskObjectID m174 : 24|16@1+ (1,0) [0|65535] "" Vector__XXX
 SG_ ErrorCodeChangeSoftKeyMask1 m174 : 40|1@1+ (1,0) [0|1] "" Vector__XXX
 SG_ ErrorCodeChangeSoftKeyMask2 m174 : 41|1@1+ (1,0) [0|1] "" Vector__XXX
 SG_ ErrorCodeChangeSoftKeyMask3 m174 : 42|1@1+ (1,0) [0|1] "" Vector__XXX
 SG_ ErrorCodeChangeSoftKeyMask4 m174 : 43|1@1+ (1,0) [0|1] "" Vector__XXX
 SG_ ErrorCodeChangeSoftKeyMask5 m174 : 44|1@1+ (1,0) [0|1] "" Vector__XXX
 SG_ ObjectToChangeAttributeID m175 : 8|16@1+ (1,0) [0|65535] "" Vector__XXX
 SG_ AttributeID_Change m175 : 24|8@1+ (1,0) [0|65535] "" Vector__XXX
 SG_ ErrorCodeChangeAttribute1 m175 : 32|1@1+ (1,0) [0|1] "" Vector__XXX
 SG_ ErrorCodeChangeAttribute2 m175 : 33|1@1+ (1,0) [0|1] "" Vector__XXX
 SG_ ErrorCodeChangeAttribute3 m175 : 34|1@1+ (1,0) [0|1] "" Vector__XXX
 SG_ ErrorCodeChangeAttribute4 m175 : 36|1@1+ (1,0) [0|1] "" Vector__XXX
 SG_ AlarmMaskObjectID m176 : 8|16@1+ (1,0) [0|65535] "" Vector__XXX
 SG_ NewPriority m176 : 24|8@1+ (1,0) [0|255] "" Vector__XXX
 SG_ ErrorCodeChangePriority1 m176 : 32|1@1+ (1,0) [0|1] "" Vector__XXX
 SG_ ErrorCodeChangePriority2 m176 : 33|1@1+ (1,0) [0|1] "" Vector__XXX
 SG_ ErrorCodeChangePriority3 m176 : 36|1@1+ (1,0) [0|1] "" Vector__XXX
 SG_ ListInputObjectID m177 : 8|16@1+ (1,0) [0|65535] "" Vector__XXX
 SG_ ListIndex m177 : 24|8@1+ (1,0) [0|255] "" Vector__XXX
 SG_ NewObjectID m177 : 32|16@1+ (1,0) [0|65535] "" Vector__XXX
 SG_ ErrorCodeChangeListItem1 m177 : 48|1@1+ (1,0) [0|1] "" Vector__XXX
 SG_ ErrorCodeChangeListItem2 m177 : 49|1@1+ (1,0) [0|1] "" Vector__XXX
 SG_ ErrorCodeChangeListItem3 m177 : 50|1@1+ (1,0) [0|1] "" Vector__XXX
 SG_ ErrorCodeChangeListItem4 m177 : 52|1@1+ (1,0) [0|1] "" Vector__XXX
 SG_ ErrorCodeDeleteObjectPool1 m178 : 8|1@1+ (1,0) [0|1] "" Vector__XXX
 SG_ ErrorCodeDeleteObjectPool2 m178 : 12|1@1+ (1,0) [0|1] "" Vector__XXX
 SG_ ParentObjectID_StringVal m179 : 8|16@1+ (1,0) [0|65535] "" Vector__XXX
 SG_ ObjectToChangeStringValueID m179 : 24|16@1+ (1,0) [0|65535] "" Vector__XXX
 SG_ ErrorCodeChangeStrObjectID m179 : 41|1@1+ (1,0) [0|1] "" Vector__XXX
 SG_ ErrorCodeChangeStrTooLong m179 : 42|1@1+ (1,0) [0|1] "" Vector__XXX
 SG_ ErrorCodeChangeStrError m179 : 43|1@1+ (1,0) [0|1] "" Vector__XXX
 SG_ ParentObjectID_Position m180 : 8|16@1+ (1,0) [0|65535] "" Vector__XXX
 SG_ ObjectToMoveID_Position m180 : 24|16@1+ (1,0) [0|65535] "" Vector__XXX
 SG_ ErrorCodeChangePosInvalidParent m180 : 40|1@1+ (1,0) [0|1] "" Vector__XXX
 SG_ ErrorCodeChangePosInvalidObject m180 : 41|1@1+ (1,0) [0|1] "" Vector__XXX
 SG_ ErrorCodeChangePosInvalidError m180 : 44|1@1+ (1,0) [0|1] "" Vector__XXX
 SG_ ErrorCodeSetObjectLabel1 m181 : 8|1@1+ (1,0) [0|1] "" Vector__XXX
 SG_ ErrorCodeSetObjectLabel2 m181 : 9|1@1+ (1,0) [0|1] "" Vector__XXX
 SG_ ErrorCodeSetObjectLabel3 m181 : 10|1@1+ (1,0) [0|1] "" Vector__XXX
 SG_ ErrorCodeSetObjectLabel4 m181 : 11|1@1+ (1,0) [0|1] "" Vector__XXX
 SG_ ErrorCodeSetObjectLabel5 m181 : 12|1@1+ (1,0) [0|1] "" Vector__XXX
 SG_ ErrorCodeSetObjectLabel6 m181 : 13|1@1+ (1,0) [0|1] "" Vector__XXX
 SG_ PolygonObjectToChangeID m182 : 8|16@1+ (1,0) [0|65535] "" Vector__XXX
 SG_ ErrorCodeChangePoygonPoint1 m182 : 24|1@1+ (1,0) [0|1] "" Vector__XXX
 SG_ ErrorCodeChangePoygonPoint2 m182 : 25|1@1+ (1,0) [0|1] "" Vector__XXX
 SG_ ErrorCodeChangePoygonPoint3 m182 : 26|1@1+ (1,0) [0|1] "" Vector__XXX
 SG_ PolygonObjectToScaleID m183 : 8|16@1+ (1,0) [0|65535] "" Vector__XXX
 SG_ NewWidthAttribute m183 : 24|16@1+ (1,0) [0|65535] "" Vector__XXX
 SG_ NewHeigthAttribute m183 : 40|16@1+ (1,0) [0|0] "" Vector__XXX
 SG_ ErrorCodeChangePolygonScale1 m183 : 56|1@1+ (1,0) [0|1] "" Vector__XXX
 SG_ ErrorCodeChangePolygonScale5 m183 : 60|1@1+ (1,0) [0|1] "" Vector__XXX
 SG_ GraphicsContextObjectID m184 : 8|16@1+ (1,0) [0|65535] "" Vector__XXX
 SG_ SubCommandID m184 : 24|8@1+ (1,0) [0|0] "" Vector__XXX
 SG_ ErrorCodeGraphicsContextCmd1 m184 : 32|1@1+ (1,0) [0|1] "" Vector__XXX
 SG_ ErrorCodeGraphicsContextCmd2 m184 : 33|1@1+ (1,0) [0|1] "" Vector__XXX
 SG_ ErrorCodeGraphicsContextCmd3 m184 : 34|1@1+ (1,0) [0|1] "" Vector__XXX
 SG_ ErrorCodeGraphicsContextCmd4 m184 : 35|1@1+ (1,0) [0|1] "" Vector__XXX
 SG_ ErrorCodeGraphicsContextCmd5 m184 : 36|1@1+ (1,0) [0|1] "" Vector__XXX
 SG_ ObjectToGetAttributeID_Resp m185 : 8|16@1+ (1,0) [0|65535] "" Vector__XXX
 SG_ AttributeID m185 : 24|8@1+ (1,0) [0|0] "" Vector__XXX
 SG_ ColourMapObjectID m186 : 8|16@1+ (1,0) [0|65535] "" Vector__XXX
 SG_ ErrorCodeSelectColourMap2 m186 : 25|1@1+ (1,0) [0|1] "" Vector__XXX
 SG_ ErrorCodeSelectColourMap1 m186 : 24|1@1+ (1,0) [0|1] "" Vector__XXX
 SG_ ErrorCodeLockUnlockMask9 m189 : 24|1@1+ (1,0) [0|1] "" Vector__XXX
 SG_ ErrorCodeLockUnlockMask8 m189 : 23|1@1+ (1,0) [0|1] "" Vector__XXX
 SG_ ErrorCodeLockUnlockMask7 m189 : 22|1@1+ (1,0) [0|1] "" Vector__XXX
 SG_ ErrorCodeLockUnlockMask6 m189 : 21|1@1+ (1,0) [0|1] "" Vector__XXX
 SG_ ErrorCodeLockUnlockMask5 m189 : 20|1@1+ (1,0) [0|1] "" Vector__XXX
 SG_ ErrorCodeLockUnlockMask4 m189 : 19|1@1+ (1,0) [0|1] "" Vector__XXX
 SG_ ErrorCodeLockUnlockMask3 m189 : 18|1@1+ (1,0) [0|1] "" Vector__XXX
 SG_ ErrorCodeLockUnlockMask2 m189 : 17|1@1+ (1,0) [0|1] "" Vector__XXX
 SG_ ErrorCodeLockUnlockMask1 m189 : 16|1@1+ (1,0) [0|1] "" Vector__XXX
 SG_ LockUnlockCommand m189 : 8|8@1+ (1,0) [0|1] "" Vector__XXX
 SG_ MacroObjecID m190 : 8|8@1+ (1,0) [0|255] "" Vector__XXX
 SG_ ErrorCodeExecuteMacro1 m190 : 16|1@1+ (1,0) [0|1] "" Vector__XXX
 SG_ ErrorCodeExecuteMacro2 m190 : 17|1@1+ (1,0) [0|1] "" Vector__XXX
 SG_ ErrorCodeExecuteMacro3 m190 : 18|1@1+ (1,0) [0|1] "" Vector__XXX
 SG_ VersionNumberISO11783Part6 m192 : 8|8@1+ (1,0) [0|255] "" Vector__XXX
 SG_ MemoryStatus m192 : 16|8@1+ (1,0) [0|1] "" Vector__XXX
 SG_ FirstWideChar m193 : 16|16@1+ (1,0) [0|65535] "" Vector__XXX
 SG_ LastWideChar m193 : 32|16@1+ (1,0) [0|65535] "" Vector__XXX
 SG_ ErrorCodeGetSupportedWideChars2 m193 : 52|1@1+ (1,0) [0|1] "" Vector__XXX
 SG_ ErrorCodeGetSupportedWideChars1 m193 : 48|1@1+ (1,0) [0|1] "" Vector__XXX
 SG_ CodePlane m193 : 8|8@1+ (1,0) [0|16] "" Vector__XXX
 SG_ NumberOfRanges m193 : 56|8@1+ (1,0) [0|255] "" Vector__XXX
 SG_ NavigationSoftKeys m194 : 8|8@1+ (1,0) [0|254] "" Vector__XXX
 SG_ XDotsForSoftKeyDescriptor m194 : 32|8@1+ (1,0) [0|255] "" Vector__XXX
 SG_ YDotsForSoftKeyDescriptor m194 : 40|8@1+ (1,0) [0|255] "" Vector__XXX
 SG_ NumberOfPossibleVirtualSoftKeys m194 : 48|8@1+ (1,0) [0|255] "" Vector__XXX
 SG_ NumberOfPhysicalSoftKeys m194 : 56|8@1+ (1,0) [0|255] "" Vector__XXX
 SG_ FontSize_8x8 m195 : 40|1@1+ (1,0) [0|1] "" Vector__XXX
 SG_ FontSize_8x12 m195 : 41|1@1+ (1,0) [0|1] "" Vector__XXX
 SG_ FontSize_12x16 m195 : 42|1@1+ (1,0) [0|1] "" Vector__XXX
 SG_ FontSize_16x16 m195 : 43|1@1+ (1,0) [0|1] "" Vector__XXX
 SG_ FontSize_16x24 m195 : 44|1@1+ (1,0) [0|1] "" Vector__XXX
 SG_ FontSize_24x32 m195 : 45|1@1+ (1,0) [0|1] "" Vector__XXX
 SG_ FontSize_32x32 m195 : 46|1@1+ (1,0) [0|1] "" Vector__XXX
 SG_ FontSize_32x48 m195 : 48|1@1+ (1,0) [0|1] "" Vector__XXX
 SG_ FontSize_48x64 m195 : 49|1@1+ (1,0) [0|1] "" Vector__XXX
 SG_ FontSize_64x64 m195 : 50|1@1+ (1,0) [0|1] "" Vector__XXX
 SG_ FontSize_64x96 m195 : 51|1@1+ (1,0) [0|1] "" Vector__XXX
 SG_ FontSize_96x128 m195 : 52|1@1+ (1,0) [0|1] "" Vector__XXX
 SG_ FontSize_128x128 m195 : 53|1@1+ (1,0) [0|1] "" Vector__XXX
 SG_ FontSize_128x192 m195 : 54|1@1+ (1,0) [0|1] "" Vector__XXX
 SG_ FontType_BoldText m195 : 56|1@1+ (1,0) [0|1] "" Vector__XXX
 SG_ FontType_CrossedOutText m195 : 57|1@1+ (1,0) [0|1] "" Vector__XXX
 SG_ FontType_UnderlinedText m195 : 58|1@1+ (1,0) [0|1] "" Vector__XXX
 SG_ FontType_ItalicsText m195 : 59|1@1+ (1,0) [0|1] "" Vector__XXX
 SG_ FontType_InvertedText m195 : 60|1@1+ (1,0) [0|1] "" Vector__XXX
 SG_ FontType_FlashInverted m195 : 61|1@1+ (1,0) [0|1] "" Vector__XXX
 SG_ FontType_FlashHidden m195 : 62|1@1+ (1,0) [0|1] "" Vector__XXX
 SG_ FontType_ProportionalFont m195 : 63|1@1+ (1,0) [0|1] "" Vector__XXX
 SG_ MaxLineWidth m196 : 8|8@1+ (1,0) [0|255] "" Vector__XXX
 SG_ LineArts m196 : 16|8@1+ (1,0) [0|1] "" Vector__XXX
 SG_ FillTypes m196 : 24|8@1+ (1,0) [0|1] "" Vector__XXX
 SG_ ShapeFillTypes m196 : 32|8@1+ (1,0) [0|3] "" Vector__XXX
 SG_ SupportedGrapicMode m199 : 16|8@1+ (1,0) [0|2] "" Vector__XXX
 SG_ Hardware1 m199 : 24|1@1+ (1,0) [0|1] "" Vector__XXX
 SG_ Hardware2 m199 : 25|1@1+ (1,0) [0|1] "" Vector__XXX
 SG_ Hardware3 m199 : 26|1@1+ (1,0) [0|1] "" Vector__XXX
 SG_ Hardware4 m199 : 27|1@1+ (1,0) [0|1] "" Vector__XXX
 SG_ Hardware5 m199 : 28|1@1+ (1,0) [0|1] "" Vector__XXX
 SG_ Hardware6 m199 : 29|1@1+ (1,0) [0|1] "" Vector__XXX
 SG_ NrOfXPixelsInDataAreaMask m199 : 32|16@1+ (1,0) [0|65535] "" Vector__XXX
 SG_ NrOfYPixelsInDataAreaMask m199 : 48|16@1+ (1,0) [0|65535] "" Vector__XXX
 SG_ AcknowledgmentStoreVersion m208 : 40|4@1+ (1,0) [0|8] "" Vector__XXX
 SG_ AcknowledgmentLoadVersion m209 : 40|4@1+ (1,0) [0|8] "" Vector__XXX
 SG_ AcknowledgmentDeleteVersion m210 : 40|4@1+ (1,0) [0|8] "" Vector__XXX
 SG_ NrOfVersionStrings m224 : 8|8@1+ (1,0) [0|255] "" Vector__XXX
 SG_ VersionLables m224 : 16|56@1+ (1,0) [0|0] "" Vector__XXX
 SG_ VTParentObjectID m240 : 8|16@1+ (1,0) [0|65535] "" Vector__XXX
 SG_ ObjectIDOfFaultyObject m240 : 24|16@1+ (1,0) [0|65535] "" Vector__XXX
 SG_ ErrorCodeVtObjPoolError1 m240 : 40|1@1+ (1,0) [0|1] "" Vector__XXX
 SG_ ErrorCodeVtObjPoolError2 m240 : 41|1@1+ (1,0) [0|1] "" Vector__XXX
 SG_ ErrorCodeVtObjPoolError3 m240 : 42|1@1+ (1,0) [0|1] "" Vector__XXX
 SG_ ErrorCodeVtObjPoolError4 m240 : 43|1@1+ (1,0) [0|1] "" Vector__XXX
 SG_ SourceAdressOfActiveWSM m254 : 8|8@1+ (1,0) [0|255] "" Vector__XXX
 SG_ VisibleDataOrAlarmMaskObjectID m254 : 16|16@1+ (1,0) [0|65535] "" Vector__XXX
 SG_ VisibleSoftKeyMaskObjectID m254 : 32|16@1+ (1,0) [0|65535] "" Vector__XXX
 SG_ VTBusyCode1 m254 : 48|1@1+ (1,0) [0|1] "" Vector__XXX
 SG_ VTBusyCode2 m254 : 49|1@1+ (1,0) [0|1] "" Vector__XXX
 SG_ VTBusyCode3 m254 : 50|1@1+ (1,0) [0|1] "" Vector__XXX
 SG_ VTBusyCode4 m254 : 51|1@1+ (1,0) [0|1] "" Vector__XXX
 SG_ VTBusyCode5 m254 : 52|1@1+ (1,0) [0|1] "" Vector__XXX
 SG_ VTBusyCode8 m254 : 55|1@1+ (1,0) [0|1] "" Vector__XXX
 SG_ VTFunctionCode m254 : 56|8@1+ (1,0) [0|255] "" Vector__XXX

BO_ 2566835454 DM3: 0 Vector__XXX

CM_ BU_ VT "Virtual Terminal";
CM_ BU_ Sprayer "Sprayer Implement";
CM_ BU_ Loader "Loader Implement";
CM_ BU_ AuxInput "Auxiliary Key Input";
CM_ BO_ 3221225472 "This is a message for not used signals, created by Vector CANdb++ DBC OLE DB Provider.";
CM_ SG_ 3221225472 AuxModelIdentification "Model Identification Code of the Auxiliary Input UnitModel Identification Code of the Auxiliary Input Unit";
CM_ SG_ 3221225472 AuxInputEnable "Auxiliary Input EnableAuxiliary Input EnableAuxiliary Input EnableAuxiliary Input Enable";
CM_ SG_ 3221225472 AuxErrorInvalidInputID "Invalid Auxiliary Input Object IDInvalid Auxiliary Input Object ID";
CM_ SG_ 3221225472 AuxErrorAnyOther "Any other errorAny other error";
CM_ SG_ 3221225472 ErrorCodeAnyOtherError "VT change mask error code: Any other errorVT change mask error code: Any other error";
CM_ SG_ 3221225472 ErrorCodePoolDeleted "VT change mask error code: Pool being deletedVT change mask error code: Pool being deleted";
CM_ SG_ 3221225472 VTChangeActiveMaskErrorID "Object ID containing errorObject ID containing error";
CM_ SG_ 3221225472 VTChangeActiveMaskParentID "Parent object ID of error object IDParent object ID of error object ID";
CM_ SG_ 3221225472 AuxiliaryFunctionType "Auxiliary function type of assigned auxiliary inputAuxiliary function type of assigned auxiliary input";
CM_ SG_ 3221225472 MaxLineWidth "Maximum pen and line thickness in pixels.
Any larger values inside attributes are automatically reduced to this value by the VT.Maximum pen and line thickness in pixels.
Any larger values inside attributes are automatically reduced to this value by the VT.";
CM_ BO_ 2365194522 "Weeder";
CM_ SG_ 2365194522 Capacity "WeederCapacityperTime";
CM_ SG_ 2365194522 Quality "WeedingQuality";
CM_ BO_ 2565340800 "ECU to VT";
CM_ SG_ 2565340800 AuxModelIdentification "Model Identification Code of the Auxiliary Input Unit";
CM_ SG_ 2565340800 AuxInputEnable "Auxiliary Input Enable";
CM_ SG_ 2565340800 AuxErrorInvalidInputID "Invalid Auxiliary Input Object ID";
CM_ SG_ 2565340800 AuxErrorAnyOther "Any other error";
CM_ BO_ 2565340802 "ECU to VT";
CM_ SG_ 2565340802 AuxModelIdentification "Model Identification Code of the Auxiliary Input Unit";
CM_ SG_ 2565340802 AuxInputEnable "Auxiliary Input Enable";
CM_ SG_ 2565340802 AuxErrorInvalidInputID "Invalid Auxiliary Input Object ID";
CM_ SG_ 2565340802 AuxErrorAnyOther "Any other error";
CM_ BO_ 2632384130 "VT to ECU";
CM_ SG_ 2632384130 ErrorCodeAnyOtherError "VT change mask error code: Any other error";
CM_ SG_ 2632384130 ErrorCodePoolDeleted "VT change mask error code: Pool being deleted";
CM_ SG_ 2632384130 VTChangeActiveMaskErrorID "Object ID containing error";
CM_ SG_ 2632384130 VTChangeActiveMaskParentID "Parent object ID of error object ID";
CM_ SG_ 2632384130 AuxiliaryFunctionType "Auxiliary function type of assigned auxiliary input";
CM_ SG_ 2632384130 AuxInputEnable "Auxiliary Input Enable";
CM_ SG_ 2632384130 MaxLineWidth "Maximum pen and line thickness in pixels.
Any larger values inside attributes are automatically reduced to this value by the VT.";
CM_ BO_ 2566835454 "Diagnostic data clear/reset of previously active DTCs.";
BA_DEF_ BU_  "ISO11783IOPVersion" ENUM  "1","2","3","4";
BA_DEF_ BU_  "ISO11783IOPFilename" STRING ;
BA_DEF_  "ISO11783_12_SpecVersion" STRING ;
BA_DEF_ SG_  "SigType" ENUM  "Default","Range","RangeSigned","ASCII","Discrete","Control","ReferencePGN","DTC","StringDelimiter","StringLength","StringLengthControl";
BA_DEF_  "DatabaseVersion" STRING ;
BA_DEF_ SG_  "SPN" INT 0 524287;
BA_DEF_ BO_  "GenMsgRequestable" INT 0 1;
BA_DEF_ BO_  "GenMsgCycleTime" INT 0 3600000;
BA_DEF_ BO_  "GenMsgSendType" ENUM  "cyclic","reserved","cyclicIfActive","reserved","reserved","reserved","reserved","reserved","noMsgSendType","vector_leerstring";
BA_DEF_ BO_  "VFrameFormat" ENUM  "StandardCAN","ExtendedCAN","reserved","J1939PG","vector_leerstring";
BA_DEF_ BU_  "ECU" STRING ;
BA_DEF_ BU_  "NmJ1939IdentityNumber" INT 0 2097151;
BA_DEF_ BU_  "NmJ1939ManufacturerCode" INT 0 2047;
BA_DEF_ BU_  "NmJ1939ECUInstance" INT 0 7;
BA_DEF_ BU_  "NmJ1939FunctionInstance" INT 0 7;
BA_DEF_ BU_  "NmJ1939Function" INT 0 255;
BA_DEF_ BU_  "NmJ1939SystemInstance" INT 0 15;
BA_DEF_ BU_  "NmJ1939System" INT 0 127;
BA_DEF_ BU_  "NmJ1939IndustryGroup" INT 0 7;
BA_DEF_ BU_  "NmJ1939AAC" INT 0 1;
BA_DEF_ BU_  "NmStationAddress" INT 0 255;
BA_DEF_  "BusType" STRING ;
BA_DEF_  "ProtocolType" STRING ;
BA_DEF_ BU_  "NodeLayerModules" STRING ;
BA_DEF_ BO_  "SingleFrame" INT 0 1;
BA_DEF_ SG_  "DDI" INT 0 65535;
BA_DEF_  "ISO11783_6_SpecVersion" STRING ;
BA_DEF_  "ISO11783_7_SpecVersion" STRING ;
BA_DEF_  "ISO11783_11_SpecVersion" STRING ;
BA_DEF_DEF_  "ISO11783IOPVersion" "4";
BA_DEF_DEF_  "ISO11783IOPFilename" "";
BA_DEF_DEF_  "ISO11783_12_SpecVersion" "";
BA_DEF_DEF_  "SigType" "Default";
BA_DEF_DEF_  "DatabaseVersion" "";
BA_DEF_DEF_  "SPN" 0;
BA_DEF_DEF_  "GenMsgRequestable" 1;
BA_DEF_DEF_  "GenMsgCycleTime" 0;
BA_DEF_DEF_  "GenMsgSendType" "noMsgSendType";
BA_DEF_DEF_  "VFrameFormat" "J1939PG";
BA_DEF_DEF_  "ECU" "";
BA_DEF_DEF_  "NmJ1939IdentityNumber" 0;
BA_DEF_DEF_  "NmJ1939ManufacturerCode" 0;
BA_DEF_DEF_  "NmJ1939ECUInstance" 0;
BA_DEF_DEF_  "NmJ1939FunctionInstance" 0;
BA_DEF_DEF_  "NmJ1939Function" 0;
BA_DEF_DEF_  "NmJ1939SystemInstance" 0;
BA_DEF_DEF_  "NmJ1939System" 0;
BA_DEF_DEF_  "NmJ1939IndustryGroup" 0;
BA_DEF_DEF_  "NmJ1939AAC" 0;
BA_DEF_DEF_  "NmStationAddress" 254;
BA_DEF_DEF_  "BusType" "";
BA_DEF_DEF_  "ProtocolType" "";
BA_DEF_DEF_  "NodeLayerModules" "";
BA_DEF_DEF_  "SingleFrame" 1;
BA_DEF_DEF_  "DDI" 0;
BA_DEF_DEF_  "ISO11783_6_SpecVersion" "";
BA_DEF_DEF_  "ISO11783_7_SpecVersion" "";
BA_DEF_DEF_  "ISO11783_11_SpecVersion" "";
BA_ "BusType" "CAN";
BA_ "ISO11783_11_SpecVersion" "2007-01-15 DIS";
BA_ "ISO11783_7_SpecVersion" "2007-03-17 DIS";
BA_ "ISO11783_6_SpecVersion" "2007-02-26 DIS";
BA_ "ProtocolType" "ISO11783";
BA_ "DatabaseVersion" "4.1";
BA_ "ISO11783_12_SpecVersion" "2006-10-24 DIS";
BA_ "NmStationAddress" BU_ SEND 131;
BA_ "NmStationAddress" BU_ VT 38;
BA_ "NmJ1939AAC" BU_ VT 1;
BA_ "NmJ1939IndustryGroup" BU_ VT 2;
BA_ "NmJ1939System" BU_ VT 1;
BA_ "NmJ1939Function" BU_ VT 29;
BA_ "NmJ1939ManufacturerCode" BU_ VT 1861;
BA_ "ECU" BU_ VT "VT";
BA_ "NodeLayerModules" BU_ Sprayer "Iso11783_IL.vmodule";
BA_ "NmStationAddress" BU_ Sprayer 128;
BA_ "NmJ1939AAC" BU_ Sprayer 1;
BA_ "NmJ1939IndustryGroup" BU_ Sprayer 2;
BA_ "NmJ1939System" BU_ Sprayer 6;
BA_ "NmJ1939Function" BU_ Sprayer 132;
BA_ "NmJ1939ManufacturerCode" BU_ Sprayer 1861;
BA_ "NmJ1939IdentityNumber" BU_ Sprayer 701231;
BA_ "ECU" BU_ Sprayer "Sprayer";
BA_ "ISO11783IOPFilename" BU_ Sprayer "ObjectPools/Sprayer.iop";
BA_ "ISO11783IOPVersion" BU_ Loader 2;
BA_ "ISO11783IOPFilename" BU_ Loader "ObjectPools/Loader.iop";
BA_ "NodeLayerModules" BU_ Loader "Iso11783_IL.vmodule";
BA_ "NmStationAddress" BU_ Loader 129;
BA_ "NmJ1939AAC" BU_ Loader 1;
BA_ "NmJ1939IndustryGroup" BU_ Loader 2;
BA_ "NmJ1939Function" BU_ Loader 132;
BA_ "NmJ1939ManufacturerCode" BU_ Loader 1861;
BA_ "NmJ1939IdentityNumber" BU_ Loader 701232;
BA_ "ECU" BU_ Loader "Loader";
BA_ "NodeLayerModules" BU_ AuxInput "Iso11783_IL.vmodule";
BA_ "NmStationAddress" BU_ AuxInput 130;
BA_ "NmJ1939AAC" BU_ AuxInput 1;
BA_ "NmJ1939IndustryGroup" BU_ AuxInput 2;
BA_ "NmJ1939Function" BU_ AuxInput 66;
BA_ "NmJ1939ManufacturerCode" BU_ AuxInput 1861;
BA_ "NmJ1939IdentityNumber" BU_ AuxInput 701233;
BA_ "ECU" BU_ AuxInput "AuxInput";
BA_ "ISO11783IOPFilename" BU_ AuxInput "ObjectPools/AuxInput.iop";
BA_ "ISO11783IOPVersion" BU_ AuxInput 2;
BA_ "GenMsgCycleTime" BO_ 2565340800 1000;
BA_ "GenMsgSendType" BO_ 2565340800 2;
BA_ "GenMsgCycleTime" BO_ 2565340802 1000;
BA_ "GenMsgSendType" BO_ 2565340802 2;
BA_ "GenMsgCycleTime" BO_ 2632384130 100;
BA_ "SigType" SG_ 3221225472 VTFunctionECUtoVT 1;
BA_ "SigType" SG_ 3221225472 KeyActivationCode 1;
BA_ "SigType" SG_ 3221225472 KeyObjectParentID 1;
BA_ "SigType" SG_ 3221225472 KeyObjectID 1;
BA_ "SigType" SG_ 3221225472 SoftKeyCode 1;
BA_ "SigType" SG_ 3221225472 ButtonActivationCode 1;
BA_ "SigType" SG_ 3221225472 ButtonObjectID 1;
BA_ "SigType" SG_ 3221225472 ButtonObjectParentID 1;
BA_ "SigType" SG_ 3221225472 ButtonKeyCode 1;
BA_ "SigType" SG_ 3221225472 XPosition 1;
BA_ "SigType" SG_ 3221225472 YPosition 1;
BA_ "SigType" SG_ 3221225472 VTSelectInputObjectID 1;
BA_ "SigType" SG_ 3221225472 VTSelectInputObjectStatus 1;
BA_ "SigType" SG_ 3221225472 VTEscObjectID 1;
BA_ "SigType" SG_ 3221225472 VTChangeNumericValueObjectID 1;
BA_ "SigType" SG_ 3221225472 VTChangeNumericValueValue 1;
BA_ "SigType" SG_ 3221225472 VTChangeActiveMaskObjectID 1;
BA_ "SigType" SG_ 3221225472 VTChangeSoftKeyMaskParentID 1;
BA_ "SigType" SG_ 3221225472 VTChangeSoftKeyMaskObjectID 1;
BA_ "SigType" SG_ 3221225472 ParentObjectID 1;
BA_ "SigType" SG_ 3221225472 ObjectToChangeStringValueID 1;
BA_ "SigType" SG_ 3221225472 ObjectPoolRecord 1;
BA_ "SigType" SG_ 3221225472 AuxiliaryFunctionObjectID 1;
BA_ "SigType" SG_ 3221225472 AssignmentErrorNotAccepted 4;
BA_ "SigType" SG_ 3221225472 InputStatusObjectId 1;
BA_ "SigType" SG_ 3221225472 ObjectToShowHideID 1;
BA_ "SigType" SG_ 3221225472 ShowOrHide 1;
BA_ "SigType" SG_ 3221225472 ObjectoEnableDisbaleID 1;
BA_ "SigType" SG_ 3221225472 EnableOrDisable 1;
BA_ "SigType" SG_ 3221225472 SelectInputObjectID 1;
BA_ "SigType" SG_ 3221225472 NumberOfRepetitions_Audio 1;
BA_ "SigType" SG_ 3221225472 Frequency_Audio 1;
BA_ "SigType" SG_ 3221225472 OnTimeDuration_Audio 1;
BA_ "SigType" SG_ 3221225472 OffTimeDuration_Audio 1;
BA_ "SigType" SG_ 3221225472 AudioVolume 1;
BA_ "SigType" SG_ 3221225472 ObjectToMoveID 1;
BA_ "SigType" SG_ 3221225472 XPosChangeTopLeft 1;
BA_ "SigType" SG_ 3221225472 YPosChangeTopLeft 1;
BA_ "SigType" SG_ 3221225472 ObjectToSizeID 1;
BA_ "SigType" SG_ 3221225472 NewWidth 1;
BA_ "SigType" SG_ 3221225472 NewHeight 1;
BA_ "SigType" SG_ 3221225472 ObjectToChangeColourID 1;
BA_ "SigType" SG_ 3221225472 NewBackgroundColour 1;
BA_ "SigType" SG_ 3221225472 ObjectToChangeNumValueID 1;
BA_ "SigType" SG_ 3221225472 NewValue 1;
BA_ "SigType" SG_ 3221225472 ObjectToChangeEndPointID 1;
BA_ "SigType" SG_ 3221225472 Width 1;
BA_ "SigType" SG_ 3221225472 Height 1;
BA_ "SigType" SG_ 3221225472 LineDirection 1;
BA_ "SigType" SG_ 3221225472 ObjectToChangeFontID 1;
BA_ "SigType" SG_ 3221225472 FontColour 1;
BA_ "SigType" SG_ 3221225472 FontSize 1;
BA_ "SigType" SG_ 3221225472 FontType 1;
BA_ "SigType" SG_ 3221225472 FontStyle 1;
BA_ "SigType" SG_ 3221225472 ObjectToChangeLineAttributesID 1;
BA_ "SigType" SG_ 3221225472 LineColour 1;
BA_ "SigType" SG_ 3221225472 LineWidth 1;
BA_ "SigType" SG_ 3221225472 LineArt 1;
BA_ "SigType" SG_ 3221225472 ObjectToChangeFillAttributesID 1;
BA_ "SigType" SG_ 3221225472 FillType 1;
BA_ "SigType" SG_ 3221225472 FillColour 1;
BA_ "SigType" SG_ 3221225472 FillPatternObjectID 1;
BA_ "SigType" SG_ 3221225472 WorkingSetObjectID 1;
BA_ "SigType" SG_ 3221225472 NewActiveMaskObjectID 1;
BA_ "SigType" SG_ 3221225472 MaskType 1;
BA_ "SigType" SG_ 3221225472 DataOrAlarmMaskObjectID 1;
BA_ "SigType" SG_ 3221225472 NewSoftKeyMaskObjectID 1;
BA_ "SigType" SG_ 3221225472 ObjectToChangeAttributeID 1;
BA_ "SigType" SG_ 3221225472 AttributeID 1;
BA_ "SigType" SG_ 3221225472 NewAttributeValue 1;
BA_ "SigType" SG_ 3221225472 AlarmMaskObjectID 1;
BA_ "SigType" SG_ 3221225472 NewPriority 1;
BA_ "SigType" SG_ 3221225472 ListInputObjectID 1;
BA_ "SigType" SG_ 3221225472 ListIndex 1;
BA_ "SigType" SG_ 3221225472 NewObjectID 1;
BA_ "SigType" SG_ 3221225472 NewStringValue 9;
BA_ "SigType" SG_ 3221225472 MemoryRequired 1;
BA_ "SigType" SG_ 3221225472 VersionLabelToStore 3;
BA_ "SigType" SG_ 3221225472 VersionLabelToLoad 3;
BA_ "SigType" SG_ 3221225472 VersionLabelToDelete 3;
BA_ "SigType" SG_ 3221225472 VTFunctionVTtoECU 1;
BA_ "SigType" SG_ 3221225472 VTSelectInputObjectIsEdited 1;
BA_ "SigType" SG_ 3221225472 ErrorCodeVTEsc1 4;
BA_ "SigType" SG_ 3221225472 ErrorCodeVTEsc2 4;
BA_ "SigType" SG_ 3221225472 ErrorCodeMissingObjects 4;
BA_ "SigType" SG_ 3221225472 ErrorCodeMaskOrChildObjectError 4;
BA_ "SigType" SG_ 3221225472 ErrorCodeAnyOtherError 4;
BA_ "SigType" SG_ 3221225472 ErrorCodePoolDeleted 4;
BA_ "SigType" SG_ 3221225472 VTChangeActiveMaskErrorID 1;
BA_ "SigType" SG_ 3221225472 VTChangeActiveMaskParentID 1;
BA_ "SigType" SG_ 3221225472 ErrorCodeVTChangeSoftKeyMask1 4;
BA_ "SigType" SG_ 3221225472 ErrorCodeVTChangeSoftKeyMask2 4;
BA_ "SigType" SG_ 3221225472 ErrorCodeVTChangeSoftKeyMask3 4;
BA_ "SigType" SG_ 3221225472 ErrorCodeVTChangeSoftKeyMask4 4;
BA_ "SigType" SG_ 3221225472 ErrorCodeVTChangeSoftKeyMask5 4;
BA_ "SigType" SG_ 3221225472 ObjectToChangeStringID 1;
BA_ "SigType" SG_ 3221225472 EnteredStringValue 9;
BA_ "SigType" SG_ 3221225472 ErrorCodeEndOfObjectPool1 4;
BA_ "SigType" SG_ 3221225472 ErrorCodeEndOfObjectPool2 4;
BA_ "SigType" SG_ 3221225472 ErrorCodeEndOfObjectPool3 4;
BA_ "SigType" SG_ 3221225472 ParentObjectIdOfFaultyObject 1;
BA_ "SigType" SG_ 3221225472 ObjectIdOfFaultyObject 1;
BA_ "SigType" SG_ 3221225472 ErrorCodeObjectPool1 4;
BA_ "SigType" SG_ 3221225472 ErrorCodeObjectPool2 4;
BA_ "SigType" SG_ 3221225472 ErrorCodeObjectPool3 4;
BA_ "SigType" SG_ 3221225472 ErrorCodeObjectPool4 4;
BA_ "SigType" SG_ 3221225472 IdentityNumber 1;
BA_ "SigType" SG_ 3221225472 ManufacturerCode 1;
BA_ "SigType" SG_ 3221225472 ECUInstance 4;
BA_ "SigType" SG_ 3221225472 FunctionInstance 1;
BA_ "SigType" SG_ 3221225472 AuxiliaryInputObjectID 1;
BA_ "SigType" SG_ 3221225472 InputObjectId 1;
BA_ "SigType" SG_ 3221225472 Value1 1;
BA_ "SigType" SG_ 3221225472 Function 1;
BA_ "SigType" SG_ 3221225472 DeviceClass 1;
BA_ "SigType" SG_ 3221225472 IndustryGroup 4;
BA_ "SigType" SG_ 3221225472 DeviceClassInstance 4;
BA_ "SigType" SG_ 3221225472 SelfConfigurableAddress 4;
BA_ "SigType" SG_ 3221225472 Value2 1;
BA_ "SigType" SG_ 3221225472 ObjectEscapeID 1;
BA_ "SigType" SG_ 3221225472 ErrorCodeEscapeObj1 4;
BA_ "SigType" SG_ 3221225472 ErrorCodeEscapeObj2 4;
BA_ "SigType" SG_ 3221225472 ObjectToHideShowID 1;
BA_ "SigType" SG_ 3221225472 ObjectShowStatus 1;
BA_ "SigType" SG_ 3221225472 ErrorCodeHideShowObj1 4;
BA_ "SigType" SG_ 3221225472 ErrorCodeHideShowObj2 4;
BA_ "SigType" SG_ 3221225472 ErrorCodeHideShowObj3 4;
BA_ "SigType" SG_ 3221225472 ObjectToEnableDisableID 1;
BA_ "SigType" SG_ 3221225472 ObjectEnableStatus 1;
BA_ "SigType" SG_ 3221225472 ErrorCodeEnableDisableObj1 4;
BA_ "SigType" SG_ 3221225472 ErrorCodeEnableDisableObj2 4;
BA_ "SigType" SG_ 3221225472 ErrorCodeEnableDisableObj3 4;
BA_ "SigType" SG_ 3221225472 ErrorCodeEnableDisableObj4 4;
BA_ "SigType" SG_ 3221225472 ObjectSelectStatus 1;
BA_ "SigType" SG_ 3221225472 ErrorCodeSelectObject1 4;
BA_ "SigType" SG_ 3221225472 ErrorCodeSelectObject2 4;
BA_ "SigType" SG_ 3221225472 ErrorCodeSelectObject3 4;
BA_ "SigType" SG_ 3221225472 ErrorCodeSelectObject4 4;
BA_ "SigType" SG_ 3221225472 ErrorCodeSelectObject5 4;
BA_ "SigType" SG_ 3221225472 ErrorCodeControlAudioDevice1 4;
BA_ "SigType" SG_ 3221225472 ErrorCodeControlAudioDevice2 4;
BA_ "SigType" SG_ 3221225472 ErrorCodeAudioVolume1 4;
BA_ "SigType" SG_ 3221225472 ErrorCodeAudioVolume2 4;
BA_ "SigType" SG_ 3221225472 ErrorCodeChangeChildLocation1 4;
BA_ "SigType" SG_ 3221225472 ErrorCodeChangeChildLocation2 4;
BA_ "SigType" SG_ 3221225472 ErrorCodeChangeChildLocation5 4;
BA_ "SigType" SG_ 3221225472 ErrorCodeObjToSize1 4;
BA_ "SigType" SG_ 3221225472 ErrorCodeObjToSize2 4;
BA_ "SigType" SG_ 3221225472 ErrorCodeObjToSize3 4;
BA_ "SigType" SG_ 3221225472 ErrorCodeObjToSize4 4;
BA_ "SigType" SG_ 3221225472 ErrorCodeChangeColour1 4;
BA_ "SigType" SG_ 3221225472 ErrorCodeChangeColour2 4;
BA_ "SigType" SG_ 3221225472 ErrorCodeChangeColour3 4;
BA_ "SigType" SG_ 3221225472 ErrorCodeChangeNumValue1 4;
BA_ "SigType" SG_ 3221225472 ErrorCodeChangeNumValue2 4;
BA_ "SigType" SG_ 3221225472 ErrorCodeChangeNumValue3 4;
BA_ "SigType" SG_ 3221225472 ValueOfTheObject 1;
BA_ "SigType" SG_ 3221225472 ErrorCodeChangeEditPoint1 4;
BA_ "SigType" SG_ 3221225472 ErrorCodeChangeEditPoint2 4;
BA_ "SigType" SG_ 3221225472 ErrorCodeChangeEditPoint3 4;
BA_ "SigType" SG_ 3221225472 ErrorCodeChangeFont1 4;
BA_ "SigType" SG_ 3221225472 ErrorCodeChangeFont2 4;
BA_ "SigType" SG_ 3221225472 ErrorCodeChangeFont4 4;
BA_ "SigType" SG_ 3221225472 ErrorCodeChangeFont3 4;
BA_ "SigType" SG_ 3221225472 ErrorCodeChangeFont5 4;
BA_ "SigType" SG_ 3221225472 ErrorCodeChangeFont6 4;
BA_ "SigType" SG_ 3221225472 ObjectToChangeLineAttributeID 1;
BA_ "SigType" SG_ 3221225472 ErrorCodeChangeLineAttribute1 4;
BA_ "SigType" SG_ 3221225472 ErrorCodeChangeLineAttribute2 4;
BA_ "SigType" SG_ 3221225472 ErrorCodeChangeLineAttribute3 4;
BA_ "SigType" SG_ 3221225472 ErrorCodeChangeLineAttribute4 4;
BA_ "SigType" SG_ 3221225472 ErrorCodeChangeFillAttributes1 4;
BA_ "SigType" SG_ 3221225472 ErrorCodeChangeFillAttributes2 4;
BA_ "SigType" SG_ 3221225472 ErrorCodeChangeFillAttributes3 4;
BA_ "SigType" SG_ 3221225472 ErrorCodeChangeFillAttributes4 4;
BA_ "SigType" SG_ 3221225472 ErrorCodeChangeFillAttributes5 4;
BA_ "SigType" SG_ 3221225472 ActiveMaskObjectID 1;
BA_ "SigType" SG_ 3221225472 ErrorCodeChangeActiveMask1 4;
BA_ "SigType" SG_ 3221225472 ErrorCodeChangeActiveMask2 4;
BA_ "SigType" SG_ 3221225472 ErrorCodeChangeActiveMask3 4;
BA_ "SigType" SG_ 3221225472 ErrorCodeChangeActiveMask4 4;
BA_ "SigType" SG_ 3221225472 ErrorCodeChangeActiveMask5 4;
BA_ "SigType" SG_ 3221225472 SoftKeyMaskObjectID 1;
BA_ "SigType" SG_ 3221225472 ErrorCodeChangeSoftKeyMask1 4;
BA_ "SigType" SG_ 3221225472 ErrorCodeChangeSoftKeyMask2 4;
BA_ "SigType" SG_ 3221225472 ErrorCodeChangeSoftKeyMask3 4;
BA_ "SigType" SG_ 3221225472 ErrorCodeChangeSoftKeyMask4 4;
BA_ "SigType" SG_ 3221225472 ErrorCodeChangeSoftKeyMask5 4;
BA_ "SigType" SG_ 3221225472 ErrorCodeChangeAttribute1 4;
BA_ "SigType" SG_ 3221225472 ErrorCodeChangeAttribute2 4;
BA_ "SigType" SG_ 3221225472 ErrorCodeChangeAttribute3 4;
BA_ "SigType" SG_ 3221225472 ErrorCodeChangeAttribute4 4;
BA_ "SigType" SG_ 3221225472 ErrorCodeChangePriority1 4;
BA_ "SigType" SG_ 3221225472 ErrorCodeChangePriority2 4;
BA_ "SigType" SG_ 3221225472 ErrorCodeChangePriority3 4;
BA_ "SigType" SG_ 3221225472 ErrorCodeChangeListItem1 4;
BA_ "SigType" SG_ 3221225472 ErrorCodeChangeListItem2 4;
BA_ "SigType" SG_ 3221225472 ErrorCodeChangeListItem3 4;
BA_ "SigType" SG_ 3221225472 ErrorCodeChangeListItem4 4;
BA_ "SigType" SG_ 3221225472 ErrorCodeDeleteObjectPool1 4;
BA_ "SigType" SG_ 3221225472 ErrorCodeDeleteObjectPool2 4;
BA_ "SigType" SG_ 3221225472 ErrorCodeChangeStrObjectID 4;
BA_ "SigType" SG_ 3221225472 ErrorCodeChangeStrTooLong 4;
BA_ "SigType" SG_ 3221225472 ErrorCodeChangeStrError 4;
BA_ "SigType" SG_ 3221225472 ErrorCodeChangePosInvalidParent 4;
BA_ "SigType" SG_ 3221225472 ErrorCodeChangePosInvalidObject 4;
BA_ "SigType" SG_ 3221225472 ErrorCodeChangePosInvalidError 4;
BA_ "SigType" SG_ 3221225472 VersionNumberISO11783Part6 1;
BA_ "SigType" SG_ 3221225472 MemoryStatus 1;
BA_ "SigType" SG_ 3221225472 XDotsForSoftKeyDescriptor 1;
BA_ "SigType" SG_ 3221225472 YDotsForSoftKeyDescriptor 1;
BA_ "SigType" SG_ 3221225472 NumberOfPossibleVirtualSoftKeys 1;
BA_ "SigType" SG_ 3221225472 NumberOfPhysicalSoftKeys 1;
BA_ "SigType" SG_ 3221225472 FontSize_8x8 4;
BA_ "SigType" SG_ 3221225472 FontSize_8x12 4;
BA_ "SigType" SG_ 3221225472 FontSize_12x16 4;
BA_ "SigType" SG_ 3221225472 FontSize_16x16 4;
BA_ "SigType" SG_ 3221225472 FontSize_16x24 4;
BA_ "SigType" SG_ 3221225472 FontSize_24x32 4;
BA_ "SigType" SG_ 3221225472 FontSize_32x32 4;
BA_ "SigType" SG_ 3221225472 FontSize_32x48 4;
BA_ "SigType" SG_ 3221225472 FontSize_48x64 4;
BA_ "SigType" SG_ 3221225472 FontSize_64x64 4;
BA_ "SigType" SG_ 3221225472 FontSize_64x96 4;
BA_ "SigType" SG_ 3221225472 FontSize_96x128 4;
BA_ "SigType" SG_ 3221225472 FontSize_128x128 4;
BA_ "SigType" SG_ 3221225472 FontSize_128x192 4;
BA_ "SigType" SG_ 3221225472 FontType_BoldText 4;
BA_ "SigType" SG_ 3221225472 FontType_CrossedOutText 4;
BA_ "SigType" SG_ 3221225472 FontType_UnderlinedText 4;
BA_ "SigType" SG_ 3221225472 FontType_ItalicsText 4;
BA_ "SigType" SG_ 3221225472 FontType_InvertedText 4;
BA_ "SigType" SG_ 3221225472 FontType_FlashInverted 4;
BA_ "SigType" SG_ 3221225472 FontType_FlashHidden 4;
BA_ "SigType" SG_ 3221225472 FontType_ProportionalFont 4;
BA_ "SigType" SG_ 3221225472 MaxLineWidth 1;
BA_ "SigType" SG_ 3221225472 LineArts 1;
BA_ "SigType" SG_ 3221225472 FillTypes 1;
BA_ "SigType" SG_ 3221225472 ShapeFillTypes 1;
BA_ "SigType" SG_ 3221225472 SupportedGrapicMode 1;
BA_ "SigType" SG_ 3221225472 Hardware1 4;
BA_ "SigType" SG_ 3221225472 Hardware2 4;
BA_ "SigType" SG_ 3221225472 Hardware3 4;
BA_ "SigType" SG_ 3221225472 Hardware4 4;
BA_ "SigType" SG_ 3221225472 NrOfXPixelsInDataAreaMask 1;
BA_ "SigType" SG_ 3221225472 NrOfYPixelsInDataAreaMask 1;
BA_ "SigType" SG_ 3221225472 AcknowledgmentStoreVersion 4;
BA_ "SigType" SG_ 3221225472 AcknowledgmentLoadVersion 4;
BA_ "SigType" SG_ 3221225472 AcknowledgmentDeleteVersion 4;
BA_ "SigType" SG_ 3221225472 NrOfVersionStrings 1;
BA_ "SigType" SG_ 3221225472 VersionLables 3;
BA_ "SigType" SG_ 3221225472 ObjectIDOfFaultyObject 1;
BA_ "SigType" SG_ 3221225472 ErrorCodeVtObjPoolError1 4;
BA_ "SigType" SG_ 3221225472 ErrorCodeVtObjPoolError2 4;
BA_ "SigType" SG_ 3221225472 ErrorCodeVtObjPoolError3 4;
BA_ "SigType" SG_ 3221225472 ErrorCodeVtObjPoolError4 4;
BA_ "SigType" SG_ 3221225472 SourceAdressOfActiveWSM 1;
BA_ "SigType" SG_ 3221225472 VisibleDataOrAlarmMaskObjectID 1;
BA_ "SigType" SG_ 3221225472 VisibleSoftKeyMaskObjectID 1;
BA_ "SigType" SG_ 3221225472 VTBusyCode1 4;
BA_ "SigType" SG_ 3221225472 VTBusyCode2 4;
BA_ "SigType" SG_ 3221225472 VTBusyCode3 4;
BA_ "SigType" SG_ 3221225472 VTBusyCode4 4;
BA_ "SigType" SG_ 3221225472 VTBusyCode5 4;
BA_ "SigType" SG_ 3221225472 VTBusyCode8 4;
BA_ "SigType" SG_ 3221225472 VTFunctionCode 1;
BA_ "SigType" SG_ 3221225472 ParentObjectID_Location 1;
BA_ "SigType" SG_ 3221225472 ObjectToMoveID_Location 1;
BA_ "SigType" SG_ 3221225472 AttributeID_Change 1;
BA_ "DDI" SG_ 2365194522 Capacity 151;
BA_ "DDI" SG_ 2365194522 Quality 151;
BA_ "SigType" SG_ 2565340800 VTFunctionECUtoVT 1;
BA_ "SigType" SG_ 2565340800 KeyActivationCode 1;
BA_ "SigType" SG_ 2565340800 KeyObjectParentID 1;
BA_ "SigType" SG_ 2565340800 KeyObjectID 1;
BA_ "SigType" SG_ 2565340800 SoftKeyCode 1;
BA_ "SigType" SG_ 2565340800 ButtonActivationCode 1;
BA_ "SigType" SG_ 2565340800 ButtonObjectID 1;
BA_ "SigType" SG_ 2565340800 ButtonObjectParentID 1;
BA_ "SigType" SG_ 2565340800 ButtonKeyCode 1;
BA_ "SigType" SG_ 2565340800 XPosition 1;
BA_ "SigType" SG_ 2565340800 YPosition 1;
BA_ "SigType" SG_ 2565340800 VTSelectInputObjectID 1;
BA_ "SigType" SG_ 2565340800 VTSelectInputObjectStatus 1;
BA_ "SigType" SG_ 2565340800 VTEscObjectID 1;
BA_ "SigType" SG_ 2565340800 VTChangeNumericValueObjectID 1;
BA_ "SigType" SG_ 2565340800 VTChangeNumericValueValue 1;
BA_ "SigType" SG_ 2565340800 VTChangeActiveMaskObjectID 1;
BA_ "SigType" SG_ 2565340800 VTChangeSoftKeyMaskParentID 1;
BA_ "SigType" SG_ 2565340800 VTChangeSoftKeyMaskObjectID 1;
BA_ "SigType" SG_ 2565340800 ParentObjectID_Resp 1;
BA_ "SigType" SG_ 2565340800 ObjectToChangeStringValueID_Resp 1;
BA_ "SigType" SG_ 2565340800 ObjectPoolRecord 1;
BA_ "SigType" SG_ 2565340800 AuxiliaryFunctionObjectID 1;
BA_ "SigType" SG_ 2565340800 AssignmentErrorNotAccepted 4;
BA_ "SigType" SG_ 2565340800 InputStatusObjectId 1;
BA_ "SigType" SG_ 2565340800 ObjectToShowHideID 1;
BA_ "SigType" SG_ 2565340800 ShowOrHide 1;
BA_ "SigType" SG_ 2565340800 ObjectoEnableDisbaleID 1;
BA_ "SigType" SG_ 2565340800 EnableOrDisable 1;
BA_ "SigType" SG_ 2565340800 SelectInputObjectID 1;
BA_ "SigType" SG_ 2565340800 NumberOfRepetitions_Audio 1;
BA_ "SigType" SG_ 2565340800 Frequency_Audio 1;
BA_ "SigType" SG_ 2565340800 OnTimeDuration_Audio 1;
BA_ "SigType" SG_ 2565340800 OffTimeDuration_Audio 1;
BA_ "SigType" SG_ 2565340800 AudioVolume 1;
BA_ "SigType" SG_ 2565340800 ObjectToMoveID_Location 1;
BA_ "SigType" SG_ 2565340800 XPosChangeTopLeft 1;
BA_ "SigType" SG_ 2565340800 YPosChangeTopLeft 1;
BA_ "SigType" SG_ 2565340800 ObjectToSizeID 1;
BA_ "SigType" SG_ 2565340800 NewWidth 1;
BA_ "SigType" SG_ 2565340800 NewHeight 1;
BA_ "SigType" SG_ 2565340800 ObjectToChangeColourID 1;
BA_ "SigType" SG_ 2565340800 NewBackgroundColour 1;
BA_ "SigType" SG_ 2565340800 ObjectToChangeNumValueID 1;
BA_ "SigType" SG_ 2565340800 NewValue 1;
BA_ "SigType" SG_ 2565340800 ObjectToChangeEndPointID 1;
BA_ "SigType" SG_ 2565340800 Width 1;
BA_ "SigType" SG_ 2565340800 Height 1;
BA_ "SigType" SG_ 2565340800 LineDirection 1;
BA_ "SigType" SG_ 2565340800 ObjectToChangeFontID 1;
BA_ "SigType" SG_ 2565340800 FontColour 1;
BA_ "SigType" SG_ 2565340800 FontSize 1;
BA_ "SigType" SG_ 2565340800 FontType 1;
BA_ "SigType" SG_ 2565340800 FontStyle 1;
BA_ "SigType" SG_ 2565340800 ObjectToChangeLineAttributesID 1;
BA_ "SigType" SG_ 2565340800 LineColour 1;
BA_ "SigType" SG_ 2565340800 LineWidth 1;
BA_ "SigType" SG_ 2565340800 LineArt 1;
BA_ "SigType" SG_ 2565340800 ObjectToChangeFillAttributesID 1;
BA_ "SigType" SG_ 2565340800 FillType 1;
BA_ "SigType" SG_ 2565340800 FillColour 1;
BA_ "SigType" SG_ 2565340800 FillPatternObjectID 1;
BA_ "SigType" SG_ 2565340800 WorkingSetObjectID 1;
BA_ "SigType" SG_ 2565340800 NewActiveMaskObjectID 1;
BA_ "SigType" SG_ 2565340800 MaskType 1;
BA_ "SigType" SG_ 2565340800 DataOrAlarmMaskObjectID 1;
BA_ "SigType" SG_ 2565340800 NewSoftKeyMaskObjectID 1;
BA_ "SigType" SG_ 2565340800 ObjectToChangeAttributeID 1;
BA_ "SigType" SG_ 2565340800 AttributeID_Change 1;
BA_ "SigType" SG_ 2565340800 NewAttributeValue 1;
BA_ "SigType" SG_ 2565340800 AlarmMaskObjectID 1;
BA_ "SigType" SG_ 2565340800 NewPriority 1;
BA_ "SigType" SG_ 2565340800 ListInputObjectID 1;
BA_ "SigType" SG_ 2565340800 ListIndex 1;
BA_ "SigType" SG_ 2565340800 NewObjectID 1;
BA_ "SigType" SG_ 2565340800 NewStringValue 9;
BA_ "SigType" SG_ 2565340800 MemoryRequired 1;
BA_ "SigType" SG_ 2565340800 VersionLabelToStore 3;
BA_ "SigType" SG_ 2565340800 VersionLabelToLoad 3;
BA_ "SigType" SG_ 2565340800 VersionLabelToDelete 3;
BA_ "SigType" SG_ 2565340802 VTFunctionECUtoVT 1;
BA_ "SigType" SG_ 2565340802 KeyActivationCode 1;
BA_ "SigType" SG_ 2565340802 KeyObjectParentID 1;
BA_ "SigType" SG_ 2565340802 KeyObjectID 1;
BA_ "SigType" SG_ 2565340802 SoftKeyCode 1;
BA_ "SigType" SG_ 2565340802 ButtonActivationCode 1;
BA_ "SigType" SG_ 2565340802 ButtonObjectID 1;
BA_ "SigType" SG_ 2565340802 ButtonObjectParentID 1;
BA_ "SigType" SG_ 2565340802 ButtonKeyCode 1;
BA_ "SigType" SG_ 2565340802 XPosition 1;
BA_ "SigType" SG_ 2565340802 YPosition 1;
BA_ "SigType" SG_ 2565340802 VTSelectInputObjectID 1;
BA_ "SigType" SG_ 2565340802 VTSelectInputObjectStatus 1;
BA_ "SigType" SG_ 2565340802 VTEscObjectID 1;
BA_ "SigType" SG_ 2565340802 VTChangeNumericValueObjectID 1;
BA_ "SigType" SG_ 2565340802 VTChangeNumericValueValue 1;
BA_ "SigType" SG_ 2565340802 VTChangeActiveMaskObjectID 1;
BA_ "SigType" SG_ 2565340802 VTChangeSoftKeyMaskParentID 1;
BA_ "SigType" SG_ 2565340802 VTChangeSoftKeyMaskObjectID 1;
BA_ "SigType" SG_ 2565340802 ParentObjectID_Resp 1;
BA_ "SigType" SG_ 2565340802 ObjectToChangeStringValueID_Resp 1;
BA_ "SigType" SG_ 2565340802 ObjectPoolRecord 1;
BA_ "SigType" SG_ 2565340802 AuxiliaryFunctionObjectID 1;
BA_ "SigType" SG_ 2565340802 AssignmentErrorNotAccepted 4;
BA_ "SigType" SG_ 2565340802 InputStatusObjectId 1;
BA_ "SigType" SG_ 2565340802 ObjectToShowHideID 1;
BA_ "SigType" SG_ 2565340802 ShowOrHide 1;
BA_ "SigType" SG_ 2565340802 ObjectoEnableDisbaleID 1;
BA_ "SigType" SG_ 2565340802 EnableOrDisable 1;
BA_ "SigType" SG_ 2565340802 SelectInputObjectID 1;
BA_ "SigType" SG_ 2565340802 NumberOfRepetitions_Audio 1;
BA_ "SigType" SG_ 2565340802 Frequency_Audio 1;
BA_ "SigType" SG_ 2565340802 OnTimeDuration_Audio 1;
BA_ "SigType" SG_ 2565340802 OffTimeDuration_Audio 1;
BA_ "SigType" SG_ 2565340802 AudioVolume 1;
BA_ "SigType" SG_ 2565340802 ObjectToMoveID_Location 1;
BA_ "SigType" SG_ 2565340802 XPosChangeTopLeft 1;
BA_ "SigType" SG_ 2565340802 YPosChangeTopLeft 1;
BA_ "SigType" SG_ 2565340802 ObjectToSizeID 1;
BA_ "SigType" SG_ 2565340802 NewWidth 1;
BA_ "SigType" SG_ 2565340802 NewHeight 1;
BA_ "SigType" SG_ 2565340802 ObjectToChangeColourID 1;
BA_ "SigType" SG_ 2565340802 NewBackgroundColour 1;
BA_ "SigType" SG_ 2565340802 ObjectToChangeNumValueID 1;
BA_ "SigType" SG_ 2565340802 NewValue 1;
BA_ "SigType" SG_ 2565340802 ObjectToChangeEndPointID 1;
BA_ "SigType" SG_ 2565340802 Width 1;
BA_ "SigType" SG_ 2565340802 Height 1;
BA_ "SigType" SG_ 2565340802 LineDirection 1;
BA_ "SigType" SG_ 2565340802 ObjectToChangeFontID 1;
BA_ "SigType" SG_ 2565340802 FontColour 1;
BA_ "SigType" SG_ 2565340802 FontSize 1;
BA_ "SigType" SG_ 2565340802 FontType 1;
BA_ "SigType" SG_ 2565340802 FontStyle 1;
BA_ "SigType" SG_ 2565340802 ObjectToChangeLineAttributesID 1;
BA_ "SigType" SG_ 2565340802 LineColour 1;
BA_ "SigType" SG_ 2565340802 LineWidth 1;
BA_ "SigType" SG_ 2565340802 LineArt 1;
BA_ "SigType" SG_ 2565340802 ObjectToChangeFillAttributesID 1;
BA_ "SigType" SG_ 2565340802 FillType 1;
BA_ "SigType" SG_ 2565340802 FillColour 1;
BA_ "SigType" SG_ 2565340802 FillPatternObjectID 1;
BA_ "SigType" SG_ 2565340802 WorkingSetObjectID 1;
BA_ "SigType" SG_ 2565340802 NewActiveMaskObjectID 1;
BA_ "SigType" SG_ 2565340802 MaskType 1;
BA_ "SigType" SG_ 2565340802 DataOrAlarmMaskObjectID 1;
BA_ "SigType" SG_ 2565340802 NewSoftKeyMaskObjectID 1;
BA_ "SigType" SG_ 2565340802 ObjectToChangeAttributeID 1;
BA_ "SigType" SG_ 2565340802 AttributeID_Change 1;
BA_ "SigType" SG_ 2565340802 NewAttributeValue 1;
BA_ "SigType" SG_ 2565340802 AlarmMaskObjectID 1;
BA_ "SigType" SG_ 2565340802 NewPriority 1;
BA_ "SigType" SG_ 2565340802 ListInputObjectID 1;
BA_ "SigType" SG_ 2565340802 ListIndex 1;
BA_ "SigType" SG_ 2565340802 NewObjectID 1;
BA_ "SigType" SG_ 2565340802 NewStringValue 9;
BA_ "SigType" SG_ 2565340802 MemoryRequired 1;
BA_ "SigType" SG_ 2565340802 VersionLabelToStore 3;
BA_ "SigType" SG_ 2565340802 VersionLabelToLoad 3;
BA_ "SigType" SG_ 2565340802 VersionLabelToDelete 3;
BA_ "SigType" SG_ 2632384130 VTFunctionVTtoECU 1;
BA_ "SigType" SG_ 2632384130 KeyActivationCode 1;
BA_ "SigType" SG_ 2632384130 KeyObjectID 1;
BA_ "SigType" SG_ 2632384130 KeyObjectParentID 1;
BA_ "SigType" SG_ 2632384130 SoftKeyCode 1;
BA_ "SigType" SG_ 2632384130 ButtonActivationCode 1;
BA_ "SigType" SG_ 2632384130 ButtonObjectID 1;
BA_ "SigType" SG_ 2632384130 ButtonObjectParentID 1;
BA_ "SigType" SG_ 2632384130 ButtonKeyCode 1;
BA_ "SigType" SG_ 2632384130 XPosition 1;
BA_ "SigType" SG_ 2632384130 YPosition 1;
BA_ "SigType" SG_ 2632384130 VTSelectInputObjectID 1;
BA_ "SigType" SG_ 2632384130 VTSelectInputObjectStatus 1;
BA_ "SigType" SG_ 2632384130 VTSelectInputObjectIsEdited 1;
BA_ "SigType" SG_ 2632384130 VTEscObjectID 1;
BA_ "SigType" SG_ 2632384130 ErrorCodeVTEsc1 4;
BA_ "SigType" SG_ 2632384130 ErrorCodeVTEsc2 4;
BA_ "SigType" SG_ 2632384130 VTChangeNumericValueObjectID 1;
BA_ "SigType" SG_ 2632384130 VTChangeNumericValueValue 1;
BA_ "SigType" SG_ 2632384130 VTChangeActiveMaskObjectID 1;
BA_ "SigType" SG_ 2632384130 ErrorCodeMissingObjects 4;
BA_ "SigType" SG_ 2632384130 ErrorCodeMaskOrChildObjectError 4;
BA_ "SigType" SG_ 2632384130 ErrorCodeAnyOtherError 4;
BA_ "SigType" SG_ 2632384130 ErrorCodePoolDeleted 4;
BA_ "SigType" SG_ 2632384130 VTChangeActiveMaskErrorID 1;
BA_ "SigType" SG_ 2632384130 VTChangeActiveMaskParentID 1;
BA_ "SigType" SG_ 2632384130 VTChangeSoftKeyMaskParentID 1;
BA_ "SigType" SG_ 2632384130 VTChangeSoftKeyMaskObjectID 1;
BA_ "SigType" SG_ 2632384130 ErrorCodeVTChangeSoftKeyMask1 4;
BA_ "SigType" SG_ 2632384130 ErrorCodeVTChangeSoftKeyMask2 4;
BA_ "SigType" SG_ 2632384130 ErrorCodeVTChangeSoftKeyMask3 4;
BA_ "SigType" SG_ 2632384130 ErrorCodeVTChangeSoftKeyMask4 4;
BA_ "SigType" SG_ 2632384130 ErrorCodeVTChangeSoftKeyMask5 4;
BA_ "SigType" SG_ 2632384130 ObjectToChangeStringID 1;
BA_ "SigType" SG_ 2632384130 EnteredStringValue 9;
BA_ "SigType" SG_ 2632384130 ErrorCodeEndOfObjectPool1 4;
BA_ "SigType" SG_ 2632384130 ErrorCodeEndOfObjectPool2 4;
BA_ "SigType" SG_ 2632384130 ErrorCodeEndOfObjectPool3 4;
BA_ "SigType" SG_ 2632384130 ParentObjectIdOfFaultyObject 1;
BA_ "SigType" SG_ 2632384130 ObjectIdOfFaultyObject 1;
BA_ "SigType" SG_ 2632384130 ErrorCodeObjectPool1 4;
BA_ "SigType" SG_ 2632384130 ErrorCodeObjectPool2 4;
BA_ "SigType" SG_ 2632384130 ErrorCodeObjectPool3 4;
BA_ "SigType" SG_ 2632384130 ErrorCodeObjectPool4 4;
BA_ "SigType" SG_ 2632384130 IdentityNumber 1;
BA_ "SigType" SG_ 2632384130 ManufacturerCode 1;
BA_ "SigType" SG_ 2632384130 ECUInstance 4;
BA_ "SigType" SG_ 2632384130 FunctionInstance 1;
BA_ "SigType" SG_ 2632384130 AuxiliaryInputObjectID 1;
BA_ "SigType" SG_ 2632384130 InputObjectId 1;
BA_ "SigType" SG_ 2632384130 Value1 1;
BA_ "SigType" SG_ 2632384130 Function 1;
BA_ "SigType" SG_ 2632384130 DeviceClass 1;
BA_ "SigType" SG_ 2632384130 IndustryGroup 4;
BA_ "SigType" SG_ 2632384130 DeviceClassInstance 4;
BA_ "SigType" SG_ 2632384130 SelfConfigurableAddress 4;
BA_ "SigType" SG_ 2632384130 AuxiliaryFunctionObjectID 1;
BA_ "SigType" SG_ 2632384130 Value2 1;
BA_ "SigType" SG_ 2632384130 InputStatusObjectId 1;
BA_ "SigType" SG_ 2632384130 ObjectEscapeID 1;
BA_ "SigType" SG_ 2632384130 ErrorCodeEscapeObj1 4;
BA_ "SigType" SG_ 2632384130 ErrorCodeEscapeObj2 4;
BA_ "SigType" SG_ 2632384130 ObjectToHideShowID 1;
BA_ "SigType" SG_ 2632384130 ObjectShowStatus 1;
BA_ "SigType" SG_ 2632384130 ErrorCodeHideShowObj1 4;
BA_ "SigType" SG_ 2632384130 ErrorCodeHideShowObj2 4;
BA_ "SigType" SG_ 2632384130 ErrorCodeHideShowObj3 4;
BA_ "SigType" SG_ 2632384130 ObjectToEnableDisableID 1;
BA_ "SigType" SG_ 2632384130 ObjectEnableStatus 1;
BA_ "SigType" SG_ 2632384130 ErrorCodeEnableDisableObj1 4;
BA_ "SigType" SG_ 2632384130 ErrorCodeEnableDisableObj2 4;
BA_ "SigType" SG_ 2632384130 ErrorCodeEnableDisableObj3 4;
BA_ "SigType" SG_ 2632384130 ErrorCodeEnableDisableObj4 4;
BA_ "SigType" SG_ 2632384130 SelectInputObjectID 1;
BA_ "SigType" SG_ 2632384130 ObjectSelectStatus 1;
BA_ "SigType" SG_ 2632384130 ErrorCodeSelectObject1 4;
BA_ "SigType" SG_ 2632384130 ErrorCodeSelectObject2 4;
BA_ "SigType" SG_ 2632384130 ErrorCodeSelectObject3 4;
BA_ "SigType" SG_ 2632384130 ErrorCodeSelectObject4 4;
BA_ "SigType" SG_ 2632384130 ErrorCodeSelectObject5 4;
BA_ "SigType" SG_ 2632384130 ErrorCodeControlAudioDevice1 4;
BA_ "SigType" SG_ 2632384130 ErrorCodeControlAudioDevice2 4;
BA_ "SigType" SG_ 2632384130 ErrorCodeAudioVolume1 4;
BA_ "SigType" SG_ 2632384130 ErrorCodeAudioVolume2 4;
BA_ "SigType" SG_ 2632384130 ParentObjectID_Location 1;
BA_ "SigType" SG_ 2632384130 ObjectToMoveID_Location 1;
BA_ "SigType" SG_ 2632384130 ErrorCodeChangeChildLocation1 4;
BA_ "SigType" SG_ 2632384130 ErrorCodeChangeChildLocation2 4;
BA_ "SigType" SG_ 2632384130 ErrorCodeChangeChildLocation5 4;
BA_ "SigType" SG_ 2632384130 ObjectToSizeID 1;
BA_ "SigType" SG_ 2632384130 ErrorCodeObjToSize1 4;
BA_ "SigType" SG_ 2632384130 ErrorCodeObjToSize2 4;
BA_ "SigType" SG_ 2632384130 ErrorCodeObjToSize3 4;
BA_ "SigType" SG_ 2632384130 ErrorCodeObjToSize4 4;
BA_ "SigType" SG_ 2632384130 ObjectToChangeColourID 1;
BA_ "SigType" SG_ 2632384130 NewBackgroundColour 1;
BA_ "SigType" SG_ 2632384130 ErrorCodeChangeColour1 4;
BA_ "SigType" SG_ 2632384130 ErrorCodeChangeColour2 4;
BA_ "SigType" SG_ 2632384130 ErrorCodeChangeColour3 4;
BA_ "SigType" SG_ 2632384130 ObjectToChangeNumValueID 1;
BA_ "SigType" SG_ 2632384130 ErrorCodeChangeNumValue1 4;
BA_ "SigType" SG_ 2632384130 ErrorCodeChangeNumValue2 4;
BA_ "SigType" SG_ 2632384130 ErrorCodeChangeNumValue3 4;
BA_ "SigType" SG_ 2632384130 ValueOfTheObject 1;
BA_ "SigType" SG_ 2632384130 ObjectToChangeEndPointID 1;
BA_ "SigType" SG_ 2632384130 ErrorCodeChangeEditPoint1 4;
BA_ "SigType" SG_ 2632384130 ErrorCodeChangeEditPoint2 4;
BA_ "SigType" SG_ 2632384130 ErrorCodeChangeEditPoint3 4;
BA_ "SigType" SG_ 2632384130 ObjectToChangeFontID 1;
BA_ "SigType" SG_ 2632384130 ErrorCodeChangeFont1 4;
BA_ "SigType" SG_ 2632384130 ErrorCodeChangeFont2 4;
BA_ "SigType" SG_ 2632384130 ErrorCodeChangeFont4 4;
BA_ "SigType" SG_ 2632384130 ErrorCodeChangeFont3 4;
BA_ "SigType" SG_ 2632384130 ErrorCodeChangeFont5 4;
BA_ "SigType" SG_ 2632384130 ErrorCodeChangeFont6 4;
BA_ "SigType" SG_ 2632384130 ObjectToChangeLineAttributeID 1;
BA_ "SigType" SG_ 2632384130 ErrorCodeChangeLineAttribute1 4;
BA_ "SigType" SG_ 2632384130 ErrorCodeChangeLineAttribute2 4;
BA_ "SigType" SG_ 2632384130 ErrorCodeChangeLineAttribute3 4;
BA_ "SigType" SG_ 2632384130 ErrorCodeChangeLineAttribute4 4;
BA_ "SigType" SG_ 2632384130 ObjectToChangeFillAttributesID 1;
BA_ "SigType" SG_ 2632384130 ErrorCodeChangeFillAttributes1 4;
BA_ "SigType" SG_ 2632384130 ErrorCodeChangeFillAttributes2 4;
BA_ "SigType" SG_ 2632384130 ErrorCodeChangeFillAttributes3 4;
BA_ "SigType" SG_ 2632384130 ErrorCodeChangeFillAttributes4 4;
BA_ "SigType" SG_ 2632384130 ErrorCodeChangeFillAttributes5 4;
BA_ "SigType" SG_ 2632384130 ActiveMaskObjectID 1;
BA_ "SigType" SG_ 2632384130 ErrorCodeChangeActiveMask1 4;
BA_ "SigType" SG_ 2632384130 ErrorCodeChangeActiveMask2 4;
BA_ "SigType" SG_ 2632384130 ErrorCodeChangeActiveMask3 4;
BA_ "SigType" SG_ 2632384130 ErrorCodeChangeActiveMask4 4;
BA_ "SigType" SG_ 2632384130 ErrorCodeChangeActiveMask5 4;
BA_ "SigType" SG_ 2632384130 DataOrAlarmMaskObjectID 1;
BA_ "SigType" SG_ 2632384130 SoftKeyMaskObjectID 1;
BA_ "SigType" SG_ 2632384130 ErrorCodeChangeSoftKeyMask1 4;
BA_ "SigType" SG_ 2632384130 ErrorCodeChangeSoftKeyMask2 4;
BA_ "SigType" SG_ 2632384130 ErrorCodeChangeSoftKeyMask3 4;
BA_ "SigType" SG_ 2632384130 ErrorCodeChangeSoftKeyMask4 4;
BA_ "SigType" SG_ 2632384130 ErrorCodeChangeSoftKeyMask5 4;
BA_ "SigType" SG_ 2632384130 ObjectToChangeAttributeID 1;
BA_ "SigType" SG_ 2632384130 AttributeID_Change 1;
BA_ "SigType" SG_ 2632384130 ErrorCodeChangeAttribute1 4;
BA_ "SigType" SG_ 2632384130 ErrorCodeChangeAttribute2 4;
BA_ "SigType" SG_ 2632384130 ErrorCodeChangeAttribute3 4;
BA_ "SigType" SG_ 2632384130 ErrorCodeChangeAttribute4 4;
BA_ "SigType" SG_ 2632384130 AlarmMaskObjectID 1;
BA_ "SigType" SG_ 2632384130 NewPriority 1;
BA_ "SigType" SG_ 2632384130 ErrorCodeChangePriority1 4;
BA_ "SigType" SG_ 2632384130 ErrorCodeChangePriority2 4;
BA_ "SigType" SG_ 2632384130 ErrorCodeChangePriority3 4;
BA_ "SigType" SG_ 2632384130 ListInputObjectID 1;
BA_ "SigType" SG_ 2632384130 ListIndex 1;
BA_ "SigType" SG_ 2632384130 NewObjectID 1;
BA_ "SigType" SG_ 2632384130 ErrorCodeChangeListItem1 4;
BA_ "SigType" SG_ 2632384130 ErrorCodeChangeListItem2 4;
BA_ "SigType" SG_ 2632384130 ErrorCodeChangeListItem3 4;
BA_ "SigType" SG_ 2632384130 ErrorCodeChangeListItem4 4;
BA_ "SigType" SG_ 2632384130 ErrorCodeDeleteObjectPool1 4;
BA_ "SigType" SG_ 2632384130 ErrorCodeDeleteObjectPool2 4;
BA_ "SigType" SG_ 2632384130 ObjectToChangeStringValueID 1;
BA_ "SigType" SG_ 2632384130 ErrorCodeChangeStrObjectID 4;
BA_ "SigType" SG_ 2632384130 ErrorCodeChangeStrTooLong 4;
BA_ "SigType" SG_ 2632384130 ErrorCodeChangeStrError 4;
BA_ "SigType" SG_ 2632384130 ErrorCodeChangePosInvalidParent 4;
BA_ "SigType" SG_ 2632384130 ErrorCodeChangePosInvalidObject 4;
BA_ "SigType" SG_ 2632384130 ErrorCodeChangePosInvalidError 4;
BA_ "SigType" SG_ 2632384130 VersionNumberISO11783Part6 1;
BA_ "SigType" SG_ 2632384130 MemoryStatus 1;
BA_ "SigType" SG_ 2632384130 XDotsForSoftKeyDescriptor 1;
BA_ "SigType" SG_ 2632384130 YDotsForSoftKeyDescriptor 1;
BA_ "SigType" SG_ 2632384130 NumberOfPossibleVirtualSoftKeys 1;
BA_ "SigType" SG_ 2632384130 NumberOfPhysicalSoftKeys 1;
BA_ "SigType" SG_ 2632384130 FontSize_8x8 4;
BA_ "SigType" SG_ 2632384130 FontSize_8x12 4;
BA_ "SigType" SG_ 2632384130 FontSize_12x16 4;
BA_ "SigType" SG_ 2632384130 FontSize_16x16 4;
BA_ "SigType" SG_ 2632384130 FontSize_16x24 4;
BA_ "SigType" SG_ 2632384130 FontSize_24x32 4;
BA_ "SigType" SG_ 2632384130 FontSize_32x32 4;
BA_ "SigType" SG_ 2632384130 FontSize_32x48 4;
BA_ "SigType" SG_ 2632384130 FontSize_48x64 4;
BA_ "SigType" SG_ 2632384130 FontSize_64x64 4;
BA_ "SigType" SG_ 2632384130 FontSize_64x96 4;
BA_ "SigType" SG_ 2632384130 FontSize_96x128 4;
BA_ "SigType" SG_ 2632384130 FontSize_128x128 4;
BA_ "SigType" SG_ 2632384130 FontSize_128x192 4;
BA_ "SigType" SG_ 2632384130 FontType_BoldText 4;
BA_ "SigType" SG_ 2632384130 FontType_CrossedOutText 4;
BA_ "SigType" SG_ 2632384130 FontType_UnderlinedText 4;
BA_ "SigType" SG_ 2632384130 FontType_ItalicsText 4;
BA_ "SigType" SG_ 2632384130 FontType_InvertedText 4;
BA_ "SigType" SG_ 2632384130 FontType_FlashInverted 4;
BA_ "SigType" SG_ 2632384130 FontType_FlashHidden 4;
BA_ "SigType" SG_ 2632384130 FontType_ProportionalFont 4;
BA_ "SigType" SG_ 2632384130 MaxLineWidth 1;
BA_ "SigType" SG_ 2632384130 LineArts 1;
BA_ "SigType" SG_ 2632384130 FillTypes 1;
BA_ "SigType" SG_ 2632384130 ShapeFillTypes 1;
BA_ "SigType" SG_ 2632384130 SupportedGrapicMode 1;
BA_ "SigType" SG_ 2632384130 Hardware1 4;
BA_ "SigType" SG_ 2632384130 Hardware2 4;
BA_ "SigType" SG_ 2632384130 Hardware3 4;
BA_ "SigType" SG_ 2632384130 Hardware4 4;
BA_ "SigType" SG_ 2632384130 NrOfXPixelsInDataAreaMask 1;
BA_ "SigType" SG_ 2632384130 NrOfYPixelsInDataAreaMask 1;
BA_ "SigType" SG_ 2632384130 AcknowledgmentStoreVersion 4;
BA_ "SigType" SG_ 2632384130 AcknowledgmentLoadVersion 4;
BA_ "SigType" SG_ 2632384130 AcknowledgmentDeleteVersion 4;
BA_ "SigType" SG_ 2632384130 NrOfVersionStrings 1;
BA_ "SigType" SG_ 2632384130 VersionLables 3;
BA_ "SigType" SG_ 2632384130 ObjectIDOfFaultyObject 1;
BA_ "SigType" SG_ 2632384130 ErrorCodeVtObjPoolError1 4;
BA_ "SigType" SG_ 2632384130 ErrorCodeVtObjPoolError2 4;
BA_ "SigType" SG_ 2632384130 ErrorCodeVtObjPoolError3 4;
BA_ "SigType" SG_ 2632384130 ErrorCodeVtObjPoolError4 4;
BA_ "SigType" SG_ 2632384130 SourceAdressOfActiveWSM 1;
BA_ "SigType" SG_ 2632384130 VisibleDataOrAlarmMaskObjectID 1;
BA_ "SigType" SG_ 2632384130 VisibleSoftKeyMaskObjectID 1;
BA_ "SigType" SG_ 2632384130 VTBusyCode1 4;
BA_ "SigType" SG_ 2632384130 VTBusyCode2 4;
BA_ "SigType" SG_ 2632384130 VTBusyCode3 4;
BA_ "SigType" SG_ 2632384130 VTBusyCode4 4;
BA_ "SigType" SG_ 2632384130 VTBusyCode5 4;
BA_ "SigType" SG_ 2632384130 VTBusyCode8 4;
BA_ "SigType" SG_ 2632384130 VTFunctionCode 1;
VAL_ 3221225472 VTFunctionECUtoVT 36 "AuxiliaryAssignmentResponseType2" 193 "GetSupported WideChars" 37 "AuxiliaryInputStatusEnableCommandResponse" 35 "AuxiliaryInputMaintenance" 190 "ExecuteMacro" 189 "LockUnlockMask" 34 "AuxiliaryPreferredAssignment" 9 "DisplayActivationResponse" 186 "SelectColourMap" 185 "GetAttribute" 184 "GraphicsContextCommand" 183 "ChangePolygonScale" 182 "ChangePolygonPoint" 181 "SetObjectLabel" 0 "SoftKeyActivationResponse" 1 "ButtonActivationResponse" 2 "PointingEventResponse" 18 "EndOfObjectPool" 32 "AuxiliaryAssignmentResponse" 146 "ESC" 160 "ShowHideObject" 161 "EnableDisableObject" 162 "SelectInputObject" 163 "ControlAudioDevice" 164 "SetAudioVolume" 165 "ChangeChildLocation" 166 "ChangeSize" 167 "ChangeBackgroundColour" 168 "ChangeNumericValue" 169 "ChangeEndPoint" 170 "ChangeFontAttributes" 171 "ChangeLineAttributes" 172 "ChangeFillAttributes" 173 "ChangeActiveMask" 174 "ChangeSoftKeyMask" 175 "ChangeAttribute" 176 "ChangePriority" 177 "ChangeListItem" 178 "DeleteObjectPool" 192 "GetMemory" 194 "GetNumberOfSoftKeys" 195 "GetTextFontData" 199 "GetHardware" 208 "StoreVersion" 209 "LoadVersion" 210 "DeleteVersion" 223 "GetVersions" 255 "WorkingSetMaintenance" 179 "ChangeStringValue" 3 "VTSelectInputObjectResponse" 4 "VTESCResponse" 5 "VTChangeNumericValueResponse" 6 "VTChangeActiveMaskResponse" 7 "VTChangeSoftKeyMaskResponse" 196 "GetFillAndLineData" 17 "ObjectPoolTransfer" 180 "ChangeChildPosition" 8 "InputStringValueResponse" ;
VAL_ 3221225472 KeyActivationCode 3 "KeyPressAborted" 0 "KeyHasBeenReleased" 1 "KeyHasBeenPressed" 2 "KeyIsStillPressed" ;
VAL_ 3221225472 KeyObjectParentID 0 "KeyHasBeenReleased" 1 "KeyHasBeenPressed" 2 "KeyIsStillPressed" ;
VAL_ 3221225472 KeyObjectID 0 "KeyHasBeenReleased" 1 "KeyHasBeenPressed" 2 "KeyIsStillPressed" ;
VAL_ 3221225472 SoftKeyCode 0 "AlarmACK" ;
VAL_ 3221225472 ButtonActivationCode 3 "ButtonPressAborted" 0 "ButtonHasBeenUnlatched" 1 "ButtonHasBeenLatched" 2 "ButtonIsStillHeld" ;
VAL_ 3221225472 ButtonObjectID 0 "KeyHasBeenReleased" 1 "KeyHasBeenPressed" 2 "KeyIsStillPressed" ;
VAL_ 3221225472 ButtonObjectParentID 0 "KeyHasBeenReleased" 1 "KeyHasBeenPressed" 2 "KeyIsStillPressed" ;
VAL_ 3221225472 TouchState 255 "Pressed" 2 "Held" 1 "Pressed" 0 "Released" ;
VAL_ 3221225472 VTSelectInputObjectStatus 0 "ObjectIsDeselected" 1 "ObjectIsSelected" ;
VAL_ 3221225472 AssignmentErrorNotAccepted 0 "AssignmentAccepted" 1 "Rejected_InputAlreadyAssigned" ;
VAL_ 3221225472 ShowOrHide 0 "Hide" 1 "Show" ;
VAL_ 3221225472 EnableOrDisable 0 "Disable" 1 "Enable" ;
VAL_ 3221225472 MaskType 1 "Data" 2 "Alarm" ;
VAL_ 3221225472 VTFunctionVTtoECU 38 "AuxiliaryInputStatusType2" 36 "AuxiliaryAssignmentCommandType2" 193 "GetSupported WideCharsResponse" 37 "AuxiliaryInputStatusEnableCommand" 190 "ExecuteMacroResponse" 189 "LockUnlockMaskResponse" 35 "AuxiliaryInputMaintenance" 10 "VTControlAudioDeviceTermination" 9 "DisplayActivation" 186 "SelectColourMapResponse" 185 "GetAttributeValueResponse" 184 "GraphicsContextCommandResponse" 183 "ChangePolygonScaleResponse" 182 "ChangePolygonPointResponse" 181 "SetObjectLabelResponse" 0 "SoftKeyActivation" 1 "ButtonActivation" 2 "PointingEvent" 18 "EndOfObjectPoolResponse" 32 "AuxiliaryAssignmentCommand" 146 "ESCResponse" 160 "ShowHideObjectResponse" 161 "EnableDisableObjectResponse" 162 "SelectInputObjectResponse" 163 "ControlAudioDeviceResponse" 164 "SetAudioVolumeResponse" 165 "ChangeChildLocationResponse" 166 "ChangeSizeResponse" 167 "ChangeBackgroundColourResponse" 168 "ChangeNumericValueResponse" 169 "ChangeEndPointResponse" 170 "ChangeFontAttributesResponse" 171 "ChangeLineAttributesResponse" 172 "ChangeFillAttributesResponse" 173 "ChangeActiveMaskResponse" 174 "ChangeSoftKeyMaskResponse" 175 "ChangeAttributeResponse" 176 "ChangePriorityResponse" 177 "ChangeListItemResponse" 178 "DeleteObjectPoolResponse" 192 "GetMemoryResponse" 194 "GetNumberOfSoftKeysResponse" 195 "GetTextFontDataResponse" 199 "GetHardwareResponse" 208 "StoreVersionResponse" 209 "LoadVersionResponse" 210 "DeleteVersionResponse" 224 "GetVersionsResponse" 254 "VTStatusMessage" 33 "AuxiliaryInputStatus" 3 "VTSelectInputObject" 4 "VTESC" 5 "VTChangeNumericValue" 6 "VTChangeActiveMask" 7 "VTChangeSoftKeyMask" 8 "InputStringValue" 196 "GetFillAndLineDataResponse" 240 "VTObjectPoolErrorMessage" 179 "ChangeStringValueResponse" 180 "ChangeChildPositionResponse" 34 "AuxiliaryPreferredAssignmentResponse" ;
VAL_ 3221225472 VTSelectInputObjectIsEdited 0 "ObjectIsNotEdited" 1 "ObjectIsOpenForEditing" ;
VAL_ 3221225472 ErrorCodeVTEsc1 0 "NoError" 1 "NoInputFieldSelected ESC_Ignored" ;
VAL_ 3221225472 ErrorCodeVTEsc2 0 "NoError" 1 "GeneralError" ;
VAL_ 3221225472 ErrorCodeMissingObjects 0 "NoErrors" 1 "MissingObjects" ;
VAL_ 3221225472 ErrorCodeMaskOrChildObjectError 0 "NoErrors" 1 "MaskOrChildObjectHasErrors" ;
VAL_ 3221225472 ErrorCodeAnyOtherError 0 "NoErrors" 1 "GeneralError" ;
VAL_ 3221225472 ErrorCodePoolDeleted 0 "NoErrors" 1 "PoolBeingDeleted" ;
VAL_ 3221225472 ErrorCodeVTChangeSoftKeyMask1 0 "NoError" 1 "InvalidDataOrAlarmMaskObjectID" ;
VAL_ 3221225472 ErrorCodeVTChangeSoftKeyMask2 0 "NoError" 1 "InvalidSoftKeyMaskObjectID" ;
VAL_ 3221225472 ErrorCodeVTChangeSoftKeyMask3 0 "NoError" 1 "MissingObjects" ;
VAL_ 3221225472 ErrorCodeVTChangeSoftKeyMask4 0 "NoError" 1 "MaskOrChildObjectHasErrors" ;
VAL_ 3221225472 ErrorCodeVTChangeSoftKeyMask5 0 "NoError" 1 "GeneralError" ;
VAL_ 3221225472 ErrorCodeEndOfObjectPool1 1 "ErrorsInTheObjectPool" 0 "NoErrors" ;
VAL_ 3221225472 ErrorCodeEndOfObjectPool2 0 "NoErrors" 1 "VTRanOutOfMemoryDuringTransfer" ;
VAL_ 3221225472 ErrorCodeEndOfObjectPool3 0 "NoErrors" 1 "GeneralError" ;
VAL_ 3221225472 ErrorCodeObjectPool1 0 "NoErrors" 1 "MethodOrAttributeNotSupportedByV" ;
VAL_ 3221225472 ErrorCodeObjectPool2 0 "NoErrors" 1 "UnknownObjectReference" ;
VAL_ 3221225472 ErrorCodeObjectPool3 0 "NoErrors" 1 "GeneralError" ;
VAL_ 3221225472 ErrorCodeObjectPool4 0 "NoErrors" 1 "ObjectPoolWasDeletedFromVolatile" ;
VAL_ 3221225472 ManufacturerCode 1863 "Thomas G. Faria Co." 1862 "Sanshin" 1861 "Vector North America" 1860 "MMP" 1859 "Kvasar AB" 1858 "Litton" 1857 "Simrad" 1856 "Trimble" 1855 "Furuno USA" 1854 "Northstar Technologies" 1853 "Japan Radio Co." 1852 "Navionics" 1851 "Raymarine" 1850 "Teleflex" 222 "Generac Power Systems, Inc." 221 "SiE" 220 "Beede Electrical Instrument Company, Inc." 219 "Cat OEM Solutions" 218 "Gits Manufacturing Company" 217 "RM Michaelides Software & Elektronik GmbH" 216 "Paneltronics Inc." 215 "Aetna Engineering/Fireboy-Xintex" 214 "MC elettronica Srl" 213 "CNH Belgium N.V." 212 "Sure Power Industries, Inc." 211 "DNA Group" 210 "Iteris, Inc." 209 "Bell Equip. Co. SA (PTY) LTD" 208 "Drew Technologies, Inc." 207 "Otto Engineering" 206 "port GmbH" 205 "SmarTire Systems Inc" 204 "The Morey Corporation" 203 "MILtronik GmbH" 202 "Curtis Instruments, Inc." 201 "Disenos y Tecnologia S.A." 200 "MGM Brakes" 199 "Actia Corp." 198 "Mystic Valley Communications" 197 "Mechron Power Systems" 196 "LEMKEN GmbH & Co. KG" 195 "General Engine Products" 194 "TriMark Corporation" 193 "Jeppesen Marine" 192 "Floscan" 191 "XATA Corporation" 190 "Hella KGaA Hueck & Co." 189 "QUALCOMM" 188 "EMP Corp." 187 "Air-Weigh" 186 "Altronic, Inc." 185 "Beede Electrical Instrument Company" 184 "EIA Electronics" 183 "KDS Controls, Inc." 182 "Vehicle Systems Engineering B.V." 181 "Coretronics, Inc." 180 "Smart Power Systems" 179 "Midwest Technologies Illinois, LLC" 178 "Siemens VDO Automotive AG" 177 "Diagnostic System Associates" 176 "Moritz Aerospace" 175 "Veris Technologies, Inc." 174 "AB Volvo Penta" 173 "Ryeso, Inc." 172 "Yanmar Marine USA" 171 "Wachendorff Elektronik GmbH & Co. KG" 170 "Computronics Corporation Ltd." 169 "Marlin Technologies Inc." 168 "Xantrex" 167 "JLG Industries Inc." 166 "Phoenix International" 165 "CPAC Systems AB" 164 "DaimlerChrysler Off-Highway" 163 "BRP Inc." 162 "Axiomatic Technologies" 161 "Offshore Systems (UK) Limited" 160 "Nido" 159 "NTech Industries Inc." 158 "Firestone Industrial Products Company" 157 "ISSPRO Inc." 156 "ITT Industries - Cannon" 155 "Vetronix Corporation" 154 "Westerbeke Corporation" 153 "Woodward, Industrial Controls Division" 152 "Elobau Elektrobauelemente GmbH & Co. KG" 151 "Raven Industries Inc. - Flow Controls Division" 150 "Fleetguard" 149 "Holset" 148 "Blue Water Data, Inc." 147 "Nautibus Electronic GmbH" 146 "Maxima Technologies" 145 "MurCal Controls" 144 "Mercury Marine" 143 "W. Gmeiner GmbH & Co." 142 "TRW Automotive (Commercial Steering Systems)" 141 "Thales Navigation Ltd." 140 "Lowrance Electronics, Inc." 139 "Caterpillar Trimble Control Technologies (CTCT), LLC" 138 "Georg Fritzmeier GmbH & Co. KG" 137 "Maretron" 136 "Komatsu Ltd." 135 "Airmar Technology Corporation" 134 "Iris Technology Ltd." 133 "Bucher Schoerling GmbH" 132 "Mulag-Fahrzeugwerk" 131 "ITT Industries" 130 "Nido - Universal Machines B.V." 129 "OMNEX Control Systems, Inc." 128 "Gerhard Duecker GmbH & Co. KG" 127 "Holland USA" 126 "Driver Tech" 125 "Nevada Automotive Test Center" 124 "Hydac Electronic" 123 "Basler Electric" 122 "FG Wilson (Engineering) Limited" 121 "HED (Hydro Electronic Devices, Inc.)" 120 "RDS Technology Ltd." 119 "IntegriNautics" 118 "Intron GmbH" 117 "HUSCO International" 116 "BEELINE Technologies" 115 "NACCO Materials Handling Group, Inc." 114 "EControls, Inc." 113 "Stress-Tek, Inc." 112 "MECALAC" 111 "Maschinenfabrik Bernhard Krone GmbH" 110 "EPIQ Sensor-Nite" 109 "LH Technologies ApS" 108 "WTK-Elecktronik GmbH" 107 "Grimme Landmaschinen GmbH & Co. KG" 106 "BAE Systems Controls, Inc." 105 "Kiepe Elektrik GmbH & Co. KG" 104 "Claas Selbstfahrende Erntemaschinen GmbH" 103 "Agrocom GmbH & Co. Agrarsystem KG" 102 "AGCO GmbH & Co." 101 "Sensoria" 100 "VDO Technik AG" 99 "International Transmissions Ltd (ITL)" 98 "Mueller-Elektronik GmbH & Co." 97 "Ag Leader Technology, Inc." 96 "Mech@tronic IT GmbH" 95 "Pacific Insight Electronics Corp." 94 "CNH Global N.V." 93 "Perkins Engines Company Ltd." 92 "Ag-Chem Equipment Co., Inc." 91 "BSG Bodensee Steuergeraete GmbH" 90 "Knorr-Bremse SfN GmbH" 89 "Kverneland Group, Electronics Division" 88 "Satloc Precision GPS" 87 "J.C. Bamford Excavators Ltd (JCB)" 86 "C.E. Niehoff & Company" 85 "Kohler Co." 84 "New Holland UK Limited" 83 "Eaton VORAD Technologies" 82 "Bobcat/Ingersoll-Rand" 81 "Fire Research Corp" 80 "Twin Disc, Inc." 79 "Daimler Benz AG - Engine Division (PBM)" 78 "Frank W. Murphy Manufacturing, Inc." 77 "Deere Power Systems Group" 76 "unused" 75 "Deere & Co. Agricultural Division" 74 "Eaton Axle-Brake Division" 73 "LeTourneau, Inc." 72 "Sisu Corporation" 71 "Vansco Electronics Ltd." 70 "Flex-Coil Limited" 69 "Trimble Navigation" 68 "Scania" 67 "Funk Manufacturing Company" 66 "John Deere Construction Equipment Division" 65 "MAN Nutzfahrzeuge AG" 64 "unused" 63 "ZF Industries Inc." 62 "Wabco" 61 "Volvo Truck Corp." 60 "Volvo Trucks North America Inc." 59 "VES Inc." 58 "SPX Corporation, OTC Division" 57 "Sauer-Danfoss Co." 56 "SAIC" 55 "Ryder System Inc." 54 "Meritor Wabco" 53 "Rockwell Land Transportation" 52 "Meritor Automotive, Inc." 51 "Robert Bosch GmbH" 50 "Robert Bosch Corp" 49 "RE America Inc." 48 "Pollak Alphabet" 47 "Phillips Semiconductor" 46 "Parasoft Computing Solutions" 45 "PACCAR" 44 "Nippondenso Co. Ltd." 43 "International Truck and Engine Corp. Vehicle Electronics" 42 "International Truck and Engine Corp. Engine Electronics" 41 "Motorola Inc." 40 "Motorola AIEG Inc." 39 "Microfirm Inc." 38 "Micro Processor Systems Inc." 37 "Mack Trucks Inc." 36 "Lucas Ltd." 35 "Kenworth Truck Co." 34 "Kelsey Hayes Co." 33 "John Deere" 32 "Jacobs Vehicle Systems" 31 "J Pollak Corp." 30 "Isuzu Motors Ltd." 29 "Hino Motors Ltd." 28 "Grote Ind. Inc." 27 "GMC" 26 "General Motors Corp., Service Technology Group" 25 "Freightliner LLC" 24 "Ford Motor Co., Vehicle Controls" 23 "Ford Motor Co., Heavy Truck" 22 "Ford Motor Co., Electronic Concepts $ Systems" 21 "Echilin Inc., Midland Brake Inc." 20 "Eaton Ltd" 19 "Eaton Corp. Trucking Info Services" 18 "Eaton Corp, Transmission Division" 17 "Eaton Corp. Res & Dev" 16 "Eaton Corp." 15 "Dickey-John Corp." 14 "Detroit Diesel Corporation" 13 "Delco Electronics" 12 "Deere & Company, Precision Farming" 11 "Dearborn Group Inc." 10 "Cummins Engine Co." 9 "Chrysler Corp." 8 "Caterpillar Inc." 7 "Case Corp." 6 "Berifors Electronics AB" 5 "AMP Inc." 4 "Ametek-Dixson" 3 "Ametek, US Gauge Division" 2 "Allison Transmission, GMC" 1 "Allied Signal Inc." 0 "Reserved" ;
VAL_ 3221225472 Function 127 "Reserved" 126 "Reserved" 125 "Reserved" 124 "Reserved" 123 "Reserved" 122 "Reserved" 121 "Reserved" 120 "Reserved" 119 "Reserved" 118 "Reserved" 117 "Reserved" 116 "Reserved" 115 "Reserved" 114 "Reserved" 113 "Reserved" 112 "Reserved" 111 "Reserved" 110 "Reserved" 109 "Reserved" 108 "Reserved" 107 "Reserved" 106 "Reserved" 105 "Reserved" 104 "Reserved" 103 "Reserved" 102 "Reserved" 101 "Reserved" 42 "Water Pump Control" 41 "Lighting - Operator Controls" 40 "Seat Control" 39 "Ignition Control Module" 38 "Tire Pressure Control" 37 "Cab Controller" 36 "Pneumatic - System Controller" 35 "Suspension - System Controller" 34 "Hydraulic Pump Controller" 33 "System Monitor" 32 "Headway Controller" 31 "Propulsion Battery Charger" 30 "Management Computer" 29 "Virtual Terminal (In Cab)" 28 "Off Vehicle Gateway" 27 "Power TakeOff (Secondary or Front)" 26 "Body Controller" 25 "Network Interconnect ECU" 24 "Vehicle Security" 23 "Vehicle Navigation" 22 "Aerodynamic Control" 21 "Cab Climate Control" 20 "Trip Recorder" 19 "Instrument Cluster" 18 "Suspension - Drive Axle" 17 "Suspension - Steer Axle" 16 "Steeting Controller" 15 "Fuel System" 14 "Cruise Control" 13 "Retarder - Driveline" 12 "Retarder - Engine" 11 "Brakes - Drive Axle" 10 "Brakes - Steer Axle" 9 "Brakes - System Controller" 8 "Axle - Drive" 7 "Axle - Steering" 6 "Power TakeOff - (Main or Rear)" 5 "Shift Control/Console" 4 "Battery Pack Monitor" 3 "Transmission" 2 "Electric Propulsion Control" 1 "Auxiliary Power Unit (APU)" 0 "Engine" 100 "Reserved" 99 "Reserved" 98 "Reserved" 97 "Reserved" 96 "Reserved" 95 "Reserved" 94 "Reserved" 93 "Reserved" 92 "Reserved" 91 "Reserved" 90 "Reserved" 89 "Reserved" 88 "Reserved" 87 "Reserved" 86 "Reserved" 85 "Reserved" 84 "Reserved" 83 "Reserved" 82 "Reserved" 81 "Reserved" 80 "Reserved" 79 "Reserved" 78 "Reserved" 77 "Reserved" 76 "Reserved" 75 "Reserved" 74 "Reserved" 73 "Reserved" 72 "Coolant Valve Controller" 71 "Transfer Case Control" 70 "Auxiliary Regeneration Device" 69 "Engine Emission Aftertreatement System" 68 "Aftertreatment system gas measurement" 67 "Electrical System Controller" 66 "I/O Controller" 65 "Gas Flow Measurement" 64 "Endurance Braking" 63 "Engine Valve Controller" 62 "On-Board Diagnostic Unit" 61 "File Server/Printer" 60 "Cab Display" 59 "Starter" 58 "Fan Drive Control" 57 "Steering Column Unit" 56 "Communications Unit, Radio" 55 "Communications Unit, Satellite" 54 "Communications Unit, Cellular" 53 "Alternator/Charging System" 52 "Chassis Controller" 51 "Forward-Looking Collision Warning System" 50 "Auxiliary Heater" 49 "Clutch/Converter Control" 48 "Ramp Control" 47 "Information System Controller" 46 "Oil Sensor Unit" 45 "Vehicle Dynamic Stability Control" 44 "Exhaust Emission Control" 43 "Transmission Display" ;
VAL_ 3221225472 IndustryGroup 0 "Global" 1 "OnHighway" 2 "AgriculturalAndForestry" 3 "Construction" 4 "Marine" 5 "Reserved" 7 "NotAvailable" ;
VAL_ 3221225472 AuxPreferredAssignmentRespError1 1 "AuxiliaryInputUnit(s)NotValid" 0 "NoErrors" ;
VAL_ 3221225472 AuxPreferredAssignmentRespError2 1 "FunctionObjectID(s)NotValid" 0 "NoErrors" ;
VAL_ 3221225472 AuxPreferredAssignmentRespError3 1 "InputObjectID(s)NotValid" 0 "NoErrors" ;
VAL_ 3221225472 AuxPreferredAssignmentRespError4 1 "GeneralError" 0 "NoErrors" ;
VAL_ 3221225472 ErrorCodeEscapeObj1 0 "NoErrors" 1 "NoInputFieldSelected" ;
VAL_ 3221225472 ErrorCodeEscapeObj2 0 "NoErrors" 1 "GeneralError" ;
VAL_ 3221225472 ObjectShowStatus 0 "ObjectIsHidden" 1 "ObjectIsShown" ;
VAL_ 3221225472 ErrorCodeHideShowObj1 0 "NoErrors" 1 "ReferencesToMissingObjects" ;
VAL_ 3221225472 ErrorCodeHideShowObj2 0 "NoErrors" 1 "InvalidObjectID" ;
VAL_ 3221225472 ErrorCodeHideShowObj3 0 "NoErrors" 1 "GeneralError" ;
VAL_ 3221225472 ObjectEnableStatus 0 "ObjectIsDisabled" 1 "ObjectIsEnabled" ;
VAL_ 3221225472 ErrorCodeEnableDisableObj1 0 "NoErrors" 1 "InvalidObjectID" ;
VAL_ 3221225472 ErrorCodeEnableDisableObj2 0 "NoErrors" 1 "CommandError" ;
VAL_ 3221225472 ErrorCodeEnableDisableObj3 1 "Could not complete. Operator inp" 0 "NoErrors" ;
VAL_ 3221225472 ErrorCodeEnableDisableObj4 0 "NoErrors" 1 "GeneralError" ;
VAL_ 3221225472 ObjectSelectStatus 2 "ObjectIsOpenedForEdit" 0 "ObjectIsDeselectedOrObjectIDIsNullObject" 1 "ObjectIsSelected" ;
VAL_ 3221225472 ErrorCodeSelectObject1 1 "ObjectIsDisabled" 0 "NoErrors" ;
VAL_ 3221225472 ErrorCodeSelectObject2 0 "NoErrors" 1 "InvalidObjectID" ;
VAL_ 3221225472 ErrorCodeSelectObject3 0 "NoErrors" 1 "ObjectIsNotVisible" ;
VAL_ 3221225472 ErrorCodeSelectObject4 0 "NoErrors" 1 "CouldNotComplete" ;
VAL_ 3221225472 ErrorCodeSelectObject5 0 "NoErrors" 1 "GeneralError" ;
VAL_ 3221225472 ErrorCodeControlAudioDevice1 0 "NoErrors" 1 "AudioDeviceIsBusy" ;
VAL_ 3221225472 ErrorCodeControlAudioDevice2 0 "NoErrors" 1 "GeneralError" ;
VAL_ 3221225472 ErrorCodeAudioVolume1 0 "NoErrors" 1 "AudioDeviceIsBusy" ;
VAL_ 3221225472 ErrorCodeAudioVolume2 0 "NoErrors" 1 "GeneralError" ;
VAL_ 3221225472 ErrorCodeChangeChildLocation1 0 "NoErrors" 1 "InvalidParentObjectID" ;
VAL_ 3221225472 ErrorCodeChangeChildLocation2 0 "NoErrors" 1 "InvalidObjectID" ;
VAL_ 3221225472 ErrorCodeChangeChildLocation5 0 "NoErrors" 1 "GeneralError" ;
VAL_ 3221225472 ErrorCodeObjToSize1 0 "NoErrors" 1 "InvalidObjectID" ;
VAL_ 3221225472 ErrorCodeObjToSize2 0 "NoErrors" 1 "InvalidWidth" ;
VAL_ 3221225472 ErrorCodeObjToSize3 0 "NoErrors" 1 "InvalidHeight" ;
VAL_ 3221225472 ErrorCodeObjToSize4 0 "NoErrors" 1 "GeneralError" ;
VAL_ 3221225472 ErrorCodeChangeColour1 0 "NoErrors" 1 "InvalidObjectID" ;
VAL_ 3221225472 ErrorCodeChangeColour2 0 "NoErrors" 1 "InvalidColourCode" ;
VAL_ 3221225472 ErrorCodeChangeColour3 0 "NoErrors" 1 "GeneralError" ;
VAL_ 3221225472 ErrorCodeChangeNumValue1 0 "NoErrors" 1 "InvalidObjectID" ;
VAL_ 3221225472 ErrorCodeChangeNumValue2 0 "NoErrors" 1 "InvalidValue" ;
VAL_ 3221225472 ErrorCodeChangeNumValue3 0 "NoErrors" 1 "GeneralError" ;
VAL_ 3221225472 ErrorCodeChangeEditPoint1 0 "NoErrors" 1 "InvalidObjectID" ;
VAL_ 3221225472 ErrorCodeChangeEditPoint2 0 "NoErrors" 1 "InvalidLineDirection" ;
VAL_ 3221225472 ErrorCodeChangeEditPoint3 0 "NoErrors" 1 "GeneralError" ;
VAL_ 3221225472 ErrorCodeChangeFont1 0 "NoErrors" 1 "InvalidObjectID" ;
VAL_ 3221225472 ErrorCodeChangeFont2 0 "NoErrors" 1 "InvalidColour" ;
VAL_ 3221225472 ErrorCodeChangeFont4 0 "NoErrors" 1 "InvalidType" ;
VAL_ 3221225472 ErrorCodeChangeFont3 0 "NoErrors" 1 "InvalidSize" ;
VAL_ 3221225472 ErrorCodeChangeFont5 0 "NoErrors" 1 "InvalidStyle" ;
VAL_ 3221225472 ErrorCodeChangeFont6 0 "NoErrors" 1 "GeneralError" ;
VAL_ 3221225472 ErrorCodeChangeLineAttribute1 0 "NoErrors" 1 "InvalidObjectID" ;
VAL_ 3221225472 ErrorCodeChangeLineAttribute2 0 "NoErrors" 1 "InvalidObjectColour" ;
VAL_ 3221225472 ErrorCodeChangeLineAttribute3 0 "NoErrors" 1 "InvalidWidth" ;
VAL_ 3221225472 ErrorCodeChangeLineAttribute4 0 "NoErrors" 1 "GeneralError" ;
VAL_ 3221225472 ErrorCodeChangeFillAttributes1 0 "NoErrors" 1 "InvalidObjectID" ;
VAL_ 3221225472 ErrorCodeChangeFillAttributes2 0 "NoErrors" 1 "InvalidType" ;
VAL_ 3221225472 ErrorCodeChangeFillAttributes3 0 "NoErrors" 1 "InvalidColour" ;
VAL_ 3221225472 ErrorCodeChangeFillAttributes4 0 "NoErrors" 1 "InvalidPatternObjectID" ;
VAL_ 3221225472 ErrorCodeChangeFillAttributes5 0 "NoErrors" 1 "GeneralError" ;
VAL_ 3221225472 ErrorCodeChangeActiveMask1 0 "NoErrors" 1 "InvalidWorkingSetObject" ;
VAL_ 3221225472 ErrorCodeChangeActiveMask2 0 "NoErrors" 1 "InvalidMaskObjectID" ;
VAL_ 3221225472 ErrorCodeChangeActiveMask3 0 "NoErrors" 1 "MissingObjects" ;
VAL_ 3221225472 ErrorCodeChangeActiveMask4 0 "NoErrors" 1 "MaskOrChildObjectHasErrors" ;
VAL_ 3221225472 ErrorCodeChangeActiveMask5 0 "NoErrors" 1 "GeneralError" ;
VAL_ 3221225472 ErrorCodeChangeSoftKeyMask1 0 "NoErrors" 1 "InvalidDataOrAlarmMaskObjectID" ;
VAL_ 3221225472 ErrorCodeChangeSoftKeyMask2 0 "NoErrors" 1 "InvalidSoftKeyMaskObjectID" ;
VAL_ 3221225472 ErrorCodeChangeSoftKeyMask3 0 "NoErrors" 1 "Missing Objects" ;
VAL_ 3221225472 ErrorCodeChangeSoftKeyMask4 0 "NoErrors" 1 "Mask or child object has errors" ;
VAL_ 3221225472 ErrorCodeChangeSoftKeyMask5 0 "NoErrors" 1 "GeneralError" ;
VAL_ 3221225472 ErrorCodeChangeAttribute1 0 "NoErrors" 1 "InvalidObjectID" ;
VAL_ 3221225472 ErrorCodeChangeAttribute2 0 "NoErrors" 1 "InvalidAttributeID" ;
VAL_ 3221225472 ErrorCodeChangeAttribute3 0 "NoErrors" 1 "InvalidValue" ;
VAL_ 3221225472 ErrorCodeChangeAttribute4 0 "NoErrors" 1 "GeneralError" ;
VAL_ 3221225472 ErrorCodeChangePriority1 0 "NoErrors" 1 "InvalidObjectID" ;
VAL_ 3221225472 ErrorCodeChangePriority2 0 "NoErrors" 1 "InvalidPriority" ;
VAL_ 3221225472 ErrorCodeChangePriority3 0 "NoErrors" 1 "GeneralError" ;
VAL_ 3221225472 ErrorCodeChangeListItem1 0 "NoErrors" 1 "InvalidListObjectID" ;
VAL_ 3221225472 ErrorCodeChangeListItem2 0 "NoErrors" 1 "InvalidListIndex" ;
VAL_ 3221225472 ErrorCodeChangeListItem3 0 "NoErrors" 1 "InvalidNewListItemObjectID" ;
VAL_ 3221225472 ErrorCodeChangeListItem4 0 "NoErrors" 1 "GeneralError" ;
VAL_ 3221225472 ErrorCodeDeleteObjectPool1 0 "NoErrors" 1 "DeletionError" ;
VAL_ 3221225472 ErrorCodeDeleteObjectPool2 0 "NoErrors" 1 "GeneralError" ;
VAL_ 3221225472 ErrorCodeChangeStrObjectID 0 "NoErrors" 1 "InvalidObjectID" ;
VAL_ 3221225472 ErrorCodeChangeStrTooLong 0 "NoErrors" 1 "StringTooLong" ;
VAL_ 3221225472 ErrorCodeChangeStrError 0 "NoErrors" 1 "GeneralError" ;
VAL_ 3221225472 ErrorCodeChangePosInvalidParent 0 "NoErrors" 1 "InvalidParentObjectID" ;
VAL_ 3221225472 ErrorCodeChangePosInvalidObject 0 "NoErrors" 1 "InvalidObjectID" ;
VAL_ 3221225472 ErrorCodeChangePosInvalidError 0 "NoErrors" 1 "GeneralError" ;
VAL_ 3221225472 ErrorCodeSetObjectLabel1 1 "InvalidObjectId" 0 "NoError" ;
VAL_ 3221225472 ErrorCodeSetObjectLabel2 1 "InvalidStringVariableObjectId" 0 "NoError" ;
VAL_ 3221225472 ErrorCodeSetObjectLabel3 1 "InvalidFontType" 0 "NoError" ;
VAL_ 3221225472 ErrorCodeSetObjectLabel4 1 "InvalidDesignatorObjectReference" 0 "NoError" ;
VAL_ 3221225472 ErrorCodeSetObjectLabel5 1 "DesignatorReferencesInvalidObjects" 0 "NoError" ;
VAL_ 3221225472 ErrorCodeSetObjectLabel6 1 "GeneralError" 0 "NoError" ;
VAL_ 3221225472 ErrorCodeChangePoygonPoint1 1 "InvalidObjectId" 0 "NoError" ;
VAL_ 3221225472 ErrorCodeChangePoygonPoint2 1 "InvalidPointIndex" 0 "NoError" ;
VAL_ 3221225472 ErrorCodeChangePoygonPoint3 1 "GeneralError" 0 "NoError" ;
VAL_ 3221225472 ErrorCodeChangePolygonScale1 1 "InvalidObjectId" 0 "NoError" ;
VAL_ 3221225472 ErrorCodeChangePolygonScale5 1 "GeneralError" 0 "NoError" ;
VAL_ 3221225472 ErrorCodeGraphicsContextCmd1 1 "InvalidObjectID" 0 "NoError" ;
VAL_ 3221225472 ErrorCodeGraphicsContextCmd2 1 "InvalidCommandID" 0 "NoError" ;
VAL_ 3221225472 ErrorCodeGraphicsContextCmd3 1 "InvalidParameter" 0 "NoError" ;
VAL_ 3221225472 ErrorCodeGraphicsContextCmd4 1 "CommandWillProduceInvalidResults" 0 "NoError" ;
VAL_ 3221225472 ErrorCodeGraphicsContextCmd5 1 "GeneralError" 0 "NoError" ;
VAL_ 3221225472 ErrorCodeSelectColourMap2 1 "GeneralError" 0 "NoError" ;
VAL_ 3221225472 ErrorCodeSelectColourMap1 1 "InvalidObjectID" 0 "NoError" ;
VAL_ 3221225472 ErrorCodeLockUnlockMask9 1 "GeneralError" 0 "NoError" ;
VAL_ 3221225472 ErrorCodeLockUnlockMask8 1 "UnsolicitedUnlock_OperatorInduced" 0 "NoError" ;
VAL_ 3221225472 ErrorCodeLockUnlockMask7 1 "UnsolicitedUnlock_MaskChanged" 0 "NoError" ;
VAL_ 3221225472 ErrorCodeLockUnlockMask6 1 "UnsolicitedUnlock_TimeoutOccured" 0 "NoError" ;
VAL_ 3221225472 ErrorCodeLockUnlockMask5 1 "AlarmMaskIsActive" 0 "NoError" ;
VAL_ 3221225472 ErrorCodeLockUnlockMask4 1 "MaskNotLocked" 0 "NoError" ;
VAL_ 3221225472 ErrorCodeLockUnlockMask3 1 "MaskAlreadyLocked" 0 "NoError" ;
VAL_ 3221225472 ErrorCodeLockUnlockMask2 1 "MaskNotVisibleOrInvalidObjectId" 0 "NoError" ;
VAL_ 3221225472 ErrorCodeLockUnlockMask1 1 "WorkingSetNotActive" 0 "NoError" ;
VAL_ 3221225472 ErrorCodeExecuteMacro1 1 "ObjectIdNotExist" 0 "NoError" ;
VAL_ 3221225472 ErrorCodeExecuteMacro2 1 "ObjectIdIsNoMacro" 0 "NoError" ;
VAL_ 3221225472 ErrorCodeExecuteMacro3 1 "GeneralError" 0 "NoError" ;
VAL_ 3221225472 VersionNumberISO11783Part6 0 "Hannover Agritechnica 2001 limit" 1 "FDIS_Version" 2 "VersionOfThe1PublishedEdition" 3 "VersionOfThe2PublishedEdition" 4 "VersionOfThe3PublishedEdition" 5 "VersionOfThe4PublishedEdition" 6 "VersionOfThe5PublishedEdition" 7 "VersionOfThe6PublishedEdition" 8 "VersionOfThe7PublishedEdition" 9 "VersionOfThe8PublishedEdition" 10 "VersionOfThe9PublishedEdition" 11 "VersionOfThe10PublishedEdition" 12 "VersionOfThe11PublishedEdition" 13 "VersionOfThe12PublishedEdition" 14 "VersionOfThe13PublishedEdition" 15 "VersionOfThe14PublishedEdition" 16 "VersionOfThe15PublishedEdition" 17 "VersionOfThe16PublishedEdition" 18 "VersionOfThe17PublishedEdition" 19 "VersionOfThe18PublishedEdition" 20 "VersionOfThe19PublishedEdition" 21 "VersionOfThe20PublishedEdition" 22 "VersionOfThe21PublishedEdition" 23 "VersionOfThe22PublishedEdition" 24 "VersionOfThe23PublishedEdition" 25 "VersionOfThe24PublishedEdition" 26 "VersionOfThe25PublishedEdition" 27 "VersionOfThe26PublishedEdition" 28 "VersionOfThe27PublishedEdition" 29 "VersionOfThe28PublishedEdition" 30 "VersionOfThe29PublishedEdition" 31 "VersionOfThe30PublishedEdition" 32 "VersionOfThe31PublishedEdition" 33 "VersionOfThe32PublishedEdition" 34 "VersionOfThe33PublishedEdition" 35 "VersionOfThe34PublishedEdition" 36 "VersionOfThe35PublishedEdition" 37 "VersionOfThe36PublishedEdition" 38 "VersionOfThe37PublishedEdition" 39 "VersionOfThe38PublishedEdition" 40 "VersionOfThe39PublishedEdition" 41 "VersionOfThe40PublishedEdition" 42 "VersionOfThe41PublishedEdition" 43 "VersionOfThe42PublishedEdition" 44 "VersionOfThe43PublishedEdition" 45 "VersionOfThe44PublishedEdition" 46 "VersionOfThe45PublishedEdition" 47 "VersionOfThe46PublishedEdition" 48 "VersionOfThe47PublishedEdition" 49 "VersionOfThe48PublishedEdition" 50 "VersionOfThe50PublishedEdition" ;
VAL_ 3221225472 MemoryStatus 0 "EnoughMemoryMayBeAvailable" 1 "NotEnoughMemoryAvailable" ;
VAL_ 3221225472 ErrorCodeGetSupportedWideChars2 1 "GeneralError" 0 "NoError" ;
VAL_ 3221225472 ErrorCodeGetSupportedWideChars1 1 "TooManyRanges" 0 "NoError" ;
VAL_ 3221225472 FontSize_8x8 0 "NotSupported" 1 "Supported" ;
VAL_ 3221225472 FontSize_8x12 0 "NotSupported" 1 "Supported" ;
VAL_ 3221225472 FontSize_12x16 0 "NotSupported" 1 "Supported" ;
VAL_ 3221225472 FontSize_16x16 0 "NotSupported" 1 "Supported" ;
VAL_ 3221225472 FontSize_16x24 0 "NotSupported" 1 "Supported" ;
VAL_ 3221225472 FontSize_24x32 0 "NotSupported" 1 "Supported" ;
VAL_ 3221225472 FontSize_32x32 0 "NotSupported" 1 "Supported" ;
VAL_ 3221225472 FontSize_32x48 0 "NotSupported" 1 "Supported" ;
VAL_ 3221225472 FontSize_48x64 0 "NotSupported" 1 "Supported" ;
VAL_ 3221225472 FontSize_64x64 0 "NotSupported" 1 "Supported" ;
VAL_ 3221225472 FontSize_64x96 0 "NotSupported" 1 "Supported" ;
VAL_ 3221225472 FontSize_96x128 0 "NotSupported" 1 "Supported" ;
VAL_ 3221225472 FontSize_128x128 0 "NotSupported" 1 "Supported" ;
VAL_ 3221225472 FontSize_128x192 0 "NotSupported" 1 "Supported" ;
VAL_ 3221225472 FontType_BoldText 0 "NotSupported" 1 "Supported" ;
VAL_ 3221225472 FontType_CrossedOutText 0 "NotSupported" 1 "Supported" ;
VAL_ 3221225472 FontType_UnderlinedText 0 "NotSupported" 1 "Supported" ;
VAL_ 3221225472 FontType_ItalicsText 0 "NotSupported" 1 "Supported" ;
VAL_ 3221225472 FontType_InvertedText 0 "NotSupported" 1 "Supported" ;
VAL_ 3221225472 FontType_FlashInverted 0 "NotSupported" 1 "Supported" ;
VAL_ 3221225472 FontType_FlashHidden 0 "NotSupported" 1 "Supported" ;
VAL_ 3221225472 FontType_ProportionalFont 0 "NotSupported" 1 "Supported" ;
VAL_ 3221225472 LineArts 0 "LineArtIsNotSupported" 1 "LineArtIsSupported" ;
VAL_ 3221225472 FillTypes 0 "FillPaternIsNotSupported" 1 "FillPaternIsSupported" ;
VAL_ 3221225472 ShapeFillTypes 0 "FillOfEllipseAndPolygonNotSup" 1 "FillEllipseSupAndFillPolygNotSup" 2 "FillEllipseNotSupAndFillPolygSup" 3 "FillOfEllipseAndPolygonSup" ;
VAL_ 3221225472 SupportedGrapicMode 0 "Monocrome" 1 "Colour16" 2 "Colour256" ;
VAL_ 3221225472 Hardware1 0 "VT has no touch screen and no pointing device" 1 "VT has a touch screen or pointing device" ;
VAL_ 3221225472 Hardware2 0 "VT does not report drag operation" 1 "VT reports drag operation" ;
VAL_ 3221225472 Hardware3 0 "VT has no multiple frequency audio output" 1 "VT has multiple frequency audio output" ;
VAL_ 3221225472 Hardware4 0 "VT has no adjustable volume audio output" 1 "VT has adjustable volume audio output" ;
VAL_ 3221225472 Hardware5 0 "VT does not support simultaneous activations of softkeys" 1 "VT supports simultaneous activations of softkeys" ;
VAL_ 3221225472 Hardware6 0 "VT does not support intermediate coordinates during a drag operation" 1 "VT supports intermediate coordinates during a drag operation" ;
VAL_ 3221225472 AcknowledgmentStoreVersion 0 "SuccessfullyStored" 2 "VersionLabelIsNotCorrect" 4 "InsufficientMemoryAvailable" 8 "GeneralError" ;
VAL_ 3221225472 AcknowledgmentLoadVersion 0 "SuccessfullyLoaded" 2 "VersionLabelNotCorrectOrUnknown" 4 "InsufficientMemoryAvailable" 8 "GeneralError" ;
VAL_ 3221225472 AcknowledgmentDeleteVersion 0 "SuccessfullyDeleted" 2 "VersionLabelIsNotCorrect" 4 "NA" 8 "GeneralError" ;
VAL_ 3221225472 ErrorCodeVtObjPoolError1 0 "NoErrors" 1 "UnsupportedMethodOrAttribute" ;
VAL_ 3221225472 ErrorCodeVtObjPoolError2 0 "NoErrors" 1 "UnknownObjectReference" ;
VAL_ 3221225472 ErrorCodeVtObjPoolError3 0 "NoErrors" 1 "RecursiveObjectReference" ;
VAL_ 3221225472 ErrorCodeVtObjPoolError4 0 "NoErrors" 1 "OtherError" ;
VAL_ 3221225472 VTBusyCode1 1 "VTIsBusyUpdatingVisibleMask" ;
VAL_ 3221225472 VTBusyCode2 1 "VTIsBusySavingDataToNonVolMemory" ;
VAL_ 3221225472 VTBusyCode3 1 "VTIsBusyExecutingCommand" ;
VAL_ 3221225472 VTBusyCode4 1 "VTIsBusyExecutingMacro" ;
VAL_ 3221225472 VTBusyCode5 1 "VTIsBusyParsingAnObjectPool" ;
VAL_ 3221225472 VTBusyCode8 1 "VTIsOutOfMemory" ;
VAL_ 2565340800 VTFunctionECUtoVT 36 "AuxiliaryAssignmentResponseType2" 193 "GetSupported WideChars" 37 "AuxiliaryInputStatusEnableCommandResponse" 35 "AuxiliaryInputMaintenance" 190 "ExecuteMacro" 189 "LockUnlockMask" 34 "AuxiliaryPreferredAssignment" 9 "DisplayActivationResponse" 186 "SelectColourMap" 185 "GetAttribute" 184 "GraphicsContextCommand" 183 "ChangePolygonScale" 182 "ChangePolygonPoint" 181 "SetObjectLabel" 0 "SoftKeyActivationResponse" 1 "ButtonActivationResponse" 2 "PointingEventResponse" 18 "EndOfObjectPool" 32 "AuxiliaryAssignmentResponse" 146 "ESC" 160 "ShowHideObject" 161 "EnableDisableObject" 162 "SelectInputObject" 163 "ControlAudioDevice" 164 "SetAudioVolume" 165 "ChangeChildLocation" 166 "ChangeSize" 167 "ChangeBackgroundColour" 168 "ChangeNumericValue" 169 "ChangeEndPoint" 170 "ChangeFontAttributes" 171 "ChangeLineAttributes" 172 "ChangeFillAttributes" 173 "ChangeActiveMask" 174 "ChangeSoftKeyMask" 175 "ChangeAttribute" 176 "ChangePriority" 177 "ChangeListItem" 178 "DeleteObjectPool" 192 "GetMemory" 194 "GetNumberOfSoftKeys" 195 "GetTextFontData" 199 "GetHardware" 208 "StoreVersion" 209 "LoadVersion" 210 "DeleteVersion" 223 "GetVersions" 255 "WorkingSetMaintenance" 179 "ChangeStringValue" 3 "VTSelectInputObjectResponse" 4 "VTESCResponse" 5 "VTChangeNumericValueResponse" 6 "VTChangeActiveMaskResponse" 7 "VTChangeSoftKeyMaskResponse" 196 "GetFillAndLineData" 17 "ObjectPoolTransfer" 180 "ChangeChildPosition" 8 "InputStringValueResponse" ;
VAL_ 2565340800 KeyActivationCode 3 "KeyPressAborted" 0 "KeyHasBeenReleased" 1 "KeyHasBeenPressed" 2 "KeyIsStillHeld" ;
VAL_ 2565340800 KeyObjectParentID 0 "KeyHasBeenReleased" 1 "KeyHasBeenPressed" 2 "KeyIsStillHeld" ;
VAL_ 2565340800 KeyObjectID 0 "KeyHasBeenReleased" 1 "KeyHasBeenPressed" 2 "KeyIsStillHeld" ;
VAL_ 2565340800 ButtonActivationCode 3 "ButtonPressAborted" 0 "ButtonHasBeenUnlatched" 1 "ButtonHasBeenLatched" 2 "ButtonsStillHeld" ;
VAL_ 2565340800 ButtonObjectID 0 "ButtonHasBeenUnlatched" 1 "ButtonHasBeenLatched" 2 "ButtonsStillHeld" ;
VAL_ 2565340800 ButtonObjectParentID 0 "ButtonHasBeenUnlatched" 1 "ButtonHasBeenLatched" 2 "ButtonsStillHeld" ;
VAL_ 2565340800 AssignmentErrorNotAccepted 0 "AssignmentAccepted" 1 "Rejected_InputAlreadyAssigned" ;
VAL_ 2565340800 ShowOrHide 0 "Hide" 1 "Show" ;
VAL_ 2565340800 EnableOrDisable 0 "Disable" 1 "Enable" ;
VAL_ 2565340800 MaskType 1 "Data" 2 "Alarm" ;
VAL_ 2565340802 VTFunctionECUtoVT 36 "AuxiliaryAssignmentResponseType2" 193 "GetSupported WideChars" 37 "AuxiliaryInputStatusEnableCommandResponse" 35 "AuxiliaryInputMaintenance" 190 "ExecuteMacro" 189 "LockUnlockMask" 34 "AuxiliaryPreferredAssignment" 9 "DisplayActivationResponse" 186 "SelectColourMap" 185 "GetAttribute" 184 "GraphicsContextCommand" 183 "ChangePolygonScale" 182 "ChangePolygonPoint" 181 "SetObjectLabel" 0 "SoftKeyActivationResponse" 1 "ButtonActivationResponse" 2 "PointingEventResponse" 18 "EndOfObjectPool" 32 "AuxiliaryAssignmentResponse" 146 "ESC" 160 "ShowHideObject" 161 "EnableDisableObject" 162 "SelectInputObject" 163 "ControlAudioDevice" 164 "SetAudioVolume" 165 "ChangeChildLocation" 166 "ChangeSize" 167 "ChangeBackgroundColour" 168 "ChangeNumericValue" 169 "ChangeEndPoint" 170 "ChangeFontAttributes" 171 "ChangeLineAttributes" 172 "ChangeFillAttributes" 173 "ChangeActiveMask" 174 "ChangeSoftKeyMask" 175 "ChangeAttribute" 176 "ChangePriority" 177 "ChangeListItem" 178 "DeleteObjectPool" 192 "GetMemory" 194 "GetNumberOfSoftKeys" 195 "GetTextFontData" 199 "GetHardware" 208 "StoreVersion" 209 "LoadVersion" 210 "DeleteVersion" 223 "GetVersions" 255 "WorkingSetMaintenance" 179 "ChangeStringValue" 3 "VTSelectInputObjectResponse" 4 "VTESCResponse" 5 "VTChangeNumericValueResponse" 6 "VTChangeActiveMaskResponse" 7 "VTChangeSoftKeyMaskResponse" 196 "GetFillAndLineData" 17 "ObjectPoolTransfer" 180 "ChangeChildPosition" 8 "InputStringValueResponse" ;
VAL_ 2565340802 KeyActivationCode 3 "KeyPressAborted" 0 "KeyHasBeenReleased" 1 "KeyHasBeenPressed" 2 "KeyIsStillHeld" ;
VAL_ 2565340802 KeyObjectParentID 0 "KeyHasBeenReleased" 1 "KeyHasBeenPressed" 2 "KeyIsStillHeld" ;
VAL_ 2565340802 KeyObjectID 0 "KeyHasBeenReleased" 1 "KeyHasBeenPressed" 2 "KeyIsStillHeld" ;
VAL_ 2565340802 ButtonActivationCode 3 "ButtonPressAborted" 0 "ButtonHasBeenUnlatched" 1 "ButtonHasBeenLatched" 2 "ButtonsStillHeld" ;
VAL_ 2565340802 ButtonObjectID 0 "ButtonHasBeenUnlatched" 1 "ButtonHasBeenLatched" 2 "ButtonsStillHeld" ;
VAL_ 2565340802 ButtonObjectParentID 0 "ButtonHasBeenUnlatched" 1 "ButtonHasBeenLatched" 2 "ButtonsStillHeld" ;
VAL_ 2565340802 AssignmentErrorNotAccepted 0 "AssignmentAccepted" 1 "Rejected_InputAlreadyAssigned" ;
VAL_ 2565340802 ShowOrHide 0 "Hide" 1 "Show" ;
VAL_ 2565340802 EnableOrDisable 0 "Disable" 1 "Enable" ;
VAL_ 2565340802 MaskType 1 "Data" 2 "Alarm" ;
VAL_ 2632384130 VTFunctionVTtoECU 38 "AuxiliaryInputStatusType2" 36 "AuxiliaryAssignmentCommandType2" 193 "GetSupported WideCharsResponse" 37 "AuxiliaryInputStatusEnableCommand" 190 "ExecuteMacroResponse" 189 "LockUnlockMaskResponse" 35 "AuxiliaryInputMaintenance" 10 "VTControlAudioDeviceTermination" 9 "DisplayActivation" 186 "SelectColourMapResponse" 185 "GetAttributeValueResponse" 184 "GraphicsContextCommandResponse" 183 "ChangePolygonScaleResponse" 182 "ChangePolygonPointResponse" 181 "SetObjectLabelResponse" 0 "SoftKeyActivation" 1 "ButtonActivation" 2 "PointingEvent" 18 "EndOfObjectPoolResponse" 32 "AuxiliaryAssignmentCommand" 146 "ESCResponse" 160 "ShowHideObjectResponse" 161 "EnableDisableObjectResponse" 162 "SelectInputObjectResponse" 163 "ControlAudioDeviceResponse" 164 "SetAudioVolumeResponse" 165 "ChangeChildLocationResponse" 166 "ChangeSizeResponse" 167 "ChangeBackgroundColourResponse" 168 "ChangeNumericValueResponse" 169 "ChangeEndPointResponse" 170 "ChangeFontAttributesResponse" 171 "ChangeLineAttributesResponse" 172 "ChangeFillAttributesResponse" 173 "ChangeActiveMaskResponse" 174 "ChangeSoftKeyMaskResponse" 175 "ChangeAttributeResponse" 176 "ChangePriorityResponse" 177 "ChangeListItemResponse" 178 "DeleteObjectPoolResponse" 192 "GetMemoryResponse" 194 "GetNumberOfSoftKeysResponse" 195 "GetTextFontDataResponse" 199 "GetHardwareResponse" 208 "StoreVersionResponse" 209 "LoadVersionResponse" 210 "DeleteVersionResponse" 224 "GetVersionsResponse" 254 "VTStatusMessage" 33 "AuxiliaryInputStatus" 3 "VTSelectInputObject" 4 "VTESC" 5 "VTChangeNumericValue" 6 "VTChangeActiveMask" 7 "VTChangeSoftKeyMask" 8 "InputStringValue" 196 "GetFillAndLineDataResponse" 240 "VTObjectPoolErrorMessage" 179 "ChangeStringValueResponse" 180 "ChangeChildPositionResponse" 34 "AuxiliaryPreferredAssignmentResponse" ;
VAL_ 2632384130 KeyActivationCode 3 "KeyPressAborted" 0 "KeyHasBeenReleased" 1 "KeyHasBeenPressed" 2 "KeyIsStillPressed" ;
VAL_ 2632384130 KeyObjectID 0 "KeyHasBeenReleased" 1 "KeyHasBeenPressed" 2 "KeyIsStillPressed" ;
VAL_ 2632384130 KeyObjectParentID 0 "KeyHasBeenReleased" 1 "KeyHasBeenPressed" 2 "KeyIsStillPressed" ;
VAL_ 2632384130 SoftKeyCode 0 "AlarmACK" ;
VAL_ 2632384130 ButtonActivationCode 3 "ButtonPressAborted" 0 "ButtonHasBeenUnlatched" 1 "ButtonHasBeenLatched" 2 "ButtonIsStillHeld" ;
VAL_ 2632384130 ButtonObjectID 0 "KeyHasBeenReleased" 1 "KeyHasBeenPressed" 2 "KeyIsStillPressed" ;
VAL_ 2632384130 ButtonObjectParentID 0 "KeyHasBeenReleased" 1 "KeyHasBeenPressed" 2 "KeyIsStillPressed" ;
VAL_ 2632384130 TouchState 255 "Pressed" 2 "Held" 1 "Pressed" 0 "Released" ;
VAL_ 2632384130 VTSelectInputObjectStatus 0 "ObjectIsDeselected" 1 "ObjectIsSelected" ;
VAL_ 2632384130 VTSelectInputObjectIsEdited 0 "ObjectIsNotEdited" 1 "ObjectIsOpenForEditing" ;
VAL_ 2632384130 ErrorCodeVTEsc1 0 "NoError" 1 "NoInputFieldSelected ESC_Ignored" ;
VAL_ 2632384130 ErrorCodeVTEsc2 0 "NoError" 1 "GeneralError" ;
VAL_ 2632384130 ErrorCodeMissingObjects 0 "NoErrors" 1 "MissingObjects" ;
VAL_ 2632384130 ErrorCodeMaskOrChildObjectError 0 "NoErrors" 1 "MaskOrChildObjectHasErrors" ;
VAL_ 2632384130 ErrorCodeAnyOtherError 0 "NoErrors" 1 "GeneralError" ;
VAL_ 2632384130 ErrorCodePoolDeleted 0 "NoErrors" 1 "PoolBeingDeleted" ;
VAL_ 2632384130 ErrorCodeVTChangeSoftKeyMask1 0 "NoError" 1 "InvalidDataOrAlarmMaskObjectID" ;
VAL_ 2632384130 ErrorCodeVTChangeSoftKeyMask2 0 "NoError" 1 "InvalidSoftKeyMaskObjectID" ;
VAL_ 2632384130 ErrorCodeVTChangeSoftKeyMask3 0 "NoError" 1 "MissingObjects" ;
VAL_ 2632384130 ErrorCodeVTChangeSoftKeyMask4 0 "NoError" 1 "MaskOrChildObjectHasErrors" ;
VAL_ 2632384130 ErrorCodeVTChangeSoftKeyMask5 0 "NoError" 1 "GeneralError" ;
VAL_ 2632384130 ErrorCodeEndOfObjectPool1 1 "ErrorsInTheObjectPool" 0 "NoErrors" ;
VAL_ 2632384130 ErrorCodeEndOfObjectPool2 0 "NoErrors" 1 "VTRanOutOfMemoryDuringTransfer" ;
VAL_ 2632384130 ErrorCodeEndOfObjectPool3 0 "NoErrors" 1 "GeneralError" ;
VAL_ 2632384130 ErrorCodeObjectPool1 0 "NoErrors" 1 "MethodOrAttributeNotSupportedByV" ;
VAL_ 2632384130 ErrorCodeObjectPool2 0 "NoErrors" 1 "UnknownObjectReference" ;
VAL_ 2632384130 ErrorCodeObjectPool3 0 "NoErrors" 1 "GeneralError" ;
VAL_ 2632384130 ErrorCodeObjectPool4 0 "NoErrors" 1 "ObjectPoolWasDeletedFromVolatile" ;
VAL_ 2632384130 ManufacturerCode 1863 "Thomas G. Faria Co." 1862 "Sanshin" 1861 "Vector North America" 1860 "MMP" 1859 "Kvasar AB" 1858 "Litton" 1857 "Simrad" 1856 "Trimble" 1855 "Furuno USA" 1854 "Northstar Technologies" 1853 "Japan Radio Co." 1852 "Navionics" 1851 "Raymarine" 1850 "Teleflex" 222 "Generac Power Systems, Inc." 221 "SiE" 220 "Beede Electrical Instrument Company, Inc." 219 "Cat OEM Solutions" 218 "Gits Manufacturing Company" 217 "RM Michaelides Software & Elektronik GmbH" 216 "Paneltronics Inc." 215 "Aetna Engineering/Fireboy-Xintex" 214 "MC elettronica Srl" 213 "CNH Belgium N.V." 212 "Sure Power Industries, Inc." 211 "DNA Group" 210 "Iteris, Inc." 209 "Bell Equip. Co. SA (PTY) LTD" 208 "Drew Technologies, Inc." 207 "Otto Engineering" 206 "port GmbH" 205 "SmarTire Systems Inc" 204 "The Morey Corporation" 203 "MILtronik GmbH" 202 "Curtis Instruments, Inc." 201 "Disenos y Tecnologia S.A." 200 "MGM Brakes" 199 "Actia Corp." 198 "Mystic Valley Communications" 197 "Mechron Power Systems" 196 "LEMKEN GmbH & Co. KG" 195 "General Engine Products" 194 "TriMark Corporation" 193 "Jeppesen Marine" 192 "Floscan" 191 "XATA Corporation" 190 "Hella KGaA Hueck & Co." 189 "QUALCOMM" 188 "EMP Corp." 187 "Air-Weigh" 186 "Altronic, Inc." 185 "Beede Electrical Instrument Company" 184 "EIA Electronics" 183 "KDS Controls, Inc." 182 "Vehicle Systems Engineering B.V." 181 "Coretronics, Inc." 180 "Smart Power Systems" 179 "Midwest Technologies Illinois, LLC" 178 "Siemens VDO Automotive AG" 177 "Diagnostic System Associates" 176 "Moritz Aerospace" 175 "Veris Technologies, Inc." 174 "AB Volvo Penta" 173 "Ryeso, Inc." 172 "Yanmar Marine USA" 171 "Wachendorff Elektronik GmbH & Co. KG" 170 "Computronics Corporation Ltd." 169 "Marlin Technologies Inc." 168 "Xantrex" 167 "JLG Industries Inc." 166 "Phoenix International" 165 "CPAC Systems AB" 164 "DaimlerChrysler Off-Highway" 163 "BRP Inc." 162 "Axiomatic Technologies" 161 "Offshore Systems (UK) Limited" 160 "Nido" 159 "NTech Industries Inc." 158 "Firestone Industrial Products Company" 157 "ISSPRO Inc." 156 "ITT Industries - Cannon" 155 "Vetronix Corporation" 154 "Westerbeke Corporation" 153 "Woodward, Industrial Controls Division" 152 "Elobau Elektrobauelemente GmbH & Co. KG" 151 "Raven Industries Inc. - Flow Controls Division" 150 "Fleetguard" 149 "Holset" 148 "Blue Water Data, Inc." 147 "Nautibus Electronic GmbH" 146 "Maxima Technologies" 145 "MurCal Controls" 144 "Mercury Marine" 143 "W. Gmeiner GmbH & Co." 142 "TRW Automotive (Commercial Steering Systems)" 141 "Thales Navigation Ltd." 140 "Lowrance Electronics, Inc." 139 "Caterpillar Trimble Control Technologies (CTCT), LLC" 138 "Georg Fritzmeier GmbH & Co. KG" 137 "Maretron" 136 "Komatsu Ltd." 135 "Airmar Technology Corporation" 134 "Iris Technology Ltd." 133 "Bucher Schoerling GmbH" 132 "Mulag-Fahrzeugwerk" 131 "ITT Industries" 130 "Nido - Universal Machines B.V." 129 "OMNEX Control Systems, Inc." 128 "Gerhard Duecker GmbH & Co. KG" 127 "Holland USA" 126 "Driver Tech" 125 "Nevada Automotive Test Center" 124 "Hydac Electronic" 123 "Basler Electric" 122 "FG Wilson (Engineering) Limited" 121 "HED (Hydro Electronic Devices, Inc.)" 120 "RDS Technology Ltd." 119 "IntegriNautics" 118 "Intron GmbH" 117 "HUSCO International" 116 "BEELINE Technologies" 115 "NACCO Materials Handling Group, Inc." 114 "EControls, Inc." 113 "Stress-Tek, Inc." 112 "MECALAC" 111 "Maschinenfabrik Bernhard Krone GmbH" 110 "EPIQ Sensor-Nite" 109 "LH Technologies ApS" 108 "WTK-Elecktronik GmbH" 107 "Grimme Landmaschinen GmbH & Co. KG" 106 "BAE Systems Controls, Inc." 105 "Kiepe Elektrik GmbH & Co. KG" 104 "Claas Selbstfahrende Erntemaschinen GmbH" 103 "Agrocom GmbH & Co. Agrarsystem KG" 102 "AGCO GmbH & Co." 101 "Sensoria" 100 "VDO Technik AG" 99 "International Transmissions Ltd (ITL)" 98 "Mueller-Elektronik GmbH & Co." 97 "Ag Leader Technology, Inc." 96 "Mech@tronic IT GmbH" 95 "Pacific Insight Electronics Corp." 94 "CNH Global N.V." 93 "Perkins Engines Company Ltd." 92 "Ag-Chem Equipment Co., Inc." 91 "BSG Bodensee Steuergeraete GmbH" 90 "Knorr-Bremse SfN GmbH" 89 "Kverneland Group, Electronics Division" 88 "Satloc Precision GPS" 87 "J.C. Bamford Excavators Ltd (JCB)" 86 "C.E. Niehoff & Company" 85 "Kohler Co." 84 "New Holland UK Limited" 83 "Eaton VORAD Technologies" 82 "Bobcat/Ingersoll-Rand" 81 "Fire Research Corp" 80 "Twin Disc, Inc." 79 "Daimler Benz AG - Engine Division (PBM)" 78 "Frank W. Murphy Manufacturing, Inc." 77 "Deere Power Systems Group" 76 "unused" 75 "Deere & Co. Agricultural Division" 74 "Eaton Axle-Brake Division" 73 "LeTourneau, Inc." 72 "Sisu Corporation" 71 "Vansco Electronics Ltd." 70 "Flex-Coil Limited" 69 "Trimble Navigation" 68 "Scania" 67 "Funk Manufacturing Company" 66 "John Deere Construction Equipment Division" 65 "MAN Nutzfahrzeuge AG" 64 "unused" 63 "ZF Industries Inc." 62 "Wabco" 61 "Volvo Truck Corp." 60 "Volvo Trucks North America Inc." 59 "VES Inc." 58 "SPX Corporation, OTC Division" 57 "Sauer-Danfoss Co." 56 "SAIC" 55 "Ryder System Inc." 54 "Meritor Wabco" 53 "Rockwell Land Transportation" 52 "Meritor Automotive, Inc." 51 "Robert Bosch GmbH" 50 "Robert Bosch Corp" 49 "RE America Inc." 48 "Pollak Alphabet" 47 "Phillips Semiconductor" 46 "Parasoft Computing Solutions" 45 "PACCAR" 44 "Nippondenso Co. Ltd." 43 "International Truck and Engine Corp. Vehicle Electronics" 42 "International Truck and Engine Corp. Engine Electronics" 41 "Motorola Inc." 40 "Motorola AIEG Inc." 39 "Microfirm Inc." 38 "Micro Processor Systems Inc." 37 "Mack Trucks Inc." 36 "Lucas Ltd." 35 "Kenworth Truck Co." 34 "Kelsey Hayes Co." 33 "John Deere" 32 "Jacobs Vehicle Systems" 31 "J Pollak Corp." 30 "Isuzu Motors Ltd." 29 "Hino Motors Ltd." 28 "Grote Ind. Inc." 27 "GMC" 26 "General Motors Corp., Service Technology Group" 25 "Freightliner LLC" 24 "Ford Motor Co., Vehicle Controls" 23 "Ford Motor Co., Heavy Truck" 22 "Ford Motor Co., Electronic Concepts $ Systems" 21 "Echilin Inc., Midland Brake Inc." 20 "Eaton Ltd" 19 "Eaton Corp. Trucking Info Services" 18 "Eaton Corp, Transmission Division" 17 "Eaton Corp. Res & Dev" 16 "Eaton Corp." 15 "Dickey-John Corp." 14 "Detroit Diesel Corporation" 13 "Delco Electronics" 12 "Deere & Company, Precision Farming" 11 "Dearborn Group Inc." 10 "Cummins Engine Co." 9 "Chrysler Corp." 8 "Caterpillar Inc." 7 "Case Corp." 6 "Berifors Electronics AB" 5 "AMP Inc." 4 "Ametek-Dixson" 3 "Ametek, US Gauge Division" 2 "Allison Transmission, GMC" 1 "Allied Signal Inc." 0 "Reserved" ;
VAL_ 2632384130 Function 127 "Reserved" 126 "Reserved" 125 "Reserved" 124 "Reserved" 123 "Reserved" 122 "Reserved" 121 "Reserved" 120 "Reserved" 119 "Reserved" 118 "Reserved" 117 "Reserved" 116 "Reserved" 115 "Reserved" 114 "Reserved" 113 "Reserved" 112 "Reserved" 111 "Reserved" 110 "Reserved" 109 "Reserved" 108 "Reserved" 107 "Reserved" 106 "Reserved" 105 "Reserved" 104 "Reserved" 103 "Reserved" 102 "Reserved" 101 "Reserved" 42 "Water Pump Control" 41 "Lighting - Operator Controls" 40 "Seat Control" 39 "Ignition Control Module" 38 "Tire Pressure Control" 37 "Cab Controller" 36 "Pneumatic - System Controller" 35 "Suspension - System Controller" 34 "Hydraulic Pump Controller" 33 "System Monitor" 32 "Headway Controller" 31 "Propulsion Battery Charger" 30 "Management Computer" 29 "Virtual Terminal (In Cab)" 28 "Off Vehicle Gateway" 27 "Power TakeOff (Secondary or Front)" 26 "Body Controller" 25 "Network Interconnect ECU" 24 "Vehicle Security" 23 "Vehicle Navigation" 22 "Aerodynamic Control" 21 "Cab Climate Control" 20 "Trip Recorder" 19 "Instrument Cluster" 18 "Suspension - Drive Axle" 17 "Suspension - Steer Axle" 16 "Steeting Controller" 15 "Fuel System" 14 "Cruise Control" 13 "Retarder - Driveline" 12 "Retarder - Engine" 11 "Brakes - Drive Axle" 10 "Brakes - Steer Axle" 9 "Brakes - System Controller" 8 "Axle - Drive" 7 "Axle - Steering" 6 "Power TakeOff - (Main or Rear)" 5 "Shift Control/Console" 4 "Battery Pack Monitor" 3 "Transmission" 2 "Electric Propulsion Control" 1 "Auxiliary Power Unit (APU)" 0 "Engine" 100 "Reserved" 99 "Reserved" 98 "Reserved" 97 "Reserved" 96 "Reserved" 95 "Reserved" 94 "Reserved" 93 "Reserved" 92 "Reserved" 91 "Reserved" 90 "Reserved" 89 "Reserved" 88 "Reserved" 87 "Reserved" 86 "Reserved" 85 "Reserved" 84 "Reserved" 83 "Reserved" 82 "Reserved" 81 "Reserved" 80 "Reserved" 79 "Reserved" 78 "Reserved" 77 "Reserved" 76 "Reserved" 75 "Reserved" 74 "Reserved" 73 "Reserved" 72 "Coolant Valve Controller" 71 "Transfer Case Control" 70 "Auxiliary Regeneration Device" 69 "Engine Emission Aftertreatement System" 68 "Aftertreatment system gas measurement" 67 "Electrical System Controller" 66 "I/O Controller" 65 "Gas Flow Measurement" 64 "Endurance Braking" 63 "Engine Valve Controller" 62 "On-Board Diagnostic Unit" 61 "File Server/Printer" 60 "Cab Display" 59 "Starter" 58 "Fan Drive Control" 57 "Steering Column Unit" 56 "Communications Unit, Radio" 55 "Communications Unit, Satellite" 54 "Communications Unit, Cellular" 53 "Alternator/Charging System" 52 "Chassis Controller" 51 "Forward-Looking Collision Warning System" 50 "Auxiliary Heater" 49 "Clutch/Converter Control" 48 "Ramp Control" 47 "Information System Controller" 46 "Oil Sensor Unit" 45 "Vehicle Dynamic Stability Control" 44 "Exhaust Emission Control" 43 "Transmission Display" ;
VAL_ 2632384130 IndustryGroup 0 "Global" 1 "OnHighway" 2 "AgriculturalAndForestry" 3 "Construction" 4 "Marine" 5 "Reserved" 7 "NotAvailable" ;
VAL_ 2632384130 AuxPreferredAssignmentRespError1 1 "AuxiliaryInputUnit(s)NotValid" 0 "NoErrors" ;
VAL_ 2632384130 AuxPreferredAssignmentRespError2 1 "FunctionObjectID(s)NotValid" 0 "NoErrors" ;
VAL_ 2632384130 AuxPreferredAssignmentRespError3 1 "InputObjectID(s)NotValid" 0 "NoErrors" ;
VAL_ 2632384130 AuxPreferredAssignmentRespError4 1 "GeneralError" 0 "NoErrors" ;
VAL_ 2632384130 ErrorCodeEscapeObj1 0 "NoErrors" 1 "NoInputFieldSelected" ;
VAL_ 2632384130 ErrorCodeEscapeObj2 0 "NoErrors" 1 "GeneralError" ;
VAL_ 2632384130 ObjectShowStatus 0 "ObjectIsHidden" 1 "ObjectIsShown" ;
VAL_ 2632384130 ErrorCodeHideShowObj1 0 "NoErrors" 1 "ReferencesToMissingObjects" ;
VAL_ 2632384130 ErrorCodeHideShowObj2 0 "NoErrors" 1 "InvalidObjectID" ;
VAL_ 2632384130 ErrorCodeHideShowObj3 0 "NoErrors" 1 "GeneralError" ;
VAL_ 2632384130 ObjectEnableStatus 0 "ObjectIsDisabled" 1 "ObjectIsEnabled" ;
VAL_ 2632384130 ErrorCodeEnableDisableObj1 0 "NoErrors" 1 "InvalidObjectID" ;
VAL_ 2632384130 ErrorCodeEnableDisableObj2 0 "NoErrors" 1 "CommandError" ;
VAL_ 2632384130 ErrorCodeEnableDisableObj3 1 "Could not complete. Operator inp" 0 "NoErrors" ;
VAL_ 2632384130 ErrorCodeEnableDisableObj4 0 "NoErrors" 1 "GeneralError" ;
VAL_ 2632384130 ObjectSelectStatus 2 "ObjectIsOpenedForEdit" 0 "ObjectIsDeselectedOrObjectIDIsNullObject" 1 "ObjectIsSelected" ;
VAL_ 2632384130 ErrorCodeSelectObject1 1 "ObjectIsDisabled" 0 "NoErrors" ;
VAL_ 2632384130 ErrorCodeSelectObject2 0 "NoErrors" 1 "InvalidObjectID" ;
VAL_ 2632384130 ErrorCodeSelectObject3 0 "NoErrors" 1 "ObjectIsNotVisible" ;
VAL_ 2632384130 ErrorCodeSelectObject4 0 "NoErrors" 1 "CouldNotComplete" ;
VAL_ 2632384130 ErrorCodeSelectObject5 0 "NoErrors" 1 "GeneralError" ;
VAL_ 2632384130 ErrorCodeControlAudioDevice1 0 "NoErrors" 1 "AudioDeviceIsBusy" ;
VAL_ 2632384130 ErrorCodeControlAudioDevice2 0 "NoErrors" 1 "GeneralError" ;
VAL_ 2632384130 ErrorCodeAudioVolume1 0 "NoErrors" 1 "AudioDeviceIsBusy" ;
VAL_ 2632384130 ErrorCodeAudioVolume2 0 "NoErrors" 1 "GeneralError" ;
VAL_ 2632384130 ErrorCodeChangeChildLocation1 0 "NoErrors" 1 "InvalidParentObjectID" ;
VAL_ 2632384130 ErrorCodeChangeChildLocation2 0 "NoErrors" 1 "InvalidObjectID" ;
VAL_ 2632384130 ErrorCodeChangeChildLocation5 0 "NoErrors" 1 "GeneralError" ;
VAL_ 2632384130 ErrorCodeObjToSize1 0 "NoErrors" 1 "InvalidObjectID" ;
VAL_ 2632384130 ErrorCodeObjToSize2 0 "NoErrors" 1 "InvalidWidth" ;
VAL_ 2632384130 ErrorCodeObjToSize3 0 "NoErrors" 1 "InvalidHeight" ;
VAL_ 2632384130 ErrorCodeObjToSize4 0 "NoErrors" 1 "GeneralError" ;
VAL_ 2632384130 ErrorCodeChangeColour1 0 "NoErrors" 1 "InvalidObjectID" ;
VAL_ 2632384130 ErrorCodeChangeColour2 0 "NoErrors" 1 "InvalidColourCode" ;
VAL_ 2632384130 ErrorCodeChangeColour3 0 "NoErrors" 1 "GeneralError" ;
VAL_ 2632384130 ErrorCodeChangeNumValue1 0 "NoErrors" 1 "InvalidObjectID" ;
VAL_ 2632384130 ErrorCodeChangeNumValue2 0 "NoErrors" 1 "InvalidValue" ;
VAL_ 2632384130 ErrorCodeChangeNumValue3 0 "NoErrors" 1 "GeneralError" ;
VAL_ 2632384130 ErrorCodeChangeEditPoint1 0 "NoErrors" 1 "InvalidObjectID" ;
VAL_ 2632384130 ErrorCodeChangeEditPoint2 0 "NoErrors" 1 "InvalidLineDirection" ;
VAL_ 2632384130 ErrorCodeChangeEditPoint3 0 "NoErrors" 1 "GeneralError" ;
VAL_ 2632384130 ErrorCodeChangeFont1 0 "NoErrors" 1 "InvalidObjectID" ;
VAL_ 2632384130 ErrorCodeChangeFont2 0 "NoErrors" 1 "InvalidColour" ;
VAL_ 2632384130 ErrorCodeChangeFont4 0 "NoErrors" 1 "InvalidType" ;
VAL_ 2632384130 ErrorCodeChangeFont3 0 "NoErrors" 1 "InvalidSize" ;
VAL_ 2632384130 ErrorCodeChangeFont5 0 "NoErrors" 1 "InvalidStyle" ;
VAL_ 2632384130 ErrorCodeChangeFont6 0 "NoErrors" 1 "GeneralError" ;
VAL_ 2632384130 ErrorCodeChangeLineAttribute1 0 "NoErrors" 1 "InvalidObjectID" ;
VAL_ 2632384130 ErrorCodeChangeLineAttribute2 0 "NoErrors" 1 "InvalidObjectColour" ;
VAL_ 2632384130 ErrorCodeChangeLineAttribute3 0 "NoErrors" 1 "InvalidWidth" ;
VAL_ 2632384130 ErrorCodeChangeLineAttribute4 0 "NoErrors" 1 "GeneralError" ;
VAL_ 2632384130 ErrorCodeChangeFillAttributes1 0 "NoErrors" 1 "InvalidObjectID" ;
VAL_ 2632384130 ErrorCodeChangeFillAttributes2 0 "NoErrors" 1 "InvalidType" ;
VAL_ 2632384130 ErrorCodeChangeFillAttributes3 0 "NoErrors" 1 "InvalidColour" ;
VAL_ 2632384130 ErrorCodeChangeFillAttributes4 0 "NoErrors" 1 "InvalidPatternObjectID" ;
VAL_ 2632384130 ErrorCodeChangeFillAttributes5 0 "NoErrors" 1 "GeneralError" ;
VAL_ 2632384130 ErrorCodeChangeActiveMask1 0 "NoErrors" 1 "InvalidWorkingSetObject" ;
VAL_ 2632384130 ErrorCodeChangeActiveMask2 0 "NoErrors" 1 "InvalidMaskObjectID" ;
VAL_ 2632384130 ErrorCodeChangeActiveMask3 0 "NoErrors" 1 "MissingObjects" ;
VAL_ 2632384130 ErrorCodeChangeActiveMask4 0 "NoErrors" 1 "MaskOrChildObjectHasErrors" ;
VAL_ 2632384130 ErrorCodeChangeActiveMask5 0 "NoErrors" 1 "GeneralError" ;
VAL_ 2632384130 ErrorCodeChangeSoftKeyMask1 0 "NoErrors" 1 "InvalidDataOrAlarmMaskObjectID" ;
VAL_ 2632384130 ErrorCodeChangeSoftKeyMask2 0 "NoErrors" 1 "InvalidSoftKeyMaskObjectID" ;
VAL_ 2632384130 ErrorCodeChangeSoftKeyMask3 0 "NoErrors" 1 "Missing Objects" ;
VAL_ 2632384130 ErrorCodeChangeSoftKeyMask4 0 "NoErrors" 1 "Mask or child object has errors" ;
VAL_ 2632384130 ErrorCodeChangeSoftKeyMask5 0 "NoErrors" 1 "GeneralError" ;
VAL_ 2632384130 ErrorCodeChangeAttribute1 0 "NoErrors" 1 "InvalidObjectID" ;
VAL_ 2632384130 ErrorCodeChangeAttribute2 0 "NoErrors" 1 "InvalidAttributeID" ;
VAL_ 2632384130 ErrorCodeChangeAttribute3 0 "NoErrors" 1 "InvalidValue" ;
VAL_ 2632384130 ErrorCodeChangeAttribute4 0 "NoErrors" 1 "GeneralError" ;
VAL_ 2632384130 ErrorCodeChangePriority1 0 "NoErrors" 1 "InvalidObjectID" ;
VAL_ 2632384130 ErrorCodeChangePriority2 0 "NoErrors" 1 "InvalidPriority" ;
VAL_ 2632384130 ErrorCodeChangePriority3 0 "NoErrors" 1 "GeneralError" ;
VAL_ 2632384130 ErrorCodeChangeListItem1 0 "NoErrors" 1 "InvalidListObjectID" ;
VAL_ 2632384130 ErrorCodeChangeListItem2 0 "NoErrors" 1 "InvalidListIndex" ;
VAL_ 2632384130 ErrorCodeChangeListItem3 0 "NoErrors" 1 "InvalidNewListItemObjectID" ;
VAL_ 2632384130 ErrorCodeChangeListItem4 0 "NoErrors" 1 "GeneralError" ;
VAL_ 2632384130 ErrorCodeDeleteObjectPool1 0 "NoErrors" 1 "DeletionError" ;
VAL_ 2632384130 ErrorCodeDeleteObjectPool2 0 "NoErrors" 1 "GeneralError" ;
VAL_ 2632384130 ErrorCodeChangeStrObjectID 0 "NoErrors" 1 "InvalidObjectID" ;
VAL_ 2632384130 ErrorCodeChangeStrTooLong 0 "NoErrors" 1 "StringTooLong" ;
VAL_ 2632384130 ErrorCodeChangeStrError 0 "NoErrors" 1 "GeneralError" ;
VAL_ 2632384130 ErrorCodeChangePosInvalidParent 0 "NoErrors" 1 "InvalidParentObjectID" ;
VAL_ 2632384130 ErrorCodeChangePosInvalidObject 0 "NoErrors" 1 "InvalidObjectID" ;
VAL_ 2632384130 ErrorCodeChangePosInvalidError 0 "NoErrors" 1 "GeneralError" ;
VAL_ 2632384130 ErrorCodeSetObjectLabel1 1 "InvalidObjectId" 0 "NoError" ;
VAL_ 2632384130 ErrorCodeSetObjectLabel2 1 "InvalidStringVariableObjectId" 0 "NoError" ;
VAL_ 2632384130 ErrorCodeSetObjectLabel3 1 "InvalidFontType" 0 "NoError" ;
VAL_ 2632384130 ErrorCodeSetObjectLabel4 1 "InvalidDesignatorObjectReference" 0 "NoError" ;
VAL_ 2632384130 ErrorCodeSetObjectLabel5 1 "DesignatorReferencesInvalidObjects" 0 "NoError" ;
VAL_ 2632384130 ErrorCodeSetObjectLabel6 1 "GeneralError" 0 "NoError" ;
VAL_ 2632384130 ErrorCodeChangePoygonPoint1 1 "InvalidObjectId" 0 "NoError" ;
VAL_ 2632384130 ErrorCodeChangePoygonPoint2 1 "InvalidPointIndex" 0 "NoError" ;
VAL_ 2632384130 ErrorCodeChangePoygonPoint3 1 "GeneralError" 0 "NoError" ;
VAL_ 2632384130 ErrorCodeChangePolygonScale1 1 "InvalidObjectId" 0 "NoError" ;
VAL_ 2632384130 ErrorCodeChangePolygonScale5 1 "GeneralError" 0 "NoError" ;
VAL_ 2632384130 ErrorCodeGraphicsContextCmd1 1 "InvalidObjectID" 0 "NoError" ;
VAL_ 2632384130 ErrorCodeGraphicsContextCmd2 1 "InvalidCommandID" 0 "NoError" ;
VAL_ 2632384130 ErrorCodeGraphicsContextCmd3 1 "InvalidParameter" 0 "NoError" ;
VAL_ 2632384130 ErrorCodeGraphicsContextCmd4 1 "CommandWillProduceInvalidResults" 0 "NoError" ;
VAL_ 2632384130 ErrorCodeGraphicsContextCmd5 1 "GeneralError" 0 "NoError" ;
VAL_ 2632384130 ErrorCodeSelectColourMap2 1 "GeneralError" 0 "NoError" ;
VAL_ 2632384130 ErrorCodeSelectColourMap1 1 "InvalidObjectID" 0 "NoError" ;
VAL_ 2632384130 ErrorCodeLockUnlockMask9 1 "GeneralError" 0 "NoError" ;
VAL_ 2632384130 ErrorCodeLockUnlockMask8 1 "UnsolicitedUnlock_OperatorInduced" 0 "NoError" ;
VAL_ 2632384130 ErrorCodeLockUnlockMask7 1 "UnsolicitedUnlock_MaskChanged" 0 "NoError" ;
VAL_ 2632384130 ErrorCodeLockUnlockMask6 1 "UnsolicitedUnlock_TimeoutOccured" 0 "NoError" ;
VAL_ 2632384130 ErrorCodeLockUnlockMask5 1 "AlarmMaskIsActive" 0 "NoError" ;
VAL_ 2632384130 ErrorCodeLockUnlockMask4 1 "MaskNotLocked" 0 "NoError" ;
VAL_ 2632384130 ErrorCodeLockUnlockMask3 1 "MaskAlreadyLocked" 0 "NoError" ;
VAL_ 2632384130 ErrorCodeLockUnlockMask2 1 "MaskNotVisibleOrInvalidObjectId" 0 "NoError" ;
VAL_ 2632384130 ErrorCodeLockUnlockMask1 1 "WorkingSetNotActive" 0 "NoError" ;
VAL_ 2632384130 ErrorCodeExecuteMacro1 1 "ObjectIdNotExist" 0 "NoError" ;
VAL_ 2632384130 ErrorCodeExecuteMacro2 1 "ObjectIdIsNoMacro" 0 "NoError" ;
VAL_ 2632384130 ErrorCodeExecuteMacro3 1 "GeneralError" 0 "NoError" ;
VAL_ 2632384130 VersionNumberISO11783Part6 0 "Hannover Agritechnica 2001 limit" 1 "FDIS_Version" 2 "VersionOfThe1PublishedEdition" 3 "VersionOfThe2PublishedEdition" 4 "VersionOfThe3PublishedEdition" 5 "VersionOfThe4PublishedEdition" 6 "VersionOfThe5PublishedEdition" 7 "VersionOfThe6PublishedEdition" 8 "VersionOfThe7PublishedEdition" 9 "VersionOfThe8PublishedEdition" 10 "VersionOfThe9PublishedEdition" 11 "VersionOfThe10PublishedEdition" 12 "VersionOfThe11PublishedEdition" 13 "VersionOfThe12PublishedEdition" 14 "VersionOfThe13PublishedEdition" 15 "VersionOfThe14PublishedEdition" 16 "VersionOfThe15PublishedEdition" 17 "VersionOfThe16PublishedEdition" 18 "VersionOfThe17PublishedEdition" 19 "VersionOfThe18PublishedEdition" 20 "VersionOfThe19PublishedEdition" 21 "VersionOfThe20PublishedEdition" 22 "VersionOfThe21PublishedEdition" 23 "VersionOfThe22PublishedEdition" 24 "VersionOfThe23PublishedEdition" 25 "VersionOfThe24PublishedEdition" 26 "VersionOfThe25PublishedEdition" 27 "VersionOfThe26PublishedEdition" 28 "VersionOfThe27PublishedEdition" 29 "VersionOfThe28PublishedEdition" 30 "VersionOfThe29PublishedEdition" 31 "VersionOfThe30PublishedEdition" 32 "VersionOfThe31PublishedEdition" 33 "VersionOfThe32PublishedEdition" 34 "VersionOfThe33PublishedEdition" 35 "VersionOfThe34PublishedEdition" 36 "VersionOfThe35PublishedEdition" 37 "VersionOfThe36PublishedEdition" 38 "VersionOfThe37PublishedEdition" 39 "VersionOfThe38PublishedEdition" 40 "VersionOfThe39PublishedEdition" 41 "VersionOfThe40PublishedEdition" 42 "VersionOfThe41PublishedEdition" 43 "VersionOfThe42PublishedEdition" 44 "VersionOfThe43PublishedEdition" 45 "VersionOfThe44PublishedEdition" 46 "VersionOfThe45PublishedEdition" 47 "VersionOfThe46PublishedEdition" 48 "VersionOfThe47PublishedEdition" 49 "VersionOfThe48PublishedEdition" 50 "VersionOfThe50PublishedEdition" ;
VAL_ 2632384130 MemoryStatus 0 "EnoughMemoryMayBeAvailable" 1 "NotEnoughMemoryAvailable" ;
VAL_ 2632384130 ErrorCodeGetSupportedWideChars2 1 "GeneralError" 0 "NoError" ;
VAL_ 2632384130 ErrorCodeGetSupportedWideChars1 1 "TooManyRanges" 0 "NoError" ;
VAL_ 2632384130 FontSize_8x8 0 "NotSupported" 1 "Supported" ;
VAL_ 2632384130 FontSize_8x12 0 "NotSupported" 1 "Supported" ;
VAL_ 2632384130 FontSize_12x16 0 "NotSupported" 1 "Supported" ;
VAL_ 2632384130 FontSize_16x16 0 "NotSupported" 1 "Supported" ;
VAL_ 2632384130 FontSize_16x24 0 "NotSupported" 1 "Supported" ;
VAL_ 2632384130 FontSize_24x32 0 "NotSupported" 1 "Supported" ;
VAL_ 2632384130 FontSize_32x32 0 "NotSupported" 1 "Supported" ;
VAL_ 2632384130 FontSize_32x48 0 "NotSupported" 1 "Supported" ;
VAL_ 2632384130 FontSize_48x64 0 "NotSupported" 1 "Supported" ;
VAL_ 2632384130 FontSize_64x64 0 "NotSupported" 1 "Supported" ;
VAL_ 2632384130 FontSize_64x96 0 "NotSupported" 1 "Supported" ;
VAL_ 2632384130 FontSize_96x128 0 "NotSupported" 1 "Supported" ;
VAL_ 2632384130 FontSize_128x128 0 "NotSupported" 1 "Supported" ;
VAL_ 2632384130 FontSize_128x192 0 "NotSupported" 1 "Supported" ;
VAL_ 2632384130 FontType_BoldText 0 "NotSupported" 1 "Supported" ;
VAL_ 2632384130 FontType_CrossedOutText 0 "NotSupported" 1 "Supported" ;
VAL_ 2632384130 FontType_UnderlinedText 0 "NotSupported" 1 "Supported" ;
VAL_ 2632384130 FontType_ItalicsText 0 "NotSupported" 1 "Supported" ;
VAL_ 2632384130 FontType_InvertedText 0 "NotSupported" 1 "Supported" ;
VAL_ 2632384130 FontType_FlashInverted 0 "NotSupported" 1 "Supported" ;
VAL_ 2632384130 FontType_FlashHidden 0 "NotSupported" 1 "Supported" ;
VAL_ 2632384130 FontType_ProportionalFont 0 "NotSupported" 1 "Supported" ;
VAL_ 2632384130 LineArts 0 "LineArtIsNotSupported" 1 "LineArtIsSupported" ;
VAL_ 2632384130 FillTypes 0 "FillPaternIsNotSupported" 1 "FillPaternIsSupported" ;
VAL_ 2632384130 ShapeFillTypes 0 "FillOfEllipseAndPolygonNotSup" 1 "FillEllipseSupAndFillPolygNotSup" 2 "FillEllipseNotSupAndFillPolygSup" 3 "FillOfEllipseAndPolygonSup" ;
VAL_ 2632384130 SupportedGrapicMode 0 "Monocrome" 1 "Colour16" 2 "Colour256" ;
VAL_ 2632384130 Hardware1 0 "VT has no touch screen and no pointing device" 1 "VT has a touch screen or pointing device" ;
VAL_ 2632384130 Hardware2 0 "VT does not report drag operation" 1 "VT reports drag operation" ;
VAL_ 2632384130 Hardware3 0 "VT has no multiple frequency audio output" 1 "VT has multiple frequency audio output" ;
VAL_ 2632384130 Hardware4 0 "VT has no adjustable volume audio output" 1 "VT has adjustable volume audio output" ;
VAL_ 2632384130 Hardware5 0 "VT does not support simultaneous activations of softkeys" 1 "VT supports simultaneous activations of softkeys" ;
VAL_ 2632384130 Hardware6 0 "VT does not support intermediate coordinates during a drag operation" 1 "VT supports intermediate coordinates during a drag operation" ;
VAL_ 2632384130 AcknowledgmentStoreVersion 0 "SuccessfullyStored" 2 "VersionLabelIsNotCorrect" 4 "InsufficientMemoryAvailable" 8 "GeneralError" ;
VAL_ 2632384130 AcknowledgmentLoadVersion 0 "SuccessfullyLoaded" 2 "VersionLabelNotCorrectOrUnknown" 4 "InsufficientMemoryAvailable" 8 "GeneralError" ;
VAL_ 2632384130 AcknowledgmentDeleteVersion 0 "SuccessfullyDeleted" 2 "VersionLabelIsNotCorrect" 4 "NA" 8 "GeneralError" ;
VAL_ 2632384130 ErrorCodeVtObjPoolError1 0 "NoErrors" 1 "UnsupportedMethodOrAttribute" ;
VAL_ 2632384130 ErrorCodeVtObjPoolError2 0 "NoErrors" 1 "UnknownObjectReference" ;
VAL_ 2632384130 ErrorCodeVtObjPoolError3 0 "NoErrors" 1 "RecursiveObjectReference" ;
VAL_ 2632384130 ErrorCodeVtObjPoolError4 0 "NoErrors" 1 "OtherError" ;
VAL_ 2632384130 VTBusyCode1 1 "VTIsBusyUpdatingVisibleMask" ;
VAL_ 2632384130 VTBusyCode2 1 "VTIsBusySavingDataToNonVolMemory" ;
VAL_ 2632384130 VTBusyCode3 1 "VTIsBusyExecutingCommand" ;
VAL_ 2632384130 VTBusyCode4 1 "VTIsBusyExecutingMacro" ;
VAL_ 2632384130 VTBusyCode5 1 "VTIsBusyParsingAnObjectPool" ;
VAL_ 2632384130 VTBusyCode8 1 "VTIsOutOfMemory" ;
