VERSION ""

NS_ :

BS_:

BU_:

BO_ 2365194522 PD_Loader: 8 SEND
 SG_ Capacity : 32|32@1+ (1,0) [0|4294967295] "mm2/s"  Loader
 SG_ Quality : 0|32@1+ (1,0) [0|100] "%"  Loader

BO_ 2364540158 EEC1: 8 Vector_XXX
 SG_ EngineSpeed : 24|16@1+ (0.125,0) [0|8031.875] "rpm" Vector_XXX

BO_ 214695671 PD_TC: 14 TC
 SG_ AreaPerTimeCapacity m151 : 32|32@1- (1,0) [0|2.14748e+09] "mm�/s" Vector__XXX

BA_DEF_ BO_  "VFrameFormat" ENUM  "StandardCAN","ExtendedCAN","reserved","J1939PG";
BA_DEF_  "BusType" STRING ;
BA_DEF_  "ProtocolType" STRING ;
BA_DEF_DEF_  "VFrameFormat" "J1939PG";
BA_DEF_DEF_  "BusType" "";
BA_DEF_DEF_  "ProtocolType" "";
BA_ "ProtocolType" "J1939";
BA_ "BusType" "CAN";
